## Kconfig
```
#
# ORIGEM: copia de arquivo do SDK — nao e codigo do curso.
#   SDK     : nRF Connect SDK v3.4.0
#   Upstream: nrf/samples/cellular/gnss/Kconfig
#   Local   : C:/ncs/v3.4.0/nrf/samples/cellular/gnss/Kconfig
#   Copiado : 2026-09-08 — curso nrf-manaus-2, modulo gnss/01_gnss_basic
#
# Para conferir se divergiu do SDK:
#   diff <este arquivo> C:/ncs/v3.4.0/nrf/samples/cellular/gnss/Kconfig
#
# DIVERGENCIA DO CURSO: nenhuma.
#

#
# Copyright (c) 2020 Nordic Semiconductor ASA
#
# SPDX-License-Identifier: LicenseRef-Nordic-5-Clause
#

menu "GNSS sample"

choice
	default GNSS_SAMPLE_MODE_CONTINUOUS
	prompt "Select GNSS operation mode"

config GNSS_SAMPLE_MODE_CONTINUOUS
	bool "Continuous tracking"

config GNSS_SAMPLE_MODE_PERIODIC
	bool "Periodic fixes"

config GNSS_SAMPLE_MODE_TTFF_TEST
	bool "Time-to-first-fix (TTFF) test mode"
	select GNSS_SAMPLE_NMEA_ONLY

endchoice

if GNSS_SAMPLE_MODE_PERIODIC

config GNSS_SAMPLE_PERIODIC_INTERVAL
	int "Fix interval for periodic fixes"
	range 10 65535
	default 120
	help
	  Fix interval (in seconds) for periodic fixes.

config GNSS_SAMPLE_PERIODIC_TIMEOUT
	int "Fix timeout for periodic fixes"
	range 0 65535
	default 120
	help
	  Fix timeout (in seconds) for periodic fixes.
	  If set to zero, GNSS is allowed to run indefinitely until a valid PVT estimate is produced.

endif # GNSS_SAMPLE_MODE_PERIODIC

if GNSS_SAMPLE_MODE_TTFF_TEST

config GNSS_SAMPLE_MODE_TTFF_TEST_COLD_START
	bool "Delete GNSS data before each start (cold start)"
	help
	  When enabled, deletes all stored data from GNSS to force a cold start every time GNSS is started.

config GNSS_SAMPLE_MODE_TTFF_TEST_INTERVAL
	int "Time to wait between TTFF tests in seconds"
	range 1 604800
	default 120

endif # GNSS_SAMPLE_MODE_TTFF_TEST

config GNSS_SAMPLE_NMEA_ONLY
	bool "Output only NMEA strings"
	help
	  Outputs only NMEA strings from the GNSS.

endmenu

choice
	default GNSS_SAMPLE_ASSISTANCE_NONE
	prompt "Select whether GNSS assistance is used or not"

config GNSS_SAMPLE_ASSISTANCE_NONE
	bool "Assistance not used"

config GNSS_SAMPLE_ASSISTANCE_NRF_CLOUD
	bool "Use nRF Cloud A-GNSS"
	select NRF_CLOUD_COAP
	imply NRF_CLOUD_AGNSS
	select MODEM_JWT
	select MODEM_INFO
	select DATE_TIME

config GNSS_SAMPLE_ASSISTANCE_SUPL
	bool "Use SUPL assistance"
	select SUPL_CLIENT_LIB

config GNSS_SAMPLE_ASSISTANCE_MINIMAL
	bool "Use factory almanac, LTE network time and MCC based location"
	select GNSS_SAMPLE_LTE_ON_DEMAND
	select SETTINGS
	select FCB
	select FLASH
	select FLASH_MAP

endchoice

if !GNSS_SAMPLE_ASSISTANCE_NONE

config GNSS_SAMPLE_LTE_ON_DEMAND
	bool "LTE is activated only when needed to fetch A-GNSS data"
	depends on !NRF_CLOUD_PGPS
	help
	  Activates LTE only when it is needed to fetch A-GNSS data. This is not supported when
	  P-GPS is enabled.

endif # !GNSS_SAMPLE_ASSISTANCE_NONE

if GNSS_SAMPLE_ASSISTANCE_SUPL

config GNSS_SAMPLE_SUPL_HOSTNAME
	string "SUPL server hostname"
	help
	  SUPL server hostname.

config GNSS_SAMPLE_SUPL_PORT
	int "SUPL server port number"
	range 0 65535
	default 7275 if GNSS_SAMPLE_SUPL_SEC_TAG > 0
	default 7276
	help
	  SUPL server port number. The OMA UserPlane Location Protocol (ULP) port number is 7275,
	  but some servers are known to use port 7276 for non-TLS connections.

config GNSS_SAMPLE_SUPL_SEC_TAG
	int "Security tag for connection to the SUPL server"
	range 0 2147483667
	default 0
	help
	  Set a non-zero value to use TLS for connection to the SUPL server. When TLS is enabled,
	  a root CA certificate must be stored on the modem.

endif # GNSS_SAMPLE_ASSISTANCE_SUPL

if GNSS_SAMPLE_MODE_CONTINUOUS

choice
	default GNSS_SAMPLE_POWER_SAVING_DISABLED
	prompt "Select GNSS power saving mode (duty-cycling)"

config GNSS_SAMPLE_POWER_SAVING_DISABLED
	bool "No power saving"

config GNSS_SAMPLE_POWER_SAVING_MODERATE
	bool "Power saving without significant performance degradation"

config GNSS_SAMPLE_POWER_SAVING_HIGH
	bool "Power saving with acceptable performance degradation"

endchoice

endif # GNSS_SAMPLE_MODE_CONTINUOUS

config GNSS_SAMPLE_REFERENCE_LATITUDE
	string "Reference position latitude in decimal degrees"
	help
	  When set, the sample calculates the distance from the reference position for each fix.
	  Given in decimal degrees (DD), for example "61.500000".

config GNSS_SAMPLE_REFERENCE_LONGITUDE
	string "Reference position longitude in decimal degrees"
	help
	  When set, the sample calculates the distance from the reference position for each fix.
	  Given in decimal degrees (DD), for example "23.800000".

config GNSS_SAMPLE_LOW_ACCURACY
	bool "Allow low accuracy fixes"
	help
	  Allows fixes with lower accuracy.

if GNSS_SAMPLE_ASSISTANCE_MINIMAL && GNSS_SAMPLE_LOW_ACCURACY

config GNSS_SAMPLE_ASSISTANCE_REFERENCE_ALT
	int "Reference altitude for 3-sat first fix in meters"
	range -32767 32767
	default -32767
	help
	  Reference altitude for 3-sat first fix in meters above the reference ellipsoid surface.
	  The default value -32767 implies that reference altitude is not injected.

endif # GNSS_SAMPLE_ASSISTANCE_MINIMAL && GNSS_SAMPLE_LOW_ACCURACY

menu "Zephyr Kernel"
source "Kconfig.zephyr"
endmenu

module = GNSS_SAMPLE
module-str = GNSS sample
source "$(ZEPHYR_BASE)/subsys/logging/Kconfig.template.log_config"
```

## prj.conf
```kconfig
#
# ORIGEM: copia de arquivo do SDK — nao e codigo do curso.
#   SDK     : nRF Connect SDK v3.4.0
#   Upstream: nrf/samples/cellular/gnss/prj.conf
#   Local   : C:/ncs/v3.4.0/nrf/samples/cellular/gnss/prj.conf
#   Copiado : 2026-09-08 — curso nrf-manaus-2, modulo gnss/01_gnss_basic
#
# Para conferir se divergiu do SDK:
#   diff <este arquivo> C:/ncs/v3.4.0/nrf/samples/cellular/gnss/prj.conf
#
# DIVERGENCIA DO CURSO:
#   CONFIG_MODEM_ANTENNA_GNSS_EXTERNAL=y
#     O padrao do NCS para o alvo nrf9151dk e a antena de bordo. A nRF9151 SMA DK
#     nao tem antena de bordo nem LNA de GNSS, entao sem esta linha a placa nao
#     recebe nada com o cabo SMA plugado no J2.
#

#
# Copyright (c) 2019 Nordic Semiconductor ASA
#
# SPDX-License-Identifier: LicenseRef-Nordic-5-Clause
#

# TF-M config
CONFIG_TFM_PROFILE_TYPE_MINIMAL=y

# General
CONFIG_FPU=y
CONFIG_NRF_MODEM_LIB=y
CONFIG_STDOUT_CONSOLE=y
CONFIG_UART_INTERRUPT_DRIVEN=y
CONFIG_PICOLIBC_IO_FLOAT=y
CONFIG_LOG=y
CONFIG_LOG_MODE_IMMEDIATE=y

# GNSS sample
# Enable to use nRF Cloud A-GNSS
CONFIG_GNSS_SAMPLE_ASSISTANCE_NRF_CLOUD=n
# nRF Cloud
CONFIG_NRF_CLOUD=y
CONFIG_NRF_CLOUD_COAP=y

# CoAP Client
CONFIG_COAP_CLIENT_BLOCK_SIZE=1024
CONFIG_COAP_CLIENT_STACK_SIZE=6144
CONFIG_COAP_CLIENT_THREAD_PRIORITY=0

# LTE Link Control
CONFIG_LTE_LINK_CONTROL=y
CONFIG_LTE_LC_PSM_MODULE=y
CONFIG_LTE_PSM_REQ=y
# PSM requested periodic TAU 8 hours
CONFIG_LTE_PSM_REQ_RPTAU="00101000"
# PSM requested active time 6 seconds
CONFIG_LTE_PSM_REQ_RAT="00000011"

# AT Host library - Used to send AT commands directy from an UART terminal and to allow
#		    integration with nRF Connect for Desktop LTE Link monitor application.
CONFIG_AT_HOST_LIBRARY=y

# Networking
CONFIG_NETWORKING=y
CONFIG_NET_SOCKETS_OFFLOAD=y
CONFIG_NET_SOCKETS=y
# Disable native network stack to save some memory
CONFIG_NET_NATIVE=n

# Memory and stack configuration
CONFIG_HEAP_MEM_POOL_SIZE=2048
CONFIG_MAIN_STACK_SIZE=4096
CONFIG_SYSTEM_WORKQUEUE_STACK_SIZE=1536

# --- Divergencia do curso ---
# A nRF9151 SMA DK (PCA10201) nao tem antena de bordo nem LNA de GNSS.
CONFIG_MODEM_ANTENNA_GNSS_EXTERNAL=y
```

## src/assistance.c
```c
/*
 * ORIGEM: copia de arquivo do SDK — nao e codigo do curso.
 *   SDK     : nRF Connect SDK v3.4.0
 *   Upstream: nrf/samples/cellular/gnss/src/assistance.c
 *   Local   : C:/ncs/v3.4.0/nrf/samples/cellular/gnss/src/assistance.c
 *   Copiado : 2026-09-08 — curso nrf-manaus-2, modulo gnss/01_gnss_basic
 *
 * Para conferir se divergiu do SDK:
 *   diff <este arquivo> C:/ncs/v3.4.0/nrf/samples/cellular/gnss/src/assistance.c
 *
 * DIVERGENCIA DO CURSO: nenhuma.
 */

/*
 * Copyright (c) 2021 Nordic Semiconductor ASA
 *
 * SPDX-License-Identifier: LicenseRef-Nordic-5-Clause
 */

#include <stdlib.h>
#include <zephyr/kernel.h>
#include <zephyr/logging/log.h>
#include <modem/modem_info.h>
#if defined(CONFIG_NRF_CLOUD_AGNSS)
#include <net/nrf_cloud_agnss.h>
#endif /* CONFIG_NRF_CLOUD_AGNSS */
#if defined(CONFIG_NRF_CLOUD_PGPS)
#include <net/nrf_cloud_pgps.h>
#endif /* CONFIG_NRF_CLOUD_PGPS */
#include <net/nrf_cloud_coap.h>

#include "assistance.h"

LOG_MODULE_DECLARE(gnss_sample, CONFIG_GNSS_SAMPLE_LOG_LEVEL);

#if defined(CONFIG_NRF_CLOUD_AGNSS)
static char agnss_data_buf[NRF_CLOUD_AGNSS_MAX_DATA_SIZE];
#endif /* CONFIG_NRF_CLOUD_AGNSS */

#if defined(CONFIG_NRF_CLOUD_PGPS)
static struct nrf_modem_gnss_agnss_data_frame agnss_need;
static struct gps_pgps_request pgps_request;
static struct nrf_cloud_pgps_prediction *prediction;
static struct k_work get_pgps_data_work;
static struct k_work inject_pgps_data_work;
#endif /* CONFIG_NRF_CLOUD_PGPS */

static struct k_work_q *work_q;
static volatile bool assistance_active;
static bool coap_connected;

#if defined(CONFIG_NRF_CLOUD_AGNSS)
static int serving_cell_info_get(struct lte_lc_cell *serving_cell)
{
	int err;

	err = modem_info_init();
	if (err) {
		return err;
	}

	char resp_buf[MODEM_INFO_MAX_RESPONSE_SIZE];

	err = modem_info_string_get(MODEM_INFO_CELLID,
				    resp_buf,
				    MODEM_INFO_MAX_RESPONSE_SIZE);
	if (err < 0) {
		return err;
	}

	serving_cell->id = strtol(resp_buf, NULL, 16);

	err = modem_info_string_get(MODEM_INFO_AREA_CODE,
				    resp_buf,
				    MODEM_INFO_MAX_RESPONSE_SIZE);
	if (err < 0) {
		return err;
	}

	serving_cell->tac = strtol(resp_buf, NULL, 16);

	/* Request for MODEM_INFO_MNC returns both MNC and MCC in the same string. */
	err = modem_info_string_get(MODEM_INFO_OPERATOR,
				    resp_buf,
				    MODEM_INFO_MAX_RESPONSE_SIZE);
	if (err < 0) {
		return err;
	}

	serving_cell->mnc = strtol(&resp_buf[3], NULL, 10);
	/* Null-terminate MCC, read and store it. */
	resp_buf[3] = '\0';
	serving_cell->mcc = strtol(resp_buf, NULL, 10);

	return 0;
}
#endif /* CONFIG_NRF_CLOUD_AGNSS */

#if defined(CONFIG_NRF_CLOUD_PGPS)
static void get_pgps_data_work_fn(struct k_work *work)
{
	ARG_UNUSED(work);

	int err;

	assistance_active = true;

	LOG_INF("Sending request for P-GPS predictions to nRF Cloud...");

	struct nrf_cloud_coap_pgps_request request = {
		.pgps_req = &pgps_request
	};

	struct nrf_cloud_pgps_result file_location = {0};

	static char host[64];
	static char path[128];

	memset(host, 0, sizeof(host));
	memset(path, 0, sizeof(path));

	file_location.host = host;
	file_location.host_sz = sizeof(host);
	file_location.path = path;
	file_location.path_sz = sizeof(path);

	err = nrf_cloud_coap_pgps_url_get(&request, &file_location);
	if (err) {
		LOG_ERR("GNSS: Failed to get P-GPS data, error: %d", err);

		nrf_cloud_pgps_request_reset();

		goto exit;
	}

	LOG_INF("Processing P-GPS response");

	err = nrf_cloud_pgps_update(&file_location);
	if (err) {
		LOG_ERR("Failed to process P-GPS response, error: %d", err);

		nrf_cloud_pgps_request_reset();

		goto exit;
	}

	LOG_INF("P-GPS response processed");

	err = nrf_cloud_pgps_notify_prediction();
	if (err) {
		LOG_ERR("Failed to request current prediction, error: %d", err);

		goto exit;
	}

	LOG_INF("P-GPS predictions requested");
exit:
	assistance_active = false;
}

static void inject_pgps_data_work_fn(struct k_work *work)
{
	ARG_UNUSED(work);

	int err;

	assistance_active = true;

	LOG_INF("Injecting P-GPS ephemerides");

	err = nrf_cloud_pgps_inject(prediction, &agnss_need);
	if (err) {
		LOG_ERR("Failed to inject P-GPS ephemerides");
	}

	err = nrf_cloud_pgps_preemptive_updates();
	if (err) {
		LOG_ERR("Failed to request P-GPS updates");
	}

	assistance_active = false;
}

static void pgps_event_handler(struct nrf_cloud_pgps_event *event)
{
	switch (event->type) {
	case PGPS_EVT_AVAILABLE:
		prediction = event->prediction;

		k_work_submit_to_queue(work_q, &inject_pgps_data_work);
		break;

	case PGPS_EVT_REQUEST:
		memcpy(&pgps_request, event->request, sizeof(pgps_request));

		k_work_submit_to_queue(work_q, &get_pgps_data_work);
		break;

	case PGPS_EVT_LOADING:
		LOG_INF("Loading P-GPS predictions");
		assistance_active = true;
		break;

	case PGPS_EVT_READY:
		LOG_INF("P-GPS predictions ready");
		assistance_active = false;
		break;

	default:
		/* No action needed */
		break;
	}
}
#endif /* CONFIG_NRF_CLOUD_PGPS */

#if defined(CONFIG_NRF_CLOUD_AGNSS)
static const char *get_system_string(uint8_t system_id)
{
	switch (system_id) {
	case NRF_MODEM_GNSS_SYSTEM_INVALID:
		return "invalid";

	case NRF_MODEM_GNSS_SYSTEM_GPS:
		return "GPS";

	case NRF_MODEM_GNSS_SYSTEM_QZSS:
		return "QZSS";

	default:
		return "unknown";
	}
}
#endif /* CONFIG_NRF_CLOUD_AGNSS */

int assistance_init(struct k_work_q *assistance_work_q)
{
	work_q = assistance_work_q;

	int err = nrf_cloud_coap_init();

	if (err) {
		LOG_ERR("Failed to initialize nRF Cloud CoAP client: %d", err);
		return err;
	}

#if defined(CONFIG_NRF_CLOUD_PGPS)
	k_work_init(&get_pgps_data_work, get_pgps_data_work_fn);
	k_work_init(&inject_pgps_data_work, inject_pgps_data_work_fn);

	struct nrf_cloud_pgps_init_param pgps_param = {
		.event_handler = pgps_event_handler,
		/* storage is defined by CONFIG_NRF_CLOUD_PGPS_STORAGE */
		.storage_base = 0u,
		.storage_size = 0u
	};

	if (nrf_cloud_pgps_init(&pgps_param) != 0) {
		LOG_ERR("Failed to initialize P-GPS");
		return -1;
	}
#endif /* CONFIG_NRF_CLOUD_PGPS */

	return 0;
}

int assistance_request(struct nrf_modem_gnss_agnss_data_frame *agnss_request)
{
	int err = 0;

	if (!coap_connected) {
		err = nrf_cloud_coap_connect(NULL);
		if (err) {
			LOG_ERR("Connecting to nRF Cloud failed: %d", err);
			return err;
		}
		coap_connected = true;
	}

#if defined(CONFIG_NRF_CLOUD_PGPS)
	/* Store the A-GNSS data request for P-GPS use. */
	memcpy(&agnss_need, agnss_request, sizeof(agnss_need));

#if defined(CONFIG_NRF_CLOUD_AGNSS)
	if (!agnss_request->data_flags) {
		/* No assistance needed from A-GNSS, skip directly to P-GPS. */
		nrf_cloud_pgps_notify_prediction();
		return 0;
	}

	/* P-GPS will handle GPS ephemerides, so skip those. */
	agnss_request->system[0].sv_mask_ephe = 0;
	/* GPS almanacs are not needed with P-GPS, so skip those. */
	agnss_request->system[0].sv_mask_alm = 0;
#endif /* CONFIG_NRF_CLOUD_AGNSS */
#endif /* CONFIG_NRF_CLOUD_PGPS */
#if defined(CONFIG_NRF_CLOUD_AGNSS)
	assistance_active = true;

	struct nrf_cloud_coap_agnss_request request = {
		NRF_CLOUD_COAP_AGNSS_REQ_CUSTOM,
		agnss_request,
		NULL,
#if defined(CONFIG_NRF_CLOUD_AGNSS_FILTERED_RUNTIME)
		true,
		/* Note: if you change the mask angle here, you may want to
		 * also change it to match in gnss_init_and_start() in main.c.
		 */
		CONFIG_NRF_CLOUD_AGNSS_ELEVATION_MASK
#endif
	};

	struct nrf_cloud_coap_agnss_result result = {
		agnss_data_buf,
		sizeof(agnss_data_buf),
		0
	};

	struct lte_lc_cells_info net_info = { 0 };

	err = serving_cell_info_get(&net_info.current_cell);
	if (err) {
		LOG_ERR("Could not get cell info, error: %d", err);
	} else {
		/* Network info for the location request. */
		request.net_info = &net_info;
	}

	LOG_INF("Requesting A-GNSS data: data_flags: 0x%02x", agnss_request->data_flags);
	for (int i = 0; i < agnss_request->system_count; i++) {
		LOG_INF("Requesting A-GNSS data: %s ephe: 0x%llx, alm: 0x%llx",
			get_system_string(agnss_request->system[i].system_id),
			agnss_request->system[i].sv_mask_ephe,
			agnss_request->system[i].sv_mask_alm);
	}

	err = nrf_cloud_coap_agnss_data_get(&request, &result);
	if (err) {
		LOG_ERR("Failed to get A-GNSS data, error: %d", err);
		goto agnss_exit;
	}

	LOG_INF("Processing A-GNSS data");

	err = nrf_cloud_agnss_process(result.buf, result.agnss_sz);
	if (err) {
		LOG_ERR("Failed to process A-GNSS data, error: %d", err);
		goto agnss_exit;
	}

	LOG_INF("A-GNSS data processed");

agnss_exit:
	assistance_active = false;
#endif /* CONFIG_NRF_CLOUD_AGNSS */

#if defined(CONFIG_NRF_CLOUD_PGPS)
	nrf_cloud_pgps_notify_prediction();
#endif /* CONFIG_NRF_CLOUD_PGPS */

	return err;
}

bool assistance_is_active(void)
{
	return assistance_active;
}
```

## src/assistance_supl.c
```c
/*
 * ORIGEM: copia de arquivo do SDK — nao e codigo do curso.
 *   SDK     : nRF Connect SDK v3.4.0
 *   Upstream: nrf/samples/cellular/gnss/src/assistance_supl.c
 *   Local   : C:/ncs/v3.4.0/nrf/samples/cellular/gnss/src/assistance_supl.c
 *   Copiado : 2026-09-08 — curso nrf-manaus-2, modulo gnss/01_gnss_basic
 *
 * Para conferir se divergiu do SDK:
 *   diff <este arquivo> C:/ncs/v3.4.0/nrf/samples/cellular/gnss/src/assistance_supl.c
 *
 * DIVERGENCIA DO CURSO: nenhuma.
 */

/*
 * Copyright (c) 2019 Nordic Semiconductor ASA
 *
 * SPDX-License-Identifier: LicenseRef-Nordic-5-Clause
 */

#include <stdio.h>
#include <zephyr/kernel.h>
#include <zephyr/logging/log.h>
#include <zephyr/net/socket.h>
#include <supl_os_client.h>
#include <supl_session.h>

#include "assistance.h"

LOG_MODULE_DECLARE(gnss_sample, CONFIG_GNSS_SAMPLE_LOG_LEVEL);

#define SUPL_SERVER        CONFIG_GNSS_SAMPLE_SUPL_HOSTNAME
#define SUPL_SERVER_PORT   CONFIG_GNSS_SAMPLE_SUPL_PORT

BUILD_ASSERT(sizeof(CONFIG_GNSS_SAMPLE_SUPL_HOSTNAME) > 1, "Server hostname must be configured");

static int supl_fd = -1;
static volatile bool assistance_active;

static ssize_t supl_read(void *p_buff, size_t nbytes, void *user_data)
{
	ARG_UNUSED(user_data);

	ssize_t rc = zsock_recv(supl_fd, p_buff, nbytes, 0);

	if (rc < 0 && (errno == EAGAIN)) {
		/* Return 0 to indicate a timeout. */
		rc = 0;
	} else if (rc == 0) {
		/* Peer closed the socket, return an error. */
		rc = -1;
	}

	return rc;
}

static ssize_t supl_write(const void *p_buff, size_t nbytes, void *user_data)
{
	ARG_UNUSED(user_data);

	return zsock_send(supl_fd, p_buff, nbytes, 0);
}

static int inject_agnss_type(void *agnss, size_t agnss_size, uint16_t type, void *user_data)
{
	ARG_UNUSED(user_data);

	int retval = nrf_modem_gnss_agnss_write(agnss, agnss_size, type);

	if (retval != 0) {
		LOG_ERR("Failed to write A-GNSS data, type: %d (errno: %d)", type, errno);
		return -1;
	}

	LOG_INF("Injected A-GNSS data, type: %d, size: %d", type, agnss_size);

	return 0;
}

static int supl_logger(int level, const char *fmt, ...)
{
	char buffer[256] = { 0 };
	va_list args;

	va_start(args, fmt);
	int ret = vsnprintk(buffer, sizeof(buffer), fmt, args);

	va_end(args);

	if (ret < 0) {
		LOG_ERR("%s: encoding error", __func__);
		return ret;
	} else if ((size_t)ret >= sizeof(buffer)) {
		LOG_ERR("%s: too long message,"
		       "it will be cut short", __func__);
	}

	LOG_INF("%s", buffer);

	return ret;
}

static int open_supl_socket(void)
{
	int err;
	char port[6];
	struct zsock_addrinfo *info;

	struct zsock_addrinfo hints = {
		.ai_flags = AI_NUMERICSERV,
		.ai_family = AF_UNSPEC, /* Both IPv4 and IPv6 addresses accepted. */
		.ai_socktype = SOCK_STREAM
	};

	snprintf(port, sizeof(port), "%d", SUPL_SERVER_PORT);

	err = zsock_getaddrinfo(SUPL_SERVER, port, &hints, &info);
	if (err) {
		LOG_ERR("Failed to resolve hostname %s, error: %d", SUPL_SERVER, err);

		return -1;
	}

	/* Not connected. */
	err = -1;

	for (struct zsock_addrinfo *addr = info; addr != NULL; addr = addr->ai_next) {
		char ip[INET6_ADDRSTRLEN] = { 0 };
		struct sockaddr *const sa = addr->ai_addr;

#if (CONFIG_GNSS_SAMPLE_SUPL_SEC_TAG > 0)
		supl_fd = zsock_socket(sa->sa_family, SOCK_STREAM, IPPROTO_TLS_1_2);
#else
		supl_fd = zsock_socket(sa->sa_family, SOCK_STREAM, IPPROTO_TCP);
#endif
		if (supl_fd < 0) {
			LOG_ERR("Failed to create socket, errno %d", errno);
			goto cleanup;
		}

#if (CONFIG_GNSS_SAMPLE_SUPL_SEC_TAG > 0)
		int sec_tag_list[] = { CONFIG_GNSS_SAMPLE_SUPL_SEC_TAG };

		err = zsock_setsockopt(supl_fd, SOL_TLS, TLS_SEC_TAG_LIST,
				       sec_tag_list, sizeof(sec_tag_list));
		if (err) {
			LOG_ERR("Failed to set TLS sec tag list, errno %d", errno);
			goto cleanup;
		}

		/* Do not require peer verification */
		int peer_verify = TLS_PEER_VERIFY_NONE;

		err = zsock_setsockopt(supl_fd, SOL_TLS, TLS_PEER_VERIFY,
				       &peer_verify, sizeof(peer_verify));
		if (err) {
			LOG_ERR("Failed to set TLS peer verify, errno %d", errno);
			goto cleanup;
		}
#endif

		/* The SUPL library expects a 1 second timeout for the read function. */
		struct timeval timeout = {
			.tv_sec = 1,
			.tv_usec = 0,
		};

		err = zsock_setsockopt(supl_fd, SOL_SOCKET, SO_RCVTIMEO, &timeout, sizeof(timeout));
		if (err) {
			LOG_ERR("Failed to set socket timeout, errno %d", errno);
			goto cleanup;
		}

		zsock_inet_ntop(sa->sa_family,
				(void *)&((struct sockaddr_in *)sa)->sin_addr,
				ip,
				INET6_ADDRSTRLEN);
		LOG_INF("Connecting to %s port %d using %s", ip, SUPL_SERVER_PORT,
#if (CONFIG_GNSS_SAMPLE_SUPL_SEC_TAG > 0)
			"TLS"
#else
			"TCP"
#endif
			);

		err = zsock_connect(supl_fd, sa, addr->ai_addrlen);
		if (err) {
			zsock_close(supl_fd);
			supl_fd = -1;

			/* Try the next address. */
			LOG_WRN("Connecting to server failed, errno %d", errno);
		} else {
			/* Connected. */
			break;
		}
	}

cleanup:
	zsock_freeaddrinfo(info);

	if (err) {
		/* Unable to connect, close socket. */
		LOG_ERR("Could not connect to SUPL server");
		if (supl_fd > -1) {
			zsock_close(supl_fd);
			supl_fd = -1;
		}
		return -1;
	}

	return 0;
}

static void close_supl_socket(void)
{
	if (zsock_close(supl_fd) < 0) {
		LOG_ERR("Failed to close SUPL socket");
	}
}

int assistance_init(struct k_work_q *assistance_work_q)
{
	ARG_UNUSED(assistance_work_q);

	static struct supl_api supl_api = {
		.read       = supl_read,
		.write      = supl_write,
		.handler    = inject_agnss_type,
		.logger     = supl_logger,
		.counter_ms = k_uptime_get
	};

	if (supl_init(&supl_api) != 0) {
		LOG_ERR("Failed to initialize SUPL library");
		return -1;
	}

	return 0;
}

int assistance_request(struct nrf_modem_gnss_agnss_data_frame *agnss_request)
{
	int err;

	assistance_active = true;

	err = open_supl_socket();
	if (err) {
		goto exit;
	}

	LOG_INF("Starting SUPL session");
	err = supl_session(agnss_request);
	LOG_INF("Done");
	close_supl_socket();

exit:
	assistance_active = false;

	return err;
}

bool assistance_is_active(void)
{
	return assistance_active;
}
```

## src/factory_almanac_v3.h
```c
/*
 * ORIGEM: copia de arquivo do SDK — nao e codigo do curso.
 *   SDK     : nRF Connect SDK v3.4.0
 *   Upstream: nrf/samples/cellular/gnss/src/factory_almanac_v3.h
 *   Local   : C:/ncs/v3.4.0/nrf/samples/cellular/gnss/src/factory_almanac_v3.h
 *   Copiado : 2026-09-08 — curso nrf-manaus-2, modulo gnss/01_gnss_basic
 *
 * Para conferir se divergiu do SDK:
 *   diff <este arquivo> C:/ncs/v3.4.0/nrf/samples/cellular/gnss/src/factory_almanac_v3.h
 *
 * DIVERGENCIA DO CURSO: nenhuma.
 */

/*
 * Copyright (c) 2023 Nordic Semiconductor ASA
 *
 * SPDX-License-Identifier: LicenseRef-Nordic-5-Clause
 */

#ifndef FACTORY_ALMANAC_V3_H_
#define FACTORY_ALMANAC_V3_H_

/* Factory almanac generated on 2026-06-02 14:51:03.
 *
 * Note, that the almanac gets more inaccurate with time and it should be updated periodically.
 */

#define FACTORY_ALMANAC_DATA_V3 \
	"f0ea03003175090000000031780e6375098f0943fd007c0ca100f5543d00105f" \
	"0800984e99ff0d01fdff31ee89637509e20c51fd009b0da10024b93600971ae1" \
	"ff219dd5ff76000200319e38637509ed2155fd00470ca1002eb4650080553200" \
	"6f1d4600c801fbff31d31e637509351363fd003a0da100ec3c91ffca878affe1" \
	"66beff3e00000031f82d637509111948fd00a40da1002438630039f83a007e56" \
	"d7ff0bff000031551e637509541c5ffd00360da100246c3b00267beaff61107a" \
	"0090fd01003121ab637509570555fd00590ca100504cbaff1efcafff43235900" \
	"36ffffff312c5f63750927004dfd00670da100699f0d0095161600050acaffc2" \
	"01feff318c1c6375097b0f5bfd00740da10094988eff400e5300efd8e2ff0a03" \
	"ffff31215a6375099c2154fd00da0ca100099a650097d7a3ff3b0b1e00a0fd01" \
	"00311313637509440d4bfd009c0ca100921a3c0098f09ffffb0bacffb3fe0300" \
	"31ca47637509a30a4ffd00500da100b4e0e7ff247e4000df783a0083fd000031" \
	"fc12637509e40a4efd3f7e0ca1007e74e3ff280d4b006457320069010600310c" \
	"3b637509beff40fd00c00ca1006297e5ffb60092ff879035001003000031d789" \
	"6375092f0146fd00840da1005ca388ff1efb3d009020a1ffb601010031d77a63" \
	"75090e0a4ffd000e0da1001f90e8ff6b1726003448f5ff210102003120676375" \
	"09540a5dfd00cd0ca100bdf1110095ecd2ff119dc9ff64fffeff31a431637509" \
	"881252fd00a60ca100b2293b002beb8affc4407900a0fe030031045f637509c5" \
	"095cfd00950da1008fba1300f8de79005ea70e00df020000319310637509770c" \
	"57fd007e0ca1000ace8eff02d1b5ffc0683500c0000400316e06637509fd0d39" \
	"fd001a0ca10010d86500d6a7fbfffadb2700af01ffff318f61637509b4094efd" \
	"004d0da10052b3e8ffcb7fd7ffd144e3ff0b000200313f336375094e1e50fd00" \
	"640da1009f466400953090ff41844800af02010031b994637509fffa47fd00a4" \
	"0ca100a3ceb5ff3de02e0070dc80ff2f000500314d69637509050343fd00fa0c" \
	"a1003c03e4ffef4c2f00f90a3700b601ffff31d85a6375096ff631fd00940da1" \
	"0095e7e0ff0a2b1d00669814007afeffff315875637509150655fd00fa0ca100" \
	"a6f50e0039a02400b228cfff0000000031f903637509760c60fd005c0ca100d6" \
	"4ab9ff214deeff56ce7800e9fd030031a21d637509120c60fd004d0da100d6a2" \
	"12006eb872001c75c5ffbdfe0200319443637509c0fb48fd00330da100fbdfb9" \
	"ffa6a0a3ff0df54d0003010400319758637509c30758fd00760ca100484dbbff" \
	"77062700bb2c2d0068ff010031ec4c6375096d115dfd00d30da1001f4d8fff77" \
	"69afffcf34e4ff60000600000000000000000000000000000000000000000000" \
	"000000000000000000000000000031ec805575092fc11bff01fbe7ca002466fc" \
	"ff8e5dbfff8ef3b2ff0000000031ab785575093ac82fff010eeeca007bb44300" \
	"6e11c1ffefca6700fbff000031947a5575093caa4cff101dedca003f0d88ff31" \
	"13c1ff7d21210001000000000000000000000000000000000000000000000000" \
	"0000000000000000000000000000000000000000000000000000000000000000" \
	"000000000000000000316802557509800061000149ebca00db8befff6d179aff" \
	"061bdbff00000000312d025575096000670010f5ebca003f4952006e6933002b" \
	"09c5ff0000000000000000000000000000000000000000000000000000000000" \
	"0000000000000000000000000000000000000000000000000000000000000000" \
	"00000000000000000000000000000000000000000000000000000000000000"
#define FACTORY_ALMANAC_CHECKSUM_V3 \
	"dc3231a3ec39743f7aa8f8a87a91acad7a75b71824d209b6592cff7ef16306af"

#endif /* FACTORY_ALMANAC_V3_H_ */
```

## src/mcc_location_table.h
```c
/*
 * ORIGEM: copia de arquivo do SDK — nao e codigo do curso.
 *   SDK     : nRF Connect SDK v3.4.0
 *   Upstream: nrf/samples/cellular/gnss/src/mcc_location_table.h
 *   Local   : C:/ncs/v3.4.0/nrf/samples/cellular/gnss/src/mcc_location_table.h
 *   Copiado : 2026-09-08 — curso nrf-manaus-2, modulo gnss/01_gnss_basic
 *
 * Para conferir se divergiu do SDK:
 *   diff <este arquivo> C:/ncs/v3.4.0/nrf/samples/cellular/gnss/src/mcc_location_table.h
 *
 * DIVERGENCIA DO CURSO: nenhuma.
 */

/*
 * Copyright (c) 2021 Nordic Semiconductor ASA
 *
 * SPDX-License-Identifier: LicenseRef-Nordic-5-Clause
 */

#ifndef MCC_LOCATION_TABLE_H_
#define MCC_LOCATION_TABLE_H_

struct __attribute__ ((__packed__)) mcc_table {
	uint8_t confidence;    /* percentage, 0-100 */
	uint8_t unc_semiminor; /* scaled, see GNSS interface for details */
	uint8_t unc_semimajor; /* scaled, see GNSS interface for details */
	uint8_t orientation;   /* orientation angle between the major axis and north */
	float lat;
	float lon;
	uint16_t mcc;
};

/**
 * @brief Finds location information for a given Mobile Country Code (MCC).
 *
 * @param mcc[in] MCC to look for.
 *
 * @return Location information for the matching MCC, NULL if no entry was found.
 */
const struct mcc_table *mcc_lookup(uint16_t mcc);

/**
 * @brief Converts a latitude in degrees to the integer representation used by GNSS.
 *
 * @param lat[in] Latitude in degrees.
 *
 * @return Latitude in scaled integer representation.
 */
int32_t lat_convert(float lat);

/**
 * @brief Converts a longitude in degrees to the integer representation used by GNSS.
 *
 * @param lon[in] Longitude in degrees.
 *
 * @return Longitude in scaled integer representation.
 */
int32_t lon_convert(float lon);

#endif /* MCC_LOCATION_TABLE_H_ */
```
