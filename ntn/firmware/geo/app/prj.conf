## CMakeLists.txt
```
#
# Copyright (c) 2024 Nordic Semiconductor ASA
#
# SPDX-License-Identifier: LicenseRef-Nordic-5-Clause
#

cmake_minimum_required(VERSION 3.20.0)

find_package(Zephyr REQUIRED HINTS $ENV{ZEPHYR_BASE})
project("Asset Tracker Template")

# Include files that are common for all modules
target_include_directories(app PRIVATE src/common)

zephyr_include_directories(config)

# Flash copy of the log: volume mount and on/off switch, see overlay-log-flash.conf
target_sources_ifdef(CONFIG_LOG_BACKEND_FS app PRIVATE src/log_flash.c)

if(CONFIG_APP_NTN_MODE)
	add_subdirectory(src/modules/ntn)
	add_subdirectory(src/modules/button)
else()
# Add main application source
target_sources(app PRIVATE src/main.c)

# Module source folders
add_subdirectory(src/modules/network)
add_subdirectory(src/modules/button)
add_subdirectory(src/cbor)

# Optional modules
add_subdirectory_ifdef(CONFIG_APP_POWER src/modules/power)
add_subdirectory_ifdef(CONFIG_APP_ENVIRONMENTAL src/modules/environmental)
add_subdirectory_ifdef(CONFIG_APP_LED src/modules/led)
add_subdirectory_ifdef(CONFIG_APP_LOCATION src/modules/location)
add_subdirectory_ifdef(CONFIG_APP_CLOUD src/modules/cloud)
add_subdirectory_ifdef(CONFIG_APP_FOTA src/modules/fota)
add_subdirectory_ifdef(CONFIG_APP_STORAGE src/modules/storage)
endif()
```

## sysbuild.conf
```
#
# Copyright (c) 2026 Nordic Semiconductor
#
# SPDX-License-Identifier: LicenseRef-Nordic-5-Clause
#

# NCS v3.4.0 marks SB_CONFIG_PARTITION_MANAGER as deprecated and gives it no
# default, so it resolves to n and sysbuild then expects the s0_partition and
# s1_partition DTS labels that this branch does not define. Keep the Partition
# Manager until this branch is migrated to the DTS partition scheme.
SB_CONFIG_PARTITION_MANAGER=y

# Gera merged_<board>.hex no build dir (o hex que vai para a pasta hex/ do curso)
SB_CONFIG_MERGED_HEX_FILES=y
```

## prj.conf
```kconfig
#
# Copyright (c) 2024 Nordic Semiconductor ASA
#
# SPDX-License-Identifier: LicenseRef-Nordic-5-Clause
#

CONFIG_NCS_APPLICATION_BOOT_BANNER_STRING="Asset Tracker Template"
CONFIG_NCS_SAMPLES_DEFAULTS=y
CONFIG_RESET_ON_FATAL_ERROR=y
CONFIG_LOG_MODE_DEFERRED=y
CONFIG_LOG_BUFFER_SIZE=4096
CONFIG_LOG_PROCESS_THREAD_STACK_SIZE=1280
CONFIG_DK_LIBRARY=y
CONFIG_ZVFS_OPEN_MAX=10
CONFIG_PWM=y

# TFM logging over uart0
CONFIG_TFM_LOG_LEVEL_SILENCE=n
CONFIG_TFM_SECURE_UART0=y
CONFIG_TFM_SECURE_UART_SHARE_INSTANCE=y
CONFIG_TFM_EXCEPTION_INFO_DUMP=y
CONFIG_TFM_SPM_LOG_LEVEL_DEBUG=y

# Heap and stacks
CONFIG_MAIN_STACK_SIZE=2560
# Extended AT host/monitor stack/heap sizes since some nrf_cloud credentials are longer than 1024 bytes.
CONFIG_AT_MONITOR_HEAP_SIZE=2176
CONFIG_HEAP_MEM_POOL_SIZE=12288
CONFIG_HEAP_MEM_POOL_IGNORE_MIN=y
CONFIG_SYSTEM_WORKQUEUE_STACK_SIZE=4098

# Enable Networking and Connection Manager.
CONFIG_NETWORKING=y
CONFIG_NET_SOCKETS=y
CONFIG_NET_SOCKETS_OFFLOAD=y
CONFIG_POSIX_API=y

# Enable LTE Connectivity using Connection Manager
CONFIG_NET_IPV4=y
# Disable ipv6 for NTN usecase
CONFIG_NET_IPV6=n
CONFIG_NET_IPV6_NBR_CACHE=n
CONFIG_NET_IPV6_MLD=n
# The modem is not a Zephyr network interface here. The NTN module owns the
# radio and uses offloaded sockets directly, and the cloud module that wanted
# the connection manager is not built in this mode. Left on, the interface
# layer is a second owner of the radio: on mfw_nrf9151-ntn its ipv4_addr_add
# fails, AUTO_DOWN takes the interface down, and DOWN_DEFAULT_LTE_DISCONNECT
# then deactivates LTE about 300 ms after the attach. The LEO line runs
# without any of this.
CONFIG_NET_CONNECTION_MANAGER=n
CONFIG_NRF_MODEM_LIB_NET_IF=n

# Enable Link Controller modules
# Explicit: the network interface layer used to pull this in as a dependency,
# and it is off now.
CONFIG_LTE_LINK_CONTROL=y
CONFIG_LTE_LC_PDN_MODULE=y
CONFIG_LTE_LC_CELLULAR_PROFILE_MODULE=y
CONFIG_LTE_LC_PSM_MODULE=y
CONFIG_LTE_LC_EDRX_MODULE=y
CONFIG_LTE_LC_CONN_EVAL_MODULE=y
CONFIG_LTE_LC_PERIODIC_SEARCH_MODULE=y


# Enable PSM (Power Saving Mode)
CONFIG_LTE_LC_WORKQUEUE_STACK_SIZE=768
CONFIG_LTE_PSM_REQ=y
CONFIG_LTE_PROPRIETARY_PSM_REQ=y
CONFIG_LTE_PSM_REQ_FORMAT_SECONDS=y
# Set Requested TAU to a large value. If the network does not support this value,
# it will typically use the largest supported value. This value should be larger
# than the default update interval (1 hour).
CONFIG_LTE_PSM_REQ_RPTAU_SECONDS=7200

# Set the PSM Requested Active Time to a low number. Since we are constantly polling for
# downlink data, there is no need for prolonged active paging after the RRC connection release.
CONFIG_LTE_PSM_REQ_RAT_SECONDS=6

# Enable eDRX (Extended Discontinuous Reception)
CONFIG_LTE_EDRX_REQ=y
# "0000" is 5.12 s
CONFIG_LTE_EDRX_REQ_VALUE_LTE_M="0000"
CONFIG_LTE_EDRX_REQ_VALUE_NBIOT="0000"

# NTN library
CONFIG_NTN=y

# Modem library
CONFIG_NRF_MODEM_LIB=y

# AT commands interface
CONFIG_UART_INTERRUPT_DRIVEN=y
CONFIG_SHELL=y
CONFIG_SHELL_WILDCARD=n
CONFIG_SHELL_STACK_SIZE=4098
CONFIG_SHELL_CMD_BUFF_SIZE=2048
CONFIG_SHELL_BACKEND_SERIAL_RX_RING_BUFFER_SIZE=2048
CONFIG_AT_SHELL=y
CONFIG_LTE_SHELL=n

# nRF Cloud
CONFIG_NRF_CLOUD=y
CONFIG_NRF_CLOUD_COAP=y
CONFIG_NRF_CLOUD_COAP_MAX_RETRIES=3
CONFIG_NRF_CLOUD_COAP_DISCONNECT_ON_FAILED_REQUEST=y
CONFIG_MODEM_JWT=y
CONFIG_NRF_CLOUD_PRINT_DETAILS=n

# On initial connection to the cloud, add info sections to the shadow
CONFIG_MODEM_INFO=y
CONFIG_MODEM_INFO_ADD_DEVICE=y
CONFIG_NRF_CLOUD_SEND_DEVICE_STATUS=y
CONFIG_NRF_CLOUD_SEND_DEVICE_STATUS_NETWORK=y
CONFIG_NRF_CLOUD_SEND_DEVICE_STATUS_SIM=y
CONFIG_NRF_CLOUD_SEND_SERVICE_INFO_FOTA=y

# MCUBOOT - Needed by FOTA
CONFIG_BOOTLOADER_MCUBOOT=y
CONFIG_IMG_MANAGER=y
CONFIG_MCUBOOT_IMG_MANAGER=y
CONFIG_STREAM_FLASH_ERASE=y

# Date Time lib - Used by PGPS and main application
CONFIG_DATE_TIME=y
CONFIG_DATE_TIME_THREAD_STACK_SIZE=1024

CONFIG_SETTINGS=y
CONFIG_SETTINGS_FCB=y
CONFIG_FCB=y

# Downloader - used by FOTAS
CONFIG_DOWNLOADER=y
CONFIG_DOWNLOADER_STACK_SIZE=1664

# Flash - Used by FOTA
CONFIG_FLASH=y
CONFIG_FLASH_PAGE_LAYOUT=y
CONFIG_FLASH_MAP=y
CONFIG_STREAM_FLASH=y
CONFIG_MPU_ALLOW_FLASH_WRITE=y
# Removed in NCS v3.4.0; assigning them aborts the build, since Kconfig
# warnings are fatal for the app image on this branch.
#CONFIG_NRF_CLOUD_LOG_DIRECT=n
#CONFIG_NRF_CLOUD_LOG_OUTPUT_LEVEL=3
CONFIG_NRF_CLOUD_FOTA_POLL=y
CONFIG_NRF_CLOUD_FOTA_POLL_LOG_LEVEL_DBG=y
CONFIG_NRF_CLOUD_FOTA_FULL_MODEM_UPDATE=y
CONFIG_NRF_CLOUD_FOTA_DOWNLOAD_FRAGMENT_SIZE=1900
CONFIG_NRF_CLOUD_COAP_DOWNLOADS=y
CONFIG_FOTA_DOWNLOAD=y
CONFIG_FOTA_DOWNLOAD_PROGRESS_EVT=y
CONFIG_FOTA_DL_TIMEOUT_MIN=60
CONFIG_FOTA_SOCKET_RETRIES=5
CONFIG_DFU_TARGET=y

# Credentials
CONFIG_NRF_CLOUD_CLIENT_ID_SRC_INTERNAL_UUID=y
CONFIG_NRF_CLOUD_CHECK_CREDENTIALS=y
CONFIG_NRF_CLOUD_CREDENTIALS_MGMT_MODEM=y

# COAP client
# Disable CoAP client retransmissions to rely on nRF Cloud CoAP transport layer retries
# (CONFIG_NRF_CLOUD_COAP_MAX_RETRIES). Multiple retransmission layers scales poorly.
CONFIG_COAP_MAX_RETRANSMIT=1
CONFIG_COAP_INIT_ACK_TIMEOUT_MS=5000
# Set CoAP therad to same priority as other modules
CONFIG_COAP_CLIENT_THREAD_PRIORITY=14
CONFIG_COAP_CLIENT_BLOCK_SIZE=1024
CONFIG_COAP_CLIENT_MESSAGE_SIZE=1024
CONFIG_COAP_CLIENT_STACK_SIZE=1280
CONFIG_COAP_EXTENDED_OPTIONS_LEN_VALUE=192

# Needed for processing floats
CONFIG_PICOLIBC=y
CONFIG_FPU=y

# Zbus
CONFIG_ZBUS=y
CONFIG_ZBUS_MSG_SUBSCRIBER=y
CONFIG_ZBUS_MSG_SUBSCRIBER_NET_BUF_POOL_SIZE=64
CONFIG_ZBUS_CHANNEL_NAME=y

# Zephyr State Machine Framework
CONFIG_SMF=y
CONFIG_SMF_ANCESTOR_SUPPORT=y
CONFIG_SMF_INITIAL_TRANSITION=y

# Location
CONFIG_LOCATION=y
CONFIG_LOCATION_DATA_DETAILS=y
CONFIG_LOCATION_METHOD_GNSS=y
CONFIG_LOCATION_METHOD_CELLULAR=y
CONFIG_LOCATION_SERVICE_EXTERNAL=y
CONFIG_LOCATION_REQUEST_DEFAULT_GNSS_TIMEOUT=60000
CONFIG_LOCATION_REQUEST_DEFAULT_CELLULAR_TIMEOUT=30000
CONFIG_LOCATION_REQUEST_DEFAULT_TIMEOUT=120000
CONFIG_LOCATION_REQUEST_DEFAULT_CELLULAR_CELL_COUNT=3
CONFIG_LOCATION_REQUEST_DEFAULT_GNSS_VISIBILITY_DETECTION=y
CONFIG_LTE_NETWORK_MODE_LTE_M_NBIOT_GPS=y
CONFIG_NRF_CLOUD_AGNSS=y

# Not for LTE throughput testing
CONFIG_NRF_MODEM_LIB_SHMEM_TX_SIZE=4096
CONFIG_NRF_MODEM_LIB_SHMEM_RX_SIZE=4096

# For nRF9160 the default is socket interface
CONFIG_NET_DEFAULT_IF_ETHERNET=y
CONFIG_MBEDTLS=n

# Networking
CONFIG_NET_L2_ETHERNET=y
CONFIG_NET_NATIVE=y
CONFIG_NET_IPV4=y
CONFIG_NET_DHCPV4=y
CONFIG_NET_STATISTICS=y
CONFIG_NET_STATISTICS_USER_API=y
CONFIG_NET_CONTEXT_SYNC_RECV=y

# Memory configurations
CONFIG_NET_BUF_RX_COUNT=8
CONFIG_NET_BUF_TX_COUNT=8
CONFIG_NET_PKT_RX_COUNT=1
CONFIG_NET_PKT_TX_COUNT=1
CONFIG_NET_TX_STACK_SIZE=512
CONFIG_NET_RX_STACK_SIZE=512
CONFIG_NET_TC_TX_COUNT=1
CONFIG_NET_MAX_CONTEXTS=5
CONFIG_NET_MGMT_EVENT_STACK_SIZE=1280

# Needed due to using connectivity manager
CONFIG_NET_IF_MAX_IPV4_COUNT=2

# For debugging purposes
CONFIG_THREAD_NAME=y

# Extra Logging
CONFIG_APP_FOTA_LOG_LEVEL_DBG=y
CONFIG_APP_LOCATION_LOG_LEVEL_DBG=y
CONFIG_APP_CLOUD_LOG_LEVEL_DBG=y
CONFIG_APP_NETWORK_LOG_LEVEL_DBG=y
CONFIG_APP_LOG_LEVEL_DBG=y

# Task Watchdog
CONFIG_TASK_WDT=y
CONFIG_TASK_WDT_CHANNELS=8
CONFIG_TASK_WDT_MIN_TIMEOUT=10000

# Device power management
CONFIG_PM_DEVICE=y
CONFIG_PM_DEVICE_SHELL=y

# nRF Cloud Provisioning
CONFIG_MODEM_ATTEST_TOKEN=y
CONFIG_NRF_PROVISIONING=y
CONFIG_NRF_PROVISIONING_LOG_LEVEL_DBG=y
CONFIG_NRF_PROVISIONING_CBOR_RECORDS=5
CONFIG_NRF_PROVISIONING_COAP=y
CONFIG_NRF_PROVISIONING_CODEC=y
CONFIG_NRF_PROVISIONING_CBOR=y
CONFIG_NRF_PROVISIONING_WITH_CERT=y
CONFIG_NRF_PROVISIONING_RX_BUF_SZ=4096
CONFIG_NRF_PROVISIONING_TX_BUF_SZ=4096
CONFIG_NRF_PROVISIONING_CODEC_AT_CMD_LEN=2048
CONFIG_NRF_PROVISIONING_CODEC_RX_SZ_START=2048

# NTN config
CONFIG_APP_NTN_MODE=y
CONFIG_APP_NTN_SERVER_ADDR="64.181.168.22"
CONFIG_APP_NTN_SERVER_PORT=5005
# Payload in the world.thingy.rocks CSV format, the same the LEO line sends:
# imei, delay, rsrp, band, ue mode, operator, position, accuracy, elevation
# and temperature. It is what the public dashboard renders.
CONFIG_APP_NTN_THINGY_ROCKS_ENDPOINT=y

# Button-driven operation. The kit attempts on its own at power-on and retries
# on a timer, button 1 skips the wait, button 2 sends again over a link that is
# held open, button 4 starts a new fix. The state machine reports on the four
# DK LEDs.
CONFIG_APP_NTN_AUTO_CONNECT=n
CONFIG_APP_NTN_STAY_CONNECTED=y
CONFIG_APP_NTN_NATIVE_SEARCH=y
CONFIG_APP_NTN_STATUS_LEDS=y
CONFIG_APP_NTN_LOG_LEVEL_DBG=y
CONFIG_APP_NTN_TIMER_TIMEOUT_MINUTES=15
CONFIG_APP_NTN_BANDLOCK_ENABLE=n
CONFIG_LTE_LC_PDN_LEGACY_PCO=y

# Debug
CONFIG_LTE_LINK_CONTROL_LOG_LEVEL_DBG=y

# Modem trace
CONFIG_NRF_MODEM_LIB_TRACE=y
CONFIG_NRF_MODEM_LIB_TRACE_BACKEND_UART=y
CONFIG_SERIAL=y
CONFIG_UART_ASYNC_API=y
CONFIG_UART_1_ASYNC=y
CONFIG_UART_1_INTERRUPT_DRIVEN=n
CONFIG_PM_DEVICE=y
```

## overlay-log-flash.conf
```kconfig
#
# Copyright (c) 2026 Nordic Semiconductor ASA
#
# SPDX-License-Identifier: LicenseRef-Nordic-5-Clause
#

# Mirror the application log to the external flash.
#
# Zephyr's file-system log backend writes every log line it would send to the
# console into a ring of files under CONFIG_LOG_BACKEND_FS_DIR as well. The
# console backend stays active, so nothing changes on the serial port; the
# flash copy is there for the runs nobody was watching. The backend expects
# the directory to be a mounted volume, which src/log_flash.c takes care of
# at boot (built whenever CONFIG_LOG_BACKEND_FS is set).
#
# The copy is off by default, to spare the flash, and is switched on from the
# shell; the switch is a marker file on the volume, so it survives reboots
# and reflashes.
#
# Add with: -DEXTRA_CONF_FILE=overlay-log-flash.conf
#
# Switch:                 log_flash on   /   log_flash off   /   log_flash status
# Read back on the kit:   fs ls /lfs1   /   fs cat /lfs1/log.0000
# Wipe:                   fs rm /lfs1/log.0000 (per file)
# From the host:          scripts/log_flash_pull.py --port COMx
# Details:                docs/common/flash_log.md
#
# Changing the partition size reformats the volume on the next boot; the
# files are lost. A reflash of the application does not touch them.

# LittleFS on a Partition Manager partition in the external flash. Enabling
# LittleFS is what makes the Partition Manager define littlefs_storage; the
# region and size options place it and size it.
CONFIG_FILE_SYSTEM=y
CONFIG_FILE_SYSTEM_LITTLEFS=y
CONFIG_PM_PARTITION_REGION_LITTLEFS_EXTERNAL=y
CONFIG_PM_PARTITION_SIZE_LITTLEFS=0x1000000

# LittleFS uses the flash erase page as its block. The SPI NOR driver reports
# 64 KiB pages by default, which would waste most of the partition on files
# far smaller than that; the part erases 4 KiB sectors just fine.
CONFIG_SPI_NOR_FLASH_LAYOUT_PAGE_SIZE=4096

# Files of 64 KiB, 200 of them, oldest dropped when the ring is full: about
# 12 MiB of history. At debug level with the GNSS searching that is close to
# 1 KiB/s, so a few hours; at INF it is weeks. A new boot keeps appending to
# the newest file, so one file can span two sessions; the timestamp
# restarting from zero marks the boundary.
CONFIG_LOG_BACKEND_FS=y
CONFIG_LOG_BACKEND_FS_DIR="/lfs1"
CONFIG_LOG_BACKEND_FS_FILE_SIZE=65536
CONFIG_LOG_BACKEND_FS_FILES_LIMIT=200
CONFIG_LOG_BACKEND_FS_OVERWRITE=y

# Not started by the logging core: log_flash.c enables the backend itself,
# at boot when the marker file is there or on "log_flash on", and at the
# maximum level, so the flash mirrors the console. (An autostarted backend
# would come up at the runtime default, INF, and miss the debug lines.)
CONFIG_LOG_BACKEND_FS_AUTOSTART=n

# The backend writes from the log processing thread, which now runs LittleFS
# and the SPI driver on top of the formatting it already did. Flash writes are
# also slower than the UART, so give the buffer more room to absorb bursts.
CONFIG_LOG_PROCESS_THREAD_STACK_SIZE=4096
CONFIG_LOG_BUFFER_SIZE=8192
```

## overlay-ntn-skylo-eminify.conf
```kconfig
#
# Copyright (c) 2026 Nordic Semiconductor ASA
#
# SPDX-License-Identifier: LicenseRef-Nordic-5-Clause
#

# PDN configuration for eminify SIM card
CONFIG_LTE_LC_PDN_DEFAULTS_OVERRIDE=y
CONFIG_LTE_LC_PDN_DEFAULT_FAM_IPV4=y
CONFIG_LTE_LC_PDN_DEFAULT_APN="em"

# Skylo runs on band 255, not the 256 the base configuration assumes. This is
# also the band the AT-command bring-up left as a permanent %XBANDLOCK on the
# test kit, and runtime and permanent masks are ANDed: any other band here
# would make the lock command fail before the attach even starts.
CONFIG_APP_NTN_BANDLOCK_ENABLE=y
CONFIG_APP_NTN_BANDLOCK=255
```

## overlay-tn-catm1.conf
```kconfig
#
# Copyright (c) 2026 Nordic Semiconductor ASA
#
# SPDX-License-Identifier: LicenseRef-Nordic-5-Clause
#
# TN validation build for the button-driven application.
#
# Same state machine, socket, payload and send acknowledgement path as the NTN
# field build, attached over Cat-M1 with an ordinary SIM so that everything but
# the satellite link can be exercised indoors. The difference is confined to
# the modem steps that only exist on the NTN modem firmware, gated in ntn.c by
# APP_NTN_LINK_TN.
#
#   Push-Location C:/ncs/v3.4.0
#   C:/ncs/tools/nrfutil.exe toolchain-manager launch --ncs-version v3.4.0 -- `
#     west build --build-dir C:/work/bgeo C:/work/geo/app `
#       --pristine --board nrf9151dk/nrf9151/ns -- `
#       "-DEXTRA_CONF_FILE=overlay-tn-catm1.conf"
#   Pop-Location

CONFIG_APP_NTN_LINK_TN=y

# The kit carries mfw_nrf9151-ntn. Only set APP_NTN_MODEM_FW_TN on a kit with
# the terrestrial modem firmware; it skips every NTN-firmware step, which is
# exactly what this build is meant to exercise.

# The NTN band lock has no meaning on a terrestrial cell.
CONFIG_APP_NTN_BANDLOCK_ENABLE=n

# The buttons are physical and the LEDs are visual. These two make the
# application drivable and observable by an automated run, and they belong only
# in this build.
CONFIG_APP_NTN_BUTTON_INJECT_SHELL=y
CONFIG_APP_NTN_STATUS_LEDS_TRACE=y

# Debug level, so the GNSS fix reports the satellites it sees. Verbose, but
# being able to watch a fix come together is worth more than a tidy log while
# this is being brought up.
CONFIG_APP_NTN_LOG_LEVEL_DBG=y

# Ten minutes to find a fix rather than three. On the bench the kit sits under
# a roof, so cold starts under a poor sky are the norm.
CONFIG_APP_NTN_GNSS_FIX_RETRY_SECONDS=600
```

## src/log_flash.c
```c
/*
 * Copyright (c) 2026 Nordic Semiconductor ASA
 *
 * SPDX-License-Identifier: LicenseRef-Nordic-5-Clause
 */

/* The flash copy of the log: its volume, the switch, and the shell commands
 * that operate it without exposing the file system.
 *
 * The file-system log backend (CONFIG_LOG_BACKEND_FS) only opens files under
 * CONFIG_LOG_BACKEND_FS_DIR; it never mounts anything. This mounts a LittleFS
 * volume on the Partition Manager's littlefs_storage partition at that path,
 * early enough that the boot messages still in the log buffer land in flash
 * too.
 *
 * Writing every log line wears the flash, so the copy is off by default and
 * only runs when a marker file exists on the volume. The marker survives
 * reboots and reflashes, which is the point: switch it on before a field run
 * with "log_flash on", off again afterwards with "log_flash off".
 *
 * The "log_flash" shell command also lists, dumps and erases the files, adds
 * a marker line to the log and sets the level of the flash copy alone (also
 * persisted on the volume). See
 * docs/common/flash_log.md. Built only with CONFIG_LOG_BACKEND_FS, see
 * overlay-log-flash.conf.
 */

#include <stdlib.h>
#include <string.h>
#include <zephyr/kernel.h>
#include <zephyr/init.h>
#include <zephyr/fs/fs.h>
#include <zephyr/fs/littlefs.h>
#include <zephyr/storage/flash_map.h>
#include <zephyr/logging/log.h>
#include <zephyr/logging/log_ctrl.h>
#include <zephyr/shell/shell.h>
#include <zephyr/sys/reboot.h>

LOG_MODULE_REGISTER(log_flash, CONFIG_LOG_DEFAULT_LEVEL);

#define MARKER_FILE CONFIG_LOG_BACKEND_FS_DIR "/enabled"
#define LEVEL_FILE CONFIG_LOG_BACKEND_FS_DIR "/level"
#define LOG_PREFIX CONFIG_LOG_BACKEND_FS_FILE_PREFIX
#define LOG_PREFIX_LEN (sizeof(LOG_PREFIX) - 1)

FS_LITTLEFS_DECLARE_DEFAULT_CONFIG(log_lfs_config);

static struct fs_mount_t log_lfs_mnt = {
	.type = FS_LITTLEFS,
	.fs_data = &log_lfs_config,
	.storage_dev = (void *)PARTITION_ID(littlefs_storage),
	.mnt_point = CONFIG_LOG_BACKEND_FS_DIR,
};

static bool mounted;
/* Once enabled, the backend holds its newest file open for the rest of the
 * boot; disabling does not close it. Deleting that file under it would send
 * the writes that follow to blocks nothing references, so "erase" reboots.
 */
static bool started_this_boot;
/* Level of the flash copy alone; the console keeps its own. Persisted in
 * LEVEL_FILE as a single digit, independently of the on/off marker, so a
 * kit set to INF for a long run stays at INF through reboots.
 */
static uint8_t flash_level = CONFIG_LOG_MAX_LEVEL;

static const struct log_backend *fs_backend(void)
{
	return log_backend_get_by_name("log_backend_fs");
}

static bool marker_present(void)
{
	struct fs_dirent entry;

	return fs_stat(MARKER_FILE, &entry) == 0;
}

static const char *level_name(uint8_t level)
{
	static const char *const names[] = { "none", "err", "wrn", "inf", "dbg" };

	return level < ARRAY_SIZE(names) ? names[level] : "?";
}

static void level_load(void)
{
	struct fs_file_t file;
	char digit;

	fs_file_t_init(&file);
	if (fs_open(&file, LEVEL_FILE, FS_O_READ) != 0) {
		return;
	}

	if (fs_read(&file, &digit, 1) == 1 && digit >= '1' && digit <= '4') {
		flash_level = digit - '0';
	}

	(void)fs_close(&file);
}

static int level_store(void)
{
	struct fs_file_t file;
	char digit = '0' + flash_level;
	int err;

	fs_file_t_init(&file);
	err = fs_open(&file, LEVEL_FILE, FS_O_CREATE | FS_O_WRITE | FS_O_TRUNC);
	if (err) {
		return err;
	}

	err = fs_write(&file, &digit, 1);
	(void)fs_close(&file);

	return err == 1 ? 0 : (err < 0 ? err : -EIO);
}

static void level_apply(const struct log_backend *backend)
{
	uint32_t count = log_src_cnt_get(Z_LOG_LOCAL_DOMAIN_ID);

	for (uint32_t i = 0; i < count; i++) {
		(void)log_filter_set(backend, Z_LOG_LOCAL_DOMAIN_ID, i, flash_level);
	}
}

static int copy_start(void)
{
	const struct log_backend *backend = fs_backend();

	if (backend == NULL) {
		return -ENODEV;
	}

	if (!log_backend_is_active(backend)) {
		log_backend_enable(backend, NULL, CONFIG_LOG_MAX_LEVEL);
		started_this_boot = true;
	}

	level_apply(backend);

	return 0;
}

static void copy_stop(void)
{
	const struct log_backend *backend = fs_backend();

	if (backend != NULL && log_backend_is_active(backend)) {
		log_backend_disable(backend);
	}
}

static bool copy_active(void)
{
	const struct log_backend *backend = fs_backend();

	return backend != NULL && log_backend_is_active(backend);
}

static int log_flash_init(void)
{
	struct fs_statvfs stat;
	int err;

	/* A blank partition is formatted on the first mount. */
	err = fs_mount(&log_lfs_mnt);
	if (err) {
		LOG_ERR("Log volume mount failed: %d, no flash log this run", err);
		return 0;
	}

	mounted = true;
	level_load();

	err = fs_statvfs(log_lfs_mnt.mnt_point, &stat);
	if (err == 0) {
		LOG_INF("Log volume at %s: %lu KiB free of %lu KiB",
			log_lfs_mnt.mnt_point,
			(unsigned long)(stat.f_bfree * stat.f_frsize / 1024),
			(unsigned long)(stat.f_blocks * stat.f_frsize / 1024));
	}

	if (marker_present()) {
		(void)copy_start();
		LOG_INF("Flash log enabled, level %s", level_name(flash_level));
	} else {
		LOG_INF("Flash log disabled, enable with: log_flash on");
	}

	return 0;
}

/* After the file system types are registered (POST_KERNEL), before any module
 * starts logging in earnest.
 */
SYS_INIT(log_flash_init, APPLICATION, 0);

#if defined(CONFIG_SHELL)

/* The log files, oldest first. The backend numbers them in order of creation
 * and only ever creates a higher number, so the numbers sort them.
 */
struct log_file {
	int num;
	size_t size;
};

static int log_file_num(const struct fs_dirent *entry)
{
	if (entry->type != FS_DIR_ENTRY_FILE ||
	    strncmp(entry->name, LOG_PREFIX, LOG_PREFIX_LEN) != 0) {
		return -1;
	}

	return atoi(entry->name + LOG_PREFIX_LEN);
}

static int cmp_log_file(const void *a, const void *b)
{
	return ((const struct log_file *)a)->num - ((const struct log_file *)b)->num;
}

/* Fill files[] with what is on the volume, sorted; returns the count. */
static int log_files_get(struct log_file *files, int max)
{
	struct fs_dir_t dir;
	struct fs_dirent entry;
	int count = 0;
	int err;

	fs_dir_t_init(&dir);
	err = fs_opendir(&dir, CONFIG_LOG_BACKEND_FS_DIR);
	if (err) {
		return err;
	}

	while (count < max && fs_readdir(&dir, &entry) == 0 && entry.name[0] != '\0') {
		int num = log_file_num(&entry);

		if (num < 0) {
			continue;
		}

		files[count].num = num;
		files[count].size = entry.size;
		count++;
	}

	(void)fs_closedir(&dir);

	qsort(files, count, sizeof(files[0]), cmp_log_file);

	return count;
}

static void log_file_path(char *buf, size_t len, int num)
{
	snprintf(buf, len, "%s/%s%04d", CONFIG_LOG_BACKEND_FS_DIR, LOG_PREFIX, num);
}

/* Print a file to the shell as is. Returns the bytes printed, or an error. */
static int dump_file(const struct shell *sh, int num)
{
	char path[64];
	char buf[257];
	struct fs_file_t file;
	int total = 0;
	int err;

	log_file_path(path, sizeof(path), num);

	fs_file_t_init(&file);
	err = fs_open(&file, path, FS_O_READ);
	if (err) {
		return err;
	}

	while (true) {
		ssize_t n = fs_read(&file, buf, sizeof(buf) - 1);

		if (n < 0) {
			err = n;
			break;
		}
		if (n == 0) {
			break;
		}

		buf[n] = '\0';
		shell_fprintf(sh, SHELL_NORMAL, "%s", buf);
		total += n;
	}

	(void)fs_close(&file);

	return err ? err : total;
}

static int cmd_on(const struct shell *sh, size_t argc, char **argv)
{
	struct fs_file_t file;
	int err;

	if (!mounted) {
		shell_error(sh, "log volume is not mounted");
		return -ENODEV;
	}

	fs_file_t_init(&file);
	err = fs_open(&file, MARKER_FILE, FS_O_CREATE | FS_O_WRITE);
	if (err) {
		shell_error(sh, "cannot create %s: %d", MARKER_FILE, err);
		return err;
	}
	(void)fs_close(&file);

	err = copy_start();
	if (err) {
		shell_error(sh, "cannot enable the backend: %d", err);
		return err;
	}

	shell_print(sh, "flash log on, stays on across reboots");

	return 0;
}

static int cmd_off(const struct shell *sh, size_t argc, char **argv)
{
	int err;

	copy_stop();

	if (!mounted) {
		return 0;
	}

	err = fs_unlink(MARKER_FILE);
	if (err && err != -ENOENT) {
		shell_error(sh, "cannot remove %s: %d", MARKER_FILE, err);
		return err;
	}

	shell_print(sh, "flash log off, the files are kept");

	return 0;
}

static int cmd_status(const struct shell *sh, size_t argc, char **argv)
{
	struct fs_statvfs stat;

	shell_print(sh, "volume: %s", mounted ? "mounted" : "not mounted");
	shell_print(sh, "flash log: %s", copy_active() ? "on" : "off");
	shell_print(sh, "level: %s", level_name(flash_level));
	shell_print(sh, "file in use: %s", started_this_boot ? "yes" : "no");

	if (mounted && fs_statvfs(log_lfs_mnt.mnt_point, &stat) == 0) {
		shell_print(sh, "space: %lu KiB free of %lu KiB",
			    (unsigned long)(stat.f_bfree * stat.f_frsize / 1024),
			    (unsigned long)(stat.f_blocks * stat.f_frsize / 1024));
	}

	return 0;
}

static int cmd_ls(const struct shell *sh, size_t argc, char **argv)
{
	struct log_file files[CONFIG_LOG_BACKEND_FS_FILES_LIMIT];
	size_t total = 0;
	int count;

	if (!mounted) {
		shell_error(sh, "log volume is not mounted");
		return -ENODEV;
	}

	count = log_files_get(files, ARRAY_SIZE(files));
	if (count < 0) {
		shell_error(sh, "cannot read the volume: %d", count);
		return count;
	}

	for (int i = 0; i < count; i++) {
		bool in_use = started_this_boot && (i == count - 1);

		shell_print(sh, "%8u  %s%04d%s", (unsigned int)files[i].size, LOG_PREFIX,
			    files[i].num, in_use ? "  (in use)" : "");
		total += files[i].size;
	}

	shell_print(sh, "%d files, %u bytes", count, (unsigned int)total);

	return 0;
}

static int cmd_dump(const struct shell *sh, size_t argc, char **argv)
{
	struct log_file files[CONFIG_LOG_BACKEND_FS_FILES_LIMIT];
	size_t total = 0;
	int only = -1;
	int count;

	if (!mounted) {
		shell_error(sh, "log volume is not mounted");
		return -ENODEV;
	}

	if (argc > 1) {
		only = atoi(argv[1]);
	}

	count = log_files_get(files, ARRAY_SIZE(files));
	if (count < 0) {
		shell_error(sh, "cannot read the volume: %d", count);
		return count;
	}

	if (only >= 0) {
		int i;

		for (i = 0; i < count; i++) {
			if (files[i].num == only) {
				files[0] = files[i];
				break;
			}
		}
		if (i == count) {
			shell_error(sh, "no %s%04d", LOG_PREFIX, only);
			return -ENOENT;
		}
		count = 1;
	}

	for (int i = 0; i < count; i++) {
		total += files[i].size;
	}

	/* The markers let the host tell the dump apart from whatever else the
	 * console carried, and check that nothing was lost on the way.
	 */
	shell_print(sh, "===== DUMP BEGIN %d files %u bytes =====", count, (unsigned int)total);

	for (int i = 0; i < count; i++) {
		bool in_use = started_this_boot && only < 0 && (i == count - 1);
		int n;

		shell_print(sh, "===== %s%04d (%u bytes)%s =====", LOG_PREFIX, files[i].num,
			    (unsigned int)files[i].size, in_use ? " in use" : "");

		n = dump_file(sh, files[i].num);
		if (n < 0) {
			shell_print(sh, "===== read error %d =====", n);
		}
	}

	shell_print(sh, "===== DUMP END %d files %u bytes =====", count, (unsigned int)total);

	return 0;
}

static int cmd_erase(const struct shell *sh, size_t argc, char **argv)
{
	struct log_file files[CONFIG_LOG_BACKEND_FS_FILES_LIMIT];
	char path[64];
	int count;

	if (!mounted) {
		shell_error(sh, "log volume is not mounted");
		return -ENODEV;
	}

	/* Stop the writes first; the reboot below takes care of the file the
	 * backend may still hold open. The on/off marker is left alone.
	 */
	copy_stop();

	count = log_files_get(files, ARRAY_SIZE(files));
	if (count < 0) {
		shell_error(sh, "cannot read the volume: %d", count);
		return count;
	}

	for (int i = 0; i < count; i++) {
		int err;

		log_file_path(path, sizeof(path), files[i].num);
		err = fs_unlink(path);
		if (err) {
			shell_error(sh, "cannot remove %s: %d", path, err);
		}
	}

	shell_print(sh, "erased %d files, rebooting", count);
	k_sleep(K_MSEC(200));

	sys_reboot(SYS_REBOOT_COLD);

	return 0;
}

static int cmd_mark(const struct shell *sh, size_t argc, char **argv)
{
	char text[96] = "";
	size_t len = 0;

	for (size_t i = 1; i < argc; i++) {
		len += snprintf(text + len, sizeof(text) - len, "%s%s", i > 1 ? " " : "", argv[i]);
		if (len >= sizeof(text)) {
			break;
		}
	}

	LOG_INF("MARK: %s", text);
	shell_print(sh, "marked");

	return 0;
}

static int cmd_level(const struct shell *sh, size_t argc, char **argv)
{
	static const char *const names[] = { "err", "wrn", "inf", "dbg" };
	const struct log_backend *backend = fs_backend();

	for (size_t i = 0; i < ARRAY_SIZE(names); i++) {
		if (strcmp(argv[1], names[i]) != 0) {
			continue;
		}

		flash_level = LOG_LEVEL_ERR + i;
		if (backend != NULL && log_backend_is_active(backend)) {
			level_apply(backend);
		}

		if (mounted && level_store() != 0) {
			shell_warn(sh, "flash log level %s, but could not be saved", names[i]);
			return 0;
		}

		shell_print(sh, "flash log level %s, stays across reboots", names[i]);
		return 0;
	}

	shell_error(sh, "level is one of: err wrn inf dbg");

	return -EINVAL;
}

SHELL_STATIC_SUBCMD_SET_CREATE(sub_log_flash,
	SHELL_CMD(on, NULL, "Copy the log to flash, persistently", cmd_on),
	SHELL_CMD(off, NULL, "Stop copying the log to flash", cmd_off),
	SHELL_CMD(status, NULL, "State, level and space left", cmd_status),
	SHELL_CMD(ls, NULL, "List the log files", cmd_ls),
	SHELL_CMD_ARG(dump, NULL, "Print the log files, oldest first: dump [<number>]",
		      cmd_dump, 1, 1),
	SHELL_CMD(erase, NULL, "Delete every log file and reboot", cmd_erase),
	SHELL_CMD_ARG(mark, NULL, "Write a MARK line into the log: mark <text...>",
		      cmd_mark, 2, 16),
	SHELL_CMD_ARG(level, NULL, "Level of the flash copy alone, persistent: level err|wrn|inf|dbg",
		      cmd_level, 2, 0),
	SHELL_SUBCMD_SET_END
);

SHELL_CMD_REGISTER(log_flash, &sub_log_flash, "Flash copy of the log", NULL);

#endif /* CONFIG_SHELL */
```
