## CMakeLists.txt
```
cmake_minimum_required(VERSION 3.20.0)

find_package(Zephyr REQUIRED HINTS $ENV{ZEPHYR_BASE})
project(data_forwarder)

find_program(ZCBOR zcbor REQUIRED)

set(CDDL_FILE ${CMAKE_CURRENT_LIST_DIR}/cddl/data_forwarder.cddl)
set(GEN_SRC_DIR ${PROJECT_BINARY_DIR}/src)
set(GEN_INC_DIR ${PROJECT_BINARY_DIR}/include)
set(GEN_ENCODE_C ${GEN_SRC_DIR}/data_forwarder_encode.c)
set(GEN_ENCODE_H ${GEN_INC_DIR}/data_forwarder_encode.h)

file(MAKE_DIRECTORY ${GEN_SRC_DIR})
file(MAKE_DIRECTORY ${GEN_INC_DIR})

# ALTERADO PELO CURSO (nrf-manaus-2) — contorno de bug do zcbor no Windows.
#
# O upstream passa --output-c/--output-h ABSOLUTOS. O zcbor do toolchain faz
#
#     makedirs("./" + path.dirname(saida))          zcbor.py:2793
#
# o que num caminho absoluto do Windows vira "./C:" e explode com
# OSError: [WinError 123]. Resultado: o sample nao compila no Windows.
#
# Reproduzido com o sample INTOCADO do add-on (v2.3.0), direto de
# C:/ncs/sdk-edge-ai/edge-ai/samples/data_forwarder — nao e efeito da copia.
#
# Contorno: passar os caminhos RELATIVOS. O add_custom_command roda com
# working directory = CMAKE_CURRENT_BINARY_DIR = PROJECT_BINARY_DIR, que e
# exatamente a raiz de GEN_SRC_DIR/GEN_INC_DIR — entao "./src" resolve no
# mesmo lugar, e o OUTPUT segue absoluto para o ninja rastrear.
#
# Em Linux/macOS o upstream funciona; este contorno tambem.
file(RELATIVE_PATH GEN_ENCODE_C_REL ${PROJECT_BINARY_DIR} ${GEN_ENCODE_C})
file(RELATIVE_PATH GEN_ENCODE_H_REL ${PROJECT_BINARY_DIR} ${GEN_ENCODE_H})

add_custom_command(
  OUTPUT ${GEN_ENCODE_C} ${GEN_ENCODE_H}
  COMMAND ${ZCBOR} code
          -c ${CDDL_FILE}
          --output-c ${GEN_ENCODE_C_REL}
          --output-h ${GEN_ENCODE_H_REL}
          --default-max-qty ${CONFIG_DATA_FWD_PROTO_MAX_CHANNELS}
          -t envelope
          -e
  WORKING_DIRECTORY ${PROJECT_BINARY_DIR}
  DEPENDS ${CDDL_FILE}
  COMMENT "Generating CBOR encoder from ${CDDL_FILE}"
)

target_include_directories(app PRIVATE
  ${GEN_INC_DIR}
)

target_sources(app PRIVATE
  src/main.c
  src/protocol/protocol.c
  ${GEN_ENCODE_C}
)

if(CONFIG_DATA_FWD_SENSOR_BMI270)
  target_sources(app PRIVATE src/sensor/bmi270.c)
elseif(CONFIG_DATA_FWD_SENSOR_ADXL367)
  target_sources(app PRIVATE src/sensor/adxl367.c)
elseif(CONFIG_DATA_FWD_SENSOR_BME688)
  target_sources(app PRIVATE src/sensor/bme688.c)
endif()

if(CONFIG_DATA_FWD_TRANSPORT_BLE_NUS)
  target_sources(app PRIVATE src/transport/ble_nus.c)
elseif(CONFIG_DATA_FWD_TRANSPORT_UART)
  target_sources(app PRIVATE src/transport/uart.c)
endif()
```

## prj.conf
```kconfig
#
# ORIGEM: copia de arquivo do SDK — nao e codigo do curso.
#   Add-on  : Edge AI Add-on for nRF Connect SDK v2.3.0
#   Upstream: samples/data_forwarder/prj.conf
#   Local   : C:/ncs/sdk-edge-ai/edge-ai/samples/data_forwarder/prj.conf
#   Copiado : 2026-08-30 — curso nrf-manaus-2, modulo edge_ai/05_data_forwarder
#
# Para conferir se divergiu do SDK:
#   diff <este arquivo> C:/ncs/sdk-edge-ai/edge-ai/samples/data_forwarder/prj.conf
#
# DIVERGENCIA DO CURSO (unica): CONFIG_GPIO=y, no fim do arquivo, para o LED de
# estado do src/main.c (azul = anunciando, verde = enviando).
#
# O fundo de escala do BMI270 (+-2 g / +-500 dps) e alterado pelo aluno em
# src/sensor/bmi270.c (linhas 85 e 102), nao por Kconfig.
#

#
# Copyright (c) 2026 Nordic Semiconductor
#
# SPDX-License-Identifier: LicenseRef-Nordic-5-Clause
#

# Data forwarder
CONFIG_DATA_FWD_PROTO=y
CONFIG_DATA_FWD_PROTO_CRC=y
CONFIG_DATA_FWD_TRANSPORT_BLE_NUS=y
CONFIG_DATA_FWD_SENSOR_BMI270=y
CONFIG_DATA_FWD_EXTRA_SENSOR_BME688=y

# Select int32 for use with Edge AI Lab
CONFIG_DATA_FWD_PROTO_INT32_VALUES=y

# Data forwarder dependencies
CONFIG_ZCBOR=y
CONFIG_COBS=y
CONFIG_CRC=y

# Sensor dependencies
CONFIG_SENSOR=y
CONFIG_BMI270=y
CONFIG_BME680=y

# Logging and assert
CONFIG_LOG=y
CONFIG_LOG_BACKEND_RTT=y
CONFIG_USE_SEGGER_RTT=y
CONFIG_SEGGER_RTT_BUFFER_SIZE_UP=4096
CONFIG_ASSERT=y

# BLE NUS transport dependencies
CONFIG_BT=y
CONFIG_BT_PERIPHERAL=y
CONFIG_BT_DEVICE_NAME="nRF DataFwd"
CONFIG_BT_MAX_CONN=1
CONFIG_BT_NUS=y
CONFIG_BT_GATT_CLIENT=y
CONFIG_BT_L2CAP_TX_MTU=247
CONFIG_BT_BUF_ACL_RX_SIZE=251

# DIVERGENCIA DO CURSO: LED de estado no main.c (ver cabecalho de src/main.c)
CONFIG_GPIO=y
```

## src/main.c
```c
/*
 * ORIGEM: copia de arquivo do SDK — nao e codigo do curso.
 *   Add-on  : Edge AI Add-on for nRF Connect SDK v2.3.0
 *   Upstream: samples/data_forwarder/src/main.c
 *   Local   : C:/ncs/sdk-edge-ai/edge-ai/samples/data_forwarder/src/main.c
 *   Copiado : 2026-08-30 — curso nrf-manaus-2, modulo edge_ai/05_data_forwarder
 *
 * Para conferir se divergiu do SDK:
 *   diff <este arquivo> C:/ncs/sdk-edge-ai/edge-ai/samples/data_forwarder/src/main.c
 *
 * DIVERGENCIA DO CURSO: LED de estado — led_init() e led_tick(). (A outra
 *   divergencia do lab e o fundo de escala do IMU, em src/sensor/bmi270.c.)
 *   O upstream nao usa LED. Na aula a TAG roda na bateria, sem RTT, e o aluno
 *   precisa saber o que ela esta fazendo:
 *
 *     azul,  1 flash curto por segundo  -> anunciando, sem central conectado
 *     verde, piscando a 2 Hz            -> conectada e enviando amostras
 *
 *   O verde e um heartbeat do proprio laco de coleta, condicionado a haver um
 *   central conectado. Se parar de piscar, ou o laco parou (sensor) ou a
 *   conexao caiu. Requer CONFIG_GPIO=y no prj.conf.
 *
 *   Detalhe que engana: proto_send_samples() retorna 0 mesmo sem conexao —
 *   ele so enfileira; o envio real acontece numa work queue e falha la
 *   (-22, nus_mtu == 0). Por isso o estado vem de um bt_conn_cb proprio
 *   (BT_CONN_CB_DEFINE), sem tocar no transporte.
 */

/*
 * Copyright (c) 2026 Nordic Semiconductor ASA
 *
 * SPDX-License-Identifier: LicenseRef-Nordic-5-Clause
 */

#include <zephyr/drivers/gpio.h>
#include <zephyr/logging/log.h>

#include "protocol/protocol.h"
#include "sensor/data_fwd_sensor.h"
#include "transport/transport.h"

LOG_MODULE_REGISTER(data_forwarder);

/* ---- DIVERGENCIA DO CURSO: LED de estado ------------------------------- */

static const struct gpio_dt_spec led_blue = GPIO_DT_SPEC_GET(DT_NODELABEL(led1_blue), gpios);
static const struct gpio_dt_spec led_green = GPIO_DT_SPEC_GET(DT_NODELABEL(led1_green), gpios);

/* Contado em amostras: o laco roda na taxa do sensor (100 Hz). */
#define LED_ADV_PERIOD 100U /* 1 s */
#define LED_ADV_ON     5U   /* 50 ms aceso */
#define LED_TX_PERIOD  50U  /* 0,5 s -> 2 Hz */
#define LED_TX_ON      10U  /* 100 ms aceso */

#if defined(CONFIG_DATA_FWD_TRANSPORT_BLE_NUS)
#include <zephyr/bluetooth/conn.h>

static atomic_t led_link;

static void led_on_connected(struct bt_conn *conn, uint8_t err)
{
	ARG_UNUSED(conn);
	if (err == 0U) {
		atomic_set(&led_link, 1);
	}
}

static void led_on_disconnected(struct bt_conn *conn, uint8_t reason)
{
	ARG_UNUSED(conn);
	ARG_UNUSED(reason);
	atomic_set(&led_link, 0);
}

BT_CONN_CB_DEFINE(led_conn_cb) = {
	.connected = led_on_connected,
	.disconnected = led_on_disconnected,
};

static inline bool led_link_up(void)
{
	return atomic_get(&led_link) != 0;
}
#else
/* UART: nao ha "conexao"; o verde reflete so o laco. */
static inline bool led_link_up(void)
{
	return true;
}
#endif

static int led_init(void)
{
	int err;

	if (!gpio_is_ready_dt(&led_blue) || !gpio_is_ready_dt(&led_green)) {
		return -ENODEV;
	}
	err = gpio_pin_configure_dt(&led_blue, GPIO_OUTPUT_INACTIVE);
	if (err) {
		return err;
	}
	return gpio_pin_configure_dt(&led_green, GPIO_OUTPUT_INACTIVE);
}

/* Uma chamada por amostra. sending = a ultima amostra foi enviada. */
static void led_tick(bool sending)
{
	static uint32_t n;

	n++;
	if (sending) {
		gpio_pin_set_dt(&led_blue, 0);
		gpio_pin_set_dt(&led_green, (n % LED_TX_PERIOD) < LED_TX_ON);
	} else {
		gpio_pin_set_dt(&led_green, 0);
		gpio_pin_set_dt(&led_blue, (n % LED_ADV_PERIOD) < LED_ADV_ON);
	}
}

/* ------------------------------------------------------------------------ */

int main(void)
{
	int err;

	struct proto_transport transport;
	const struct proto_session_config session = {
		.rate_hz = data_fwd_sensor_frequency(),
		.channels = data_fwd_sensor_channel_count(),
		.sensor_type = data_fwd_sensor_type_id(),
		.channel_names = data_fwd_sensor_channel_names(),
#if defined(CONFIG_BT_DEVICE_NAME)
		.device_name = CONFIG_BT_DEVICE_NAME,
#else
		.device_name = "nRF DataFwd",
#endif
	};

	/* DIVERGENCIA DO CURSO: LED. Falha aqui nao impede a coleta. */
	err = led_init();
	if (err) {
		LOG_WRN("LED init failed (err %d)", err);
	}

	err = transport_init(&transport);
	if (err) {
		LOG_ERR("Transport init failed (err %d)", err);
		return err;
	}

	err = proto_init(&transport);
	if (err) {
		LOG_ERR("Protocol init failed (err %d)", err);
		return err;
	}

	err = data_fwd_sensor_init();
	if (err) {
		LOG_ERR("Sensor init failed (err %d)", err);
		return err;
	}

	err = proto_start_session(&session);
	if (err) {
		LOG_ERR("Failed to start session (err %d)", err);
		return err;
	}

	LOG_INF("Data forwarder started (sid %u)", proto_get_session_id());

	while (1) {
		proto_value_t values[CONFIG_DATA_FWD_PROTO_MAX_CHANNELS];
		size_t count;

		err = data_fwd_sensor_fetch(values, ARRAY_SIZE(values), &count);
		if (err) {
			LOG_WRN("Sample fetch failed (err %d)", err);
			led_tick(false); /* DIVERGENCIA DO CURSO */
			continue;
		}

		err = proto_send_samples(values, count);
		if (err) {
			LOG_WRN("Sample send failed (err %d)", err);
		}
		led_tick((err == 0) && led_link_up()); /* DIVERGENCIA DO CURSO */
	}

	return 0;
}
```
