## CMakeLists.txt
```
#
# 11_benchmark_npu_vs_cpu — o mesmo modelo na CPU (Neuton) e na NPU (Axon)
# (curso nrf-manaus-2; app do curso, modelos do sample da Nordic).
#
# Build (do SDK padrao, C:/ncs/v3.4.0; o add-on entra como modulo extra):
#   Axon (padrao na LM20B):
#     west build -p -b nrf54lm20dk/nrf54lm20b/cpuapp --sysbuild \
#          -d .../11_benchmark_npu_vs_cpu/build_lm20_axon .../11_benchmark_npu_vs_cpu \
#          -- -DEXTRA_ZEPHYR_MODULES=C:/ncs/sdk-edge-ai/edge-ai
#   Neuton (CPU):
#     ... -d .../build_lm20_neuton ... \
#          -- -DEXTRA_ZEPHYR_MODULES=C:/ncs/sdk-edge-ai/edge-ai \
#             -D11_benchmark_npu_vs_cpu_CONFIG_NRF_EDGEAI_CLASSIFICATION_MODEL_NEUTON=y
#

cmake_minimum_required(VERSION 3.20.0)

find_package(Zephyr REQUIRED HINTS $ENV{ZEPHYR_BASE})
project(benchmark_npu_vs_cpu)

if(CONFIG_NRF_EDGEAI_CLASSIFICATION_MODEL_AXON)
  target_sources(app PRIVATE src/nrf_edgeai_generated/Axon/nrf_edgeai_user_model.c)
  target_include_directories(app PRIVATE src/nrf_edgeai_generated/Axon)
  message(STATUS "Benchmark: modelo Axon (NPU)")
else()
  target_sources(app PRIVATE src/nrf_edgeai_generated/Neuton/nrf_edgeai_user_model.c)
  target_include_directories(app PRIVATE src/nrf_edgeai_generated/Neuton)
  message(STATUS "Benchmark: modelo Neuton (CPU)")
endif()

target_sources(app PRIVATE src/main.c src/test_vectors.c)
```

## Kconfig
```
#
# 11_benchmark_npu_vs_cpu — escolha do backend do modelo (curso nrf-manaus-2).
# Mesmos nomes de simbolo do sample nrf_edgeai/classification da Nordic.
#

menu "Benchmark NPU vs CPU"

choice NRF_EDGEAI_CLASSIFICATION_MODEL
	prompt "Backend do modelo de classificacao"
	default NRF_EDGEAI_CLASSIFICATION_MODEL_AXON if SOC_NRF54LM20B
	default NRF_EDGEAI_CLASSIFICATION_MODEL_NEUTON

config NRF_EDGEAI_CLASSIFICATION_MODEL_NEUTON
	bool "Neuton (CPU)"
	help
	  A mesma solution gerada para rodar na CPU (rede em float).

config NRF_EDGEAI_CLASSIFICATION_MODEL_AXON
	bool "Axon (NPU)"
	depends on SOC_NRF54LM20B
	select NRF_AXON
	help
	  A mesma solution compilada para a NPU (rede int8 + command buffer).

endchoice

endmenu

source "Kconfig.zephyr"
```

## prj.conf
```kconfig
#
# 11_benchmark_npu_vs_cpu (curso nrf-manaus-2). A parte de engine segue os
# prj_example.conf dos dois backends; os buffers do Axon ficam no conf de board
# (so valem quando CONFIG_NRF_AXON entra pela escolha do Kconfig).
#

# nRF Edge AI
CONFIG_NRF_EDGEAI=y
CONFIG_FPU=y

# Console e logging (desligados pelo power.conf na medicao de corrente)
CONFIG_LOG=y
CONFIG_CONSOLE=y
CONFIG_SERIAL=y
CONFIG_ASSERT=y
```

## power.conf
```kconfig
# Fragmento para a medicao de corrente com o PPK2: sem console, serial ou log
# (mesma receita do sample axon_low_power da Nordic — UART ligada contamina a
# medicao). Aplicar com:
#   -D11_benchmark_npu_vs_cpu_EXTRA_CONF_FILE=power.conf
CONFIG_SERIAL=n
CONFIG_CONSOLE=n
CONFIG_UART_CONSOLE=n
CONFIG_LOG=n
```

## boards/nrf54lm20dk_nrf54lm20b_cpuapp.conf
```kconfig
# Buffers do Axon para a variante NPU (a escolha do backend e do Kconfig;
# na variante Neuton estas linhas geram so um aviso de dependencia nao atendida)
CONFIG_NRF_AXON_INTERLAYER_BUFFER_SIZE=64
CONFIG_NRF_AXON_PSUM_BUFFER_SIZE=0
```

## boards/nrf54lm20dk_nrf54lm20b_cpuapp.overlay
```dts
/* Liga o no da NPU no devicetree (inofensivo na variante Neuton: sem
 * CONFIG_NRF_AXON o driver nem e compilado) */
&axon {
	status = "okay";
};
```

## src/main.c
```c
/*
 * 11_benchmark_npu_vs_cpu — o MESMO modelo, medido na CPU (Neuton) e na NPU (Axon).
 *
 * Codigo do curso nrf-manaus-2 (modulo edge_ai/11_benchmark_npu_vs_cpu). Os dois
 * modelos em src/nrf_edgeai_generated/{Neuton,Axon}/ vem do sample
 * nrf_edgeai/classification do Edge AI Add-on v2.3.0: a mesma solution de
 * estados de encomenda gerada nos dois backends. O CMake escolhe UM deles pelo
 * Kconfig CONFIG_NRF_EDGEAI_CLASSIFICATION_MODEL_{NEUTON,AXON} — o app nao muda
 * uma linha entre as duas variantes.
 *
 * O que o harness faz (padrao do sample axon_low_power da Nordic):
 *   - vetores embarcados (7 janelas de 50 amostras, uma por classe) — nenhum
 *     sensor: o estimulo e identico e deterministico nas duas variantes
 *   - mede so o nrf_edgeai_run_inference(), com o relogio do sistema
 *     (k_cycle_get_32 — o cycle counter da CPU congela nos estados de idle);
 *     o feed e um memcpy e fica fora da conta
 *   - roda varreduras de BENCH_SWEEPS x 7 inferencias e dorme
 *     BENCH_SLEEP_MS entre elas — no PPK2 cada rajada aparece como um degrau
 *     de corrente sobre o piso de sono
 *
 * Para a medicao de corrente, recompile com o fragmento power.conf (desliga
 * console/serial/log) e pendure o PPK2 na DK.
 */

#include <stdint.h>

#include <zephyr/kernel.h>
#include <zephyr/sys/printk.h>

#include <nrf_edgeai/nrf_edgeai.h>

#include "nrf_edgeai_user_model.h"
#include "test_vectors.h"

#define BENCH_SWEEPS	100  /* inferencias por rajada = BENCH_SWEEPS * 7 */
#define BENCH_SLEEP_MS	2000 /* sono entre rajadas (piso de corrente no PPK2) */

#if IS_ENABLED(CONFIG_NRF_EDGEAI_CLASSIFICATION_MODEL_AXON)
#define VARIANTE "Axon (NPU)"
#else
#define VARIANTE "Neuton (CPU)"
#endif

int main(void)
{
	printk("\n=== 11_benchmark: %s ===\n", VARIANTE);

	nrf_edgeai_t *p_model = nrf_edgeai_user_model();

	if (p_model == NULL || nrf_edgeai_init(p_model) != NRF_EDGEAI_ERR_SUCCESS) {
		printk("ERRO: init do modelo falhou\n");
		return 0;
	}
	printk("Modelo: solution %s, janela %u, %u classes\n",
	       nrf_edgeai_solution_id_str(p_model),
	       (unsigned int)nrf_edgeai_input_window_size(p_model),
	       (unsigned int)nrf_edgeai_model_outputs_num(p_model));

	uint32_t sweep_num = 0;

	while (true) {
		uint64_t total_ns = 0;
		uint64_t min_ns = UINT64_MAX;
		uint64_t max_ns = 0;
		uint32_t inferences = 0;
		uint32_t erros = 0;

		for (uint32_t s = 0; s < BENCH_SWEEPS; s++) {
			for (size_t w = 0; w < BENCH_NUM_WINDOWS; w++) {
				const struct bench_window *bw = &bench_windows[w];

				nrf_edgeai_err_t res = nrf_edgeai_feed_inputs(
					p_model, (void *)bw->data, BENCH_WINDOW_SIZE);

				if (res != NRF_EDGEAI_ERR_SUCCESS) {
					printk("ERRO: feed '%s' (%d)\n", bw->label, res);
					continue;
				}

				uint32_t t0 = k_cycle_get_32();

				res = nrf_edgeai_run_inference(p_model);

				uint32_t t1 = k_cycle_get_32();

				if (res != NRF_EDGEAI_ERR_SUCCESS) {
					printk("ERRO: inferencia '%s' (%d)\n", bw->label, res);
					continue;
				}

				uint64_t ns = k_cyc_to_ns_floor64((uint32_t)(t1 - t0));

				total_ns += ns;
				inferences++;
				if (ns < min_ns) {
					min_ns = ns;
				}
				if (ns > max_ns) {
					max_ns = ns;
				}

				if (p_model->decoded_output.classif.predicted_class !=
				    bw->expected_class) {
					erros++;
				}
			}
		}

		sweep_num++;
		printk("[%s] rajada %u: %u inferencias, latencia us min/med/max = "
		       "%llu / %llu / %llu, classes erradas: %u\n",
		       VARIANTE, sweep_num, inferences, min_ns / 1000,
		       (total_ns / inferences) / 1000, max_ns / 1000, erros);

		k_sleep(K_MSEC(BENCH_SLEEP_MS));
	}

	return 0;
}
```

## src/test_vectors.c
```c
/*
 * Vetores de teste do benchmark — ver test_vectors.h para a origem.
 */

#include "test_vectors.h"

static const flt32_t class_0_parcel_idle_accel_data[] = {
	1019.234877, 1018.652192, 1016.69811, 1019.901583, 1017.029378,
	1014.381015, 1016.604559, 1016.201444, 1016.23062, 1018.555051,
	1016.319548, 1017.072842, 1018.494815, 1013.635677, 1017.41575,
	1021.132362, 1018.691935, 1019.848198, 1016.620341, 1011.873442,
	1020.299764, 1018.478126, 1015.541777, 1014.450299, 1013.253033,
	1015.282387, 1016.849032, 1021.09152, 1017.657982, 1013.24848,
	1018.48856, 1013.41613, 1018.465645, 1017.460544, 1014.099637,
	1016.850408, 1016.396988, 1016.185508, 1014.927525, 1019.275502,
	1017.403871, 1016.319314, 1018.377489, 1019.466485, 1019.221851,
	1013.788435, 1015.948113, 1014.715299, 1018.539064, 1014.715299,
};

static const flt32_t class_1_parcel_shaking_accel_data[] = {
	832.512589, 1272.162323, 1263.232939, 1489.776683, 1859.176281,
	1772.024529, 1622.484949, 1421.231322, 988.9233308, 2904.564726,
	1004.390724, 961.4903516, 1569.262094, 1926.891127, 2159.370306,
	1897.586384, 1533.182266, 2626.996728, 1044.248622, 866.9409276,
	953.1315255, 970.2099379, 1587.471444, 1810.551686, 1633.204426,
	1730.792617, 2137.291854, 629.6878458, 1069.066947, 1052.676461,
	1091.051232, 1590.295378, 1840.453506, 1829.107198, 1790.32045,
	3505.788281, 1398.574137, 1089.641059, 625.6990249, 854.0307434,
	1191.972966, 1523.862829, 1490.407087, 1600.889671, 1487.519159,
	1112.465548, 1909.979213, 1078.403761, 971.6052426, 872.8287226,
};

static const flt32_t class_2_parcel_impact_accel_data[] = {
	1015.482154, 1014.753436, 1014.523099, 1012.472024, 1009.822764,
	1013.528832, 1010.94256, 1014.375469, 1010.949774, 1013.925464,
	1015.508712, 1012.451178, 968.8407378, 1393.710166, 5943.221118,
	6924.142149, 4296.249304, 3458.151271, 2119.268542, 3263.52814,
	1881.500201, 1479.332158, 1364.573158, 2317.111272, 3159.792859,
	2391.741083, 1305.986745, 1169.182085, 1079.52232, 1048.65378,
	1196.683715, 1054.96444, 1147.454278, 971.4221942, 1054.533138,
	1005.604551, 998.3117395, 1026.769424, 991.8001837, 1026.298981,
	1007.115343, 1014.293972, 1007.958389, 1009.272635, 1015.343811,
	1013.057529, 1013.781359, 1012.335122, 1011.281924, 1014.560157,
};

static const flt32_t class_3_parcel_free_fall_accel_data[] = {
	36.87388192, 32.60300207, 29.4674831, 32.69417905, 34.11116509,
	33.15887284, 33.85626394, 32.15342346, 52.59657571, 36.6853006,
	38.54968347, 35.5160419, 48.3840372, 47.2611057, 39.59571977,
	39.79519569, 47.38188498, 50.11275303, 55.69724245, 64.75752645,
	70.27411802, 68.7569314, 68.42144611, 66.124, 75.38968258,
	58.17801248, 81.70503133, 81.17282629, 74.35437106, 62.17788379,
	63.89306679, 46.27838078, 43.04231927, 39.9609133, 39.70982871,
	34.28699252, 43.81753603, 27.73132727, 27.37479921, 46.95272669,
	24.82332774, 30.18310574, 37.00201876, 44.0080229, 39.55886449,
	162.4691915, 50.70270683, 15.83370127, 75.95418619, 82.38026851,
};

static const flt32_t class_4_parcel_carrying_accel_data[] = {
	1076.406463, 1109.062753, 1161.315764, 1237.303839, 1304.16174,
	1350.922984, 1241.533046, 1058.547397, 936.9035098, 903.8836329,
	909.9999218, 969.2561481, 1018.445741, 978.245237, 898.4931508,
	820.9886822, 793.33496, 823.5297855, 861.7252695, 896.6489743,
	934.029546, 949.6519496, 934.6501455, 959.1392024, 1009.025175,
	1096.235981, 1187.678992, 1166.728833, 1151.409319, 1130.995037,
	1206.818376, 1211.209389, 1234.399883, 1316.256909, 1192.097129,
	935.7616639, 849.2381705, 855.3595664, 875.9844676, 940.2683021,
	979.1213199, 974.3049546, 894.6000374, 830.5673266, 806.1867451,
	848.9594567, 879.9365677, 904.6198895, 916.9955333, 963.7698856,
};

static const flt32_t class_5_parcel_in_car_accel_data[] = {
	1020.14299, 1172.412078, 974.2434799, 1081.052374, 936.2345817,
	1076.324048, 952.8650187, 958.4387398, 919.7921364, 945.1008577,
	1010.444803, 1048.425866, 954.5281871, 934.6416098, 1039.243636,
	983.2000815, 1106.467282, 1022.459808, 905.5254547, 1021.745856,
	1036.285954, 1061.250757, 1039.194138, 940.8242922, 1076.395069,
	1059.220609, 1131.268418, 973.8779736, 1029.466912, 1062.131636,
	1077.031533, 1055.016753, 972.2285251, 1046.442069, 993.0253833,
	1035.990238, 1008.750742, 1035.737579, 1041.367931, 1042.022619,
	960.7748412, 1037.639083, 977.0186869, 990.7190264, 1054.852976,
	979.9177917, 997.7978969, 1034.345125, 959.2851854, 1041.668807,
};

static const flt32_t class_6_parcel_placed_accel_data[] = {
	1028.084177, 1009.771942, 1023.977186, 1012.436213, 1020.685482,
	1018.459741, 1013.2669, 1402.760074, 1072.973569, 1044.170967,
	996.3176143, 1090.362426, 1024.921702, 1037.91844, 1052.900034,
	1062.920713, 1020.651183, 966.0045051, 906.5110973, 871.8735271,
	824.1462199, 799.1876862, 776.2963823, 765.3527818, 802.7631891,
	1163.179632, 1016.619697, 76.78637744, 1418.807213, 1005.875935,
	1033.329744, 1119.948199, 946.126825, 1083.038163, 949.8881454,
	1064.367743, 978.8891064, 1023.622866, 1026.007989, 1002.963002,
	1026.46044, 1008.698302, 1032.013223, 1016.890865, 1016.071373,
	1022.803209, 1009.949278, 1007.64987, 997.3304425, 1062.455154,
};

const struct bench_window bench_windows[BENCH_NUM_WINDOWS] = {
	{"idle", 0, class_0_parcel_idle_accel_data},
	{"shaking", 1, class_1_parcel_shaking_accel_data},
	{"impact", 2, class_2_parcel_impact_accel_data},
	{"free_fall", 3, class_3_parcel_free_fall_accel_data},
	{"carrying", 4, class_4_parcel_carrying_accel_data},
	{"in_car", 5, class_5_parcel_in_car_accel_data},
	{"placed", 6, class_6_parcel_placed_accel_data},
};
```

## src/test_vectors.h
```c
/*
 * Vetores de teste do benchmark: 7 janelas de magnitude de aceleracao (uma por
 * classe do modelo de estados de encomenda), 50 amostras f32 cada.
 *
 * ORIGEM: dados copiados de samples/nrf_edgeai/classification/src/main.c do
 * Edge AI Add-on v2.3.0 (capturas reais de sensor, uma sequencia por classe).
 */

#ifndef TEST_VECTORS_H_
#define TEST_VECTORS_H_

#include <stddef.h>

#include <nrf_edgeai/nrf_edgeai_ctypes.h>

#define BENCH_WINDOW_SIZE 50
#define BENCH_NUM_WINDOWS 7

struct bench_window {
	const char *label;
	int expected_class;
	const flt32_t *data; /* BENCH_WINDOW_SIZE amostras */
};

extern const struct bench_window bench_windows[BENCH_NUM_WINDOWS];

#endif /* TEST_VECTORS_H_ */
```
