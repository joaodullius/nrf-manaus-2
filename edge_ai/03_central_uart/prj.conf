## CMakeLists.txt
```
#
# Copyright (c) 2018 Nordic Semiconductor
#
# SPDX-License-Identifier: LicenseRef-Nordic-5-Clause
#
cmake_minimum_required(VERSION 3.20.0)

find_package(Zephyr REQUIRED HINTS $ENV{ZEPHYR_BASE})
project(central_uart)

# Falha cedo e com mensagem util, em vez de compilar um central que nunca conecta.
if(NOT CONFIG_LAB_TAG_ADDR_VALUE)
  message(FATAL_ERROR
    "CONFIG_LAB_TAG_ADDR_VALUE nao definido.\n"
    "Este central so conecta no tag cujo endereco BLE for informado.\n"
    "Descubra o endereco do seu tag na linha \"Identity:\" do log RTT dele e defina, "
    "por exemplo em um fragmento meu_tag.conf:\n"
    "  CONFIG_LAB_TAG_ADDR_VALUE=\"EF:12:34:56:78:9A\"\n"
    "  CONFIG_LAB_TAG_ADDR_TYPE=\"random\"\n"
    "e compile com -DEXTRA_CONF_FILE=meu_tag.conf")
endif()

# NORDIC SDK APP START
target_sources(app PRIVATE
  src/main.c
  src/leds.c
)
# NORDIC SDK APP END
```

## Kconfig
```
#
# Copyright (c) 2024 Nordic Semiconductor
#
# SPDX-License-Identifier: LicenseRef-Nordic-5-Clause
#

menu "Lab: filtro do tag (nrf-manaus-2)"

config LAB_TAG_ADDR_VALUE
	string "Endereco BLE do tag deste aluno"
	default ""
	help
	  Endereco BLE do nRF54L15-TAG em que este central deve conectar, no
	  formato "EF:12:34:56:78:9A".

	  Sem isto o central conectaria em qualquer dispositivo anunciando a NUS —
	  numa sala com varios tags, no do colega. O build falha se ficar vazio.

	  Para descobrir o endereco do seu tag: compile o 01_gesture_recognition
	  com o fragmento data_collection.conf, abra o RTT e leia a linha
	  "Identity:" impressa no boot pelo proprio Zephyr.

config LAB_TAG_ADDR_TYPE
	string "Tipo do endereco BLE do tag"
	default "random"
	help
	  "random" ou "public", conforme aparece entre parenteses na linha
	  "Identity:" do log do tag. Os tags da Nordic usam endereco random
	  estatico, entao o default costuma servir.


config LAB_BRIDGE_BINARY
	bool "Ponte binaria (para o 04_data_forwarder)"
	default n
	help
	  Repassa os bytes da NUS para a UART sem tocar em nada.

	  O sample foi escrito para texto: ele acrescenta LF quando o pedaco
	  recebido termina em CR, o que e o desejado com o CSV do
	  01_gesture_recognition em modo de coleta.

	  O 04_data_forwarder manda CBOR dentro de COBS. Ali essa injecao corrompe
	  o frame, o CRC do protocolo detecta, e o frame e descartado — a perda e
	  silenciosa e dificil de diagnosticar.

	  Ligue junto com o MTU maior: veja binary_bridge.conf.

endmenu

source "Kconfig.zephyr"

config SETTINGS
	default y

config ZMS
	default y if (SOC_FLASH_NRF_RRAM || SOC_FLASH_NRF_MRAM)

config NVS
	default y if !(SOC_FLASH_NRF_RRAM || SOC_FLASH_NRF_MRAM)
```

## prj.conf
```kconfig
#
# ORIGEM: copia de arquivo do SDK — nao e codigo do curso.
#   SDK     : nRF Connect SDK v3.4.0
#   Upstream: nrf/samples/bluetooth/central_uart/prj.conf
#   Local   : C:/ncs/v3.4.0/nrf/samples/bluetooth/central_uart/prj.conf
#   Copiado : 2026-08-30 — curso nrf-manaus-2, modulo edge_ai/03_central_uart
#
# Para conferir se divergiu do SDK:
#   diff <este arquivo> C:/ncs/v3.4.0/nrf/samples/bluetooth/central_uart/prj.conf
#
# DIVERGENCIA DO CURSO (unica): o bloco "Buffers de log" no final do arquivo.
#   O endereco do tag nao e config: o aluno digita no terminal serial no boot.
#

#
# Copyright (c) 2018 Nordic Semiconductor
#
# SPDX-License-Identifier: LicenseRef-Nordic-5-Clause
#

# Enable the UART driver
CONFIG_UART_ASYNC_API=y
CONFIG_NRFX_UARTE=y
CONFIG_SERIAL=y
CONFIG_CONSOLE=y
CONFIG_UART_CONSOLE=y

# Enable the BLE stack with GATT Client configuration
CONFIG_BT=y
CONFIG_BT_CENTRAL=y
CONFIG_BT_SMP=y
CONFIG_BT_GATT_CLIENT=y

# Enable the BLE modules from NCS
CONFIG_BT_NUS_CLIENT=y
CONFIG_BT_SCAN=y
CONFIG_BT_SCAN_FILTER_ENABLE=y
CONFIG_BT_SCAN_UUID_CNT=1
CONFIG_BT_SCAN_ADDRESS_CNT=1
CONFIG_BT_GATT_DM=y
CONFIG_HEAP_MEM_POOL_SIZE=2048

# This example requires more stack
CONFIG_SYSTEM_WORKQUEUE_STACK_SIZE=2048
# Enable bonding
CONFIG_BT_SETTINGS=y
CONFIG_FLASH=y
CONFIG_FLASH_PAGE_LAYOUT=y
CONFIG_FLASH_MAP=y

# Config logger
CONFIG_LOG=y
CONFIG_USE_SEGGER_RTT=y
CONFIG_LOG_BACKEND_RTT=y
CONFIG_LOG_BACKEND_UART=n
CONFIG_LOG_PRINTK=n

CONFIG_ASSERT=y

#
# --- Buffers de log (adicionado pelo curso, nao esta no sample) ---
#
# Os dois vem em 1024 bytes e a rajada de boot estoura ambos: verificado no hardware,
# o log do central cortava em "<inf> bt_hci_core: HCI transport: SDC" e sumiam as
# linhas seguintes — inclusive o "Filtrando pelo tag ..." que confirma qual
# endereco o central entendeu. Justamente o que o aluno precisa ver.
#
# Nao adianta mexer so no buffer do RTT: no modo deferred a mensagem morre antes,
# no ring buffer do proprio subsistema de log. Sao dois buffers.
#
# Mesma correcao aplicada no lado do tag (prj.conf do 01) e em
# C:\work\nrf-tag (tag/01-motion-adv/prj.conf).
#
CONFIG_LOG_BUFFER_SIZE=4096
CONFIG_SEGGER_RTT_BUFFER_SIZE_UP=4096
```

## binary_bridge.conf
```kconfig
#
# Fragmento do curso — ponte BINARIA, para receber o 05_data_forwarder.
#
# Uso:
#   west build ... -- -DEXTRA_CONF_FILE="meu_tag.conf;binary_bridge.conf"
#
# Sem este fragmento o 03 e uma ponte de TEXTO, para o CSV do
# 01_gesture_recognition em modo de coleta. Sao dois transportes diferentes:
#
#   texto    "<id> ax,ay,az,gx,gy,gz\r\n"     <- 01_gesture_recognition
#   binario  CBOR dentro de COBS + CRC-16     <- 05_data_forwarder
#
# 1. Repassa os bytes intactos (ver src/main.c, ble_data_received).
CONFIG_LAB_BRIDGE_BINARY=y
#
# 2. MTU. O tag do 05_data_forwarder negocia 247; sem isto o central oferece o
#    default (23) e cada notificacao carrega 20 bytes uteis. Com 6 canais int32
#    a 100 Hz isso e fragmentacao demais. Os mesmos valores que o
#    data_forwarder usa do lado do tag, e que a doc do add-on manda usar na
#    ponte (tools/data_forwarder_host/docs/ble_throughput_tuning.md).
CONFIG_BT_L2CAP_TX_MTU=247
CONFIG_BT_BUF_ACL_RX_SIZE=251
```

## meu_tag.conf
```kconfig
#
# Fragmento do aluno — endereco BLE do SEU tag.
#
# Uso:
#   west build ... -- -DEXTRA_CONF_FILE=meu_tag.conf
#
# Como descobrir o endereco: compile o 01_gesture_recognition com o fragmento
# data_collection.conf, grave no tag, abra o RTT e leia a linha "Identity:"
# impressa no boot, por exemplo:
#
#   <inf> bt_hci_core: Identity: EC:EF:40:2D:5E:46 (random)
#                                ^^^^^^^^^^^^^^^^^  ^^^^^^
#                                VALUE              TYPE
#
# Deixar vazio faz o build falhar de proposito: um central sem endereco
# conectaria no tag do colega.
#
CONFIG_LAB_TAG_ADDR_VALUE=""
CONFIG_LAB_TAG_ADDR_TYPE="random"
```

## src/main.c
```c
/*
 * ORIGEM: copia de arquivo do SDK — nao e codigo do curso.
 *   SDK     : nRF Connect SDK v3.4.0
 *   Upstream: nrf/samples/bluetooth/central_uart/src/main.c
 *   Local   : C:/ncs/v3.4.0/nrf/samples/bluetooth/central_uart/src/main.c
 *   Copiado : 2026-08-30 — curso nrf-manaus-2, modulo edge_ai/03_central_uart
 *
 * Para conferir se divergiu do SDK:
 *   diff <este arquivo> C:/ncs/v3.4.0/nrf/samples/bluetooth/central_uart/src/main.c
 *
 * DIVERGENCIA DO CURSO: read_tag_address_from_uart(), scan_start() e
 *   add_tag_address_filter().
 *   O upstream filtra por UUID da NUS em modo OR e alimenta o filtro de endereco
 *   pelos bonds. Aqui o endereco e digitado pelo aluno no terminal serial no boot
 *   e o filtro e so por endereco, em modo AND — cada aluno conecta no seu
 *   proprio tag.
 */

/*
 * Copyright (c) 2018 Nordic Semiconductor ASA
 *
 * SPDX-License-Identifier: LicenseRef-Nordic-5-Clause
 */

/** @file
 *  @brief Nordic UART Service Client sample
 */

#include <errno.h>
#include <string.h>
#include <uart_async_adapter.h>

#include <zephyr/kernel.h>
#include <zephyr/device.h>
#include <zephyr/devicetree.h>
#include <zephyr/sys/byteorder.h>
#include <zephyr/sys/printk.h>

#include <zephyr/bluetooth/bluetooth.h>
#include <zephyr/bluetooth/hci.h>
#include <zephyr/bluetooth/conn.h>
#include <zephyr/bluetooth/uuid.h>
#include <zephyr/bluetooth/gatt.h>

#include <bluetooth/services/nus.h>
#include <bluetooth/services/nus_client.h>
#include <bluetooth/gatt_dm.h>
#include <bluetooth/scan.h>

#include <zephyr/settings/settings.h>

#include <zephyr/drivers/uart.h>

#include <zephyr/logging/log.h>

#include "leds.h"

#define LOG_MODULE_NAME central_uart
LOG_MODULE_REGISTER(LOG_MODULE_NAME);

/* UART payload buffer element size. */
#define UART_BUF_SIZE 20

#define KEY_PASSKEY_ACCEPT DK_BTN1_MSK
#define KEY_PASSKEY_REJECT DK_BTN2_MSK

#define NUS_WRITE_TIMEOUT K_MSEC(150)
#define UART_WAIT_FOR_BUF_DELAY K_MSEC(50)
#define UART_RX_TIMEOUT 50000 /* Wait for RX complete event time in microseconds. */

#if DT_HAS_CHOSEN(nordic_nus_uart)
#define NUS_UART_NODE DT_CHOSEN(nordic_nus_uart)
#elif DT_HAS_CHOSEN(zephyr_shell_uart)
#define NUS_UART_NODE DT_CHOSEN(zephyr_shell_uart)
#else
#error "No NUS UART: add chosen 'nordic,nus-uart' to devicetree (e.g. in a board overlay)."
#endif
static const struct device *uart = DEVICE_DT_GET(NUS_UART_NODE);
static struct k_work_delayable uart_work;
static struct k_work scan_work;

#ifdef CONFIG_UART_ASYNC_ADAPTER
UART_ASYNC_ADAPTER_INST_DEFINE(async_adapter);
#else
#define async_adapter NULL
#endif

K_SEM_DEFINE(nus_write_sem, 0, 1);

struct uart_data_t {
	void *fifo_reserved;
	uint8_t  data[UART_BUF_SIZE];
	uint16_t len;
};

static K_FIFO_DEFINE(fifo_uart_tx_data);
static K_FIFO_DEFINE(fifo_uart_rx_data);

static struct bt_conn *default_conn;
static struct bt_nus_client nus_client;

static void ble_data_sent(struct bt_nus_client *nus, uint8_t err,
					const uint8_t *const data, uint16_t len)
{
	ARG_UNUSED(nus);
	ARG_UNUSED(data);
	ARG_UNUSED(len);

	leds_indicate_ble_traffic();

	k_sem_give(&nus_write_sem);

	if (err) {
		LOG_WRN("ATT error code: 0x%02X", err);
	}
}

static uint8_t ble_data_received(struct bt_nus_client *nus,
						const uint8_t *data, uint16_t len)
{
	ARG_UNUSED(nus);

	int err;

	leds_indicate_ble_traffic();

	for (uint16_t pos = 0; pos != len;) {
		struct uart_data_t *tx = k_malloc(sizeof(*tx));

		if (!tx) {
			LOG_WRN("Not able to allocate UART send data buffer");
			return BT_GATT_ITER_CONTINUE;
		}

		/* Keep the last byte of TX buffer for potential LF char. */
		size_t tx_data_size = sizeof(tx->data) - 1;

		if ((len - pos) > tx_data_size) {
			tx->len = tx_data_size;
		} else {
			tx->len = (len - pos);
		}

		memcpy(tx->data, &data[pos], tx->len);

		pos += tx->len;

		/* Append the LF character when the CR character triggered
		 * transmission from the peer.
		 */
		if ((pos == len) && (data[len - 1] == '\r')) {
			tx->data[tx->len] = '\n';
			tx->len++;
		}

		err = uart_tx(uart, tx->data, tx->len, SYS_FOREVER_MS);
		if (err) {
			k_fifo_put(&fifo_uart_tx_data, tx);
		}
	}

	return BT_GATT_ITER_CONTINUE;
}

static void uart_cb(const struct device *dev, struct uart_event *evt, void *user_data)
{
	ARG_UNUSED(dev);

	static size_t aborted_len;
	struct uart_data_t *buf;
	static uint8_t *aborted_buf;
	static bool disable_req;

	switch (evt->type) {
	case UART_TX_DONE:
		LOG_DBG("UART_TX_DONE");
		if ((evt->data.tx.len == 0) ||
		    (!evt->data.tx.buf)) {
			return;
		}

		if (aborted_buf) {
			buf = CONTAINER_OF(aborted_buf, struct uart_data_t,
					   data[0]);
			aborted_buf = NULL;
			aborted_len = 0;
		} else {
			buf = CONTAINER_OF(evt->data.tx.buf,
					   struct uart_data_t,
					   data[0]);
		}

		k_free(buf);

		buf = k_fifo_get(&fifo_uart_tx_data, K_NO_WAIT);
		if (!buf) {
			return;
		}

		if (uart_tx(uart, buf->data, buf->len, SYS_FOREVER_MS)) {
			LOG_WRN("Failed to send data over UART");
		}

		break;

	case UART_RX_RDY:
		LOG_DBG("UART_RX_RDY");
		buf = CONTAINER_OF(evt->data.rx.buf, struct uart_data_t, data[0]);
		buf->len += evt->data.rx.len;

		if (disable_req) {
			return;
		}

		if ((evt->data.rx.buf[buf->len - 1] == '\n') ||
		    (evt->data.rx.buf[buf->len - 1] == '\r')) {
			disable_req = true;
			uart_rx_disable(uart);
		}

		break;

	case UART_RX_DISABLED:
		LOG_DBG("UART_RX_DISABLED");
		disable_req = false;

		buf = k_malloc(sizeof(*buf));
		if (buf) {
			buf->len = 0;
		} else {
			LOG_WRN("Not able to allocate UART receive buffer");
			k_work_reschedule(&uart_work, UART_WAIT_FOR_BUF_DELAY);
			return;
		}

		uart_rx_enable(uart, buf->data, sizeof(buf->data),
			       UART_RX_TIMEOUT);

		break;

	case UART_RX_BUF_REQUEST:
		LOG_DBG("UART_RX_BUF_REQUEST");
		buf = k_malloc(sizeof(*buf));
		if (buf) {
			buf->len = 0;
			uart_rx_buf_rsp(uart, buf->data, sizeof(buf->data));
		} else {
			LOG_WRN("Not able to allocate UART receive buffer");
		}

		break;

	case UART_RX_BUF_RELEASED:
		LOG_DBG("UART_RX_BUF_RELEASED");
		buf = CONTAINER_OF(evt->data.rx_buf.buf, struct uart_data_t,
				   data[0]);

		if (buf->len > 0) {
			k_fifo_put(&fifo_uart_rx_data, buf);
		} else {
			k_free(buf);
		}

		break;

	case UART_TX_ABORTED:
		LOG_DBG("UART_TX_ABORTED");
		if (!aborted_buf) {
			aborted_buf = (uint8_t *)evt->data.tx.buf;
		}

		aborted_len += evt->data.tx.len;
		buf = CONTAINER_OF(aborted_buf, struct uart_data_t,
				   data[0]);

		uart_tx(uart, &buf->data[aborted_len],
			buf->len - aborted_len, SYS_FOREVER_MS);

		break;

	default:
		break;
	}
}

static void uart_work_handler(struct k_work *item)
{
	struct uart_data_t *buf;

	buf = k_malloc(sizeof(*buf));
	if (buf) {
		buf->len = 0;
	} else {
		LOG_WRN("Not able to allocate UART receive buffer");
		k_work_reschedule(&uart_work, UART_WAIT_FOR_BUF_DELAY);
		return;
	}

	uart_rx_enable(uart, buf->data, sizeof(buf->data), UART_RX_TIMEOUT);
}

static int uart_init(void)
{
	int err;
	struct uart_data_t *rx;

	if (!device_is_ready(uart)) {
		LOG_ERR("UART device not ready");
		return -ENODEV;
	}

	rx = k_malloc(sizeof(*rx));
	if (rx) {
		rx->len = 0;
	} else {
		return -ENOMEM;
	}

	k_work_init_delayable(&uart_work, uart_work_handler);

	if (IS_ENABLED(CONFIG_UART_ASYNC_ADAPTER)) {
		uart_async_adapter_init(async_adapter, uart);
		uart = async_adapter;
	}

	err = uart_callback_set(uart, uart_cb, NULL);
	if (err) {
		return err;
	}

	return uart_rx_enable(uart, rx->data, sizeof(rx->data),
			      UART_RX_TIMEOUT);
}

static void discovery_complete(struct bt_gatt_dm *dm,
			       void *context)
{
	struct bt_nus_client *nus = context;
	LOG_INF("Service discovery completed");

	bt_gatt_dm_data_print(dm);

	bt_nus_handles_assign(dm, nus);
	bt_nus_subscribe_receive(nus);

	bt_gatt_dm_data_release(dm);
}

static void discovery_service_not_found(struct bt_conn *conn,
					void *context)
{
	LOG_INF("Service not found");
}

static void discovery_error(struct bt_conn *conn,
			    int err,
			    void *context)
{
	LOG_WRN("Error while discovering GATT database: (%d)", err);
}

struct bt_gatt_dm_cb discovery_cb = {
	.completed         = discovery_complete,
	.service_not_found = discovery_service_not_found,
	.error_found       = discovery_error,
};

static void gatt_discover(struct bt_conn *conn)
{
	int err;

	if (conn != default_conn) {
		return;
	}

	err = bt_gatt_dm_start(conn,
			       BT_UUID_NUS_SERVICE,
			       &discovery_cb,
			       &nus_client);
	if (err) {
		LOG_ERR("could not start the discovery procedure, error "
			"code: %d", err);
	}
}

static void exchange_func(struct bt_conn *conn, uint8_t err, struct bt_gatt_exchange_params *params)
{
	if (!err) {
		LOG_INF("MTU exchange done");
	} else {
		LOG_WRN("MTU exchange failed (err %" PRIu8 ")", err);
	}
}

static void connected(struct bt_conn *conn, uint8_t conn_err)
{
	char addr[BT_ADDR_LE_STR_LEN];
	int err;

	bt_addr_le_to_str(bt_conn_get_dst(conn), addr, sizeof(addr));

	if (conn_err) {
		LOG_INF("Failed to connect to %s, 0x%02x %s", addr, conn_err,
			bt_hci_err_to_str(conn_err));

		if (default_conn == conn) {
			bt_conn_unref(default_conn);
			default_conn = NULL;

			(void)k_work_submit(&scan_work);
		}

		return;
	}

	LOG_INF("Connected: %s", addr);

	leds_set_ble_connected(true);

	static struct bt_gatt_exchange_params exchange_params;

	exchange_params.func = exchange_func;
	err = bt_gatt_exchange_mtu(conn, &exchange_params);
	if (err) {
		LOG_WRN("MTU exchange failed (err %d)", err);
	}

	err = bt_conn_set_security(conn, BT_SECURITY_L2);
	if (err) {
		LOG_WRN("Failed to set security: %d", err);

		gatt_discover(conn);
	}

	err = bt_scan_stop();
	if (err) {
		LOG_ERR("Stop LE scan failed (err %d)", err);
	}
}

static void disconnected(struct bt_conn *conn, uint8_t reason)
{
	char addr[BT_ADDR_LE_STR_LEN];

	bt_addr_le_to_str(bt_conn_get_dst(conn), addr, sizeof(addr));

	LOG_INF("Disconnected: %s, reason 0x%02x %s", addr, reason, bt_hci_err_to_str(reason));

	if (default_conn != conn) {
		return;
	}

	leds_set_ble_connected(false);
	bt_conn_unref(default_conn);
	default_conn = NULL;

	(void)k_work_submit(&scan_work);
}

static void security_changed(struct bt_conn *conn, bt_security_t level,
			     enum bt_security_err err)
{
	char addr[BT_ADDR_LE_STR_LEN];

	bt_addr_le_to_str(bt_conn_get_dst(conn), addr, sizeof(addr));

	if (!err) {
		LOG_INF("Security changed: %s level %u", addr, level);
	} else {
		LOG_WRN("Security failed: %s level %u err %d %s", addr, level, err,
			bt_security_err_to_str(err));
	}

	gatt_discover(conn);
}

BT_CONN_CB_DEFINE(conn_callbacks) = {
	.connected = connected,
	.disconnected = disconnected,
	.security_changed = security_changed
};

static void scan_filter_match(struct bt_scan_device_info *device_info,
			      struct bt_scan_filter_match *filter_match,
			      bool connectable)
{
	char addr[BT_ADDR_LE_STR_LEN];

	bt_addr_le_to_str(device_info->recv_info->addr, addr, sizeof(addr));

	LOG_INF("Filters matched. Address: %s connectable: %d",
		addr, connectable);
}

static void scan_connecting_error(struct bt_scan_device_info *device_info)
{
	LOG_WRN("Connecting failed");
}

static void scan_connecting(struct bt_scan_device_info *device_info,
			    struct bt_conn *conn)
{
	default_conn = bt_conn_ref(conn);
}

static int nus_client_init(void)
{
	int err;
	struct bt_nus_client_init_param init = {
		.cb = {
			.received = ble_data_received,
			.sent = ble_data_sent,
		}
	};

	err = bt_nus_client_init(&nus_client, &init);
	if (err) {
		LOG_ERR("NUS Client initialization failed (err %d)", err);
		return err;
	}

	LOG_INF("NUS Client module initialized");
	return err;
}

BT_SCAN_CB_INIT(scan_cb, scan_filter_match, NULL,
		scan_connecting_error, scan_connecting);

/* ALTERADO PELO CURSO (nrf-manaus-2).
 *
 * Upstream: o filtro de endereco era alimentado pelos bonds (bt_foreach_bond) e
 * combinado com o filtro de UUID em modo OR (bt_scan_filter_enable(..., false)) —
 * ou seja, o central conectava em QUALQUER dispositivo anunciando a NUS.
 *
 * Numa sala com varios tags anunciando ao mesmo tempo isso faz o aluno conectar no
 * tag do colega. Aqui o endereco e o que o aluno digitou no terminal serial
 * (read_tag_address_from_uart) e o filtro passa a ser SO por endereco, em modo
 * AND (match_all = true).
 */
static bt_addr_le_t tag_addr;

/* Tamanho de uma linha digitada: "EC:EF:40:2D:5E:46 (random)" + CR/LF + folga. */
#define TAG_ADDR_LINE_SIZE 48
#define TAG_ADDR_PROMPT_PERIOD K_SECONDS(5)

/* Interpreta o que o aluno digitou. Aceita "EC:EF:40:2D:5E:46",
 * "EC:EF:40:2D:5E:46 random" e "EC:EF:40:2D:5E:46 (random)" — o que se copia da
 * linha "Identity:" do log do tag. Sem tipo, assume random.
 */
static int parse_tag_address(char *line, bt_addr_le_t *addr)
{
	char *value;
	char *type;
	char *save;

	value = strtok_r(line, " \t", &save);
	if (!value) {
		return -EINVAL;
	}

	type = strtok_r(NULL, " \t", &save);
	if (!type) {
		type = "random";
	} else {
		size_t n = strlen(type);

		if (n > 2 && type[0] == '(' && type[n - 1] == ')') {
			type[n - 1] = '\0';
			type++;
		}
	}

	return bt_addr_le_from_str(value, type, addr);
}

/* Pede o endereco do tag no terminal serial e so retorna com um valido.
 *
 * Roda antes do scan, entao a UART ainda nao e ponte: os pedacos que uart_cb
 * deixa em fifo_uart_rx_data sao a linha digitada. O prompt e repetido a cada
 * TAG_ADDR_PROMPT_PERIOD para quem abre o terminal depois do boot.
 */
static void read_tag_address_from_uart(bt_addr_le_t *addr)
{
	char line[TAG_ADDR_LINE_SIZE];
	size_t len = 0;
	bool prompt = true;

	for (;;) {
		struct uart_data_t *buf;

		if (prompt) {
			/* Repete tambem o que ja foi digitado, se houver. */
			line[len] = '\0';
			printk("\nEndereco BLE do tag (ex.: EC:EF:40:2D:5E:46 random): %s",
			       line);
			prompt = false;
		}

		buf = k_fifo_get(&fifo_uart_rx_data, TAG_ADDR_PROMPT_PERIOD);
		if (!buf) {
			prompt = true;
			continue;
		}

		for (size_t i = 0; i < buf->len; i++) {
			char c = buf->data[i];

			if (c == '\r' || c == '\n') {
				line[len] = '\0';

				if (len == 0) {
					/* Linha vazia (ou o LF de um CR+LF): ignora. */
				} else if (parse_tag_address(line, addr) == 0) {
					printk("\n");
					k_free(buf);
					return;
				} else {
					printk("\nEndereco invalido. Use o formato "
					       "EC:EF:40:2D:5E:46 random\n");
					prompt = true;
				}
				len = 0;
			} else if (c >= ' ' && c <= '~' && len < sizeof(line) - 1) {
				/* So ASCII imprimivel: a abertura da porta no PC pode
				 * soltar um byte de lixo, que nao deve entrar na linha.
				 */
				line[len++] = c;
				printk("%c", c);
			}
		}

		k_free(buf);
	}
}

static int add_tag_address_filter(uint8_t *filter_mode)
{
	char addr_str[BT_ADDR_LE_STR_LEN];
	int err;

	err = bt_scan_filter_add(BT_SCAN_FILTER_TYPE_ADDR, &tag_addr);
	if (err) {
		LOG_ERR("Address filter cannot be added (err %d)", err);
		return err;
	}

	*filter_mode |= BT_SCAN_ADDR_FILTER;
	bt_addr_le_to_str(&tag_addr, addr_str, sizeof(addr_str));
	LOG_INF("Filtrando pelo tag %s", addr_str);

	return 0;
}

static int scan_start(void)
{
	int err;
	uint8_t filter_mode = 0;

	err = bt_scan_stop();
	if (err) {
		LOG_ERR("Failed to stop scanning (err %d)", err);
		return err;
	}

	bt_scan_filter_remove_all();

	err = add_tag_address_filter(&filter_mode);
	if (err) {
		return err;
	}

	/* match_all = true: so conecta no endereco configurado. */
	err = bt_scan_filter_enable(filter_mode, true);
	if (err) {
		LOG_ERR("Filters cannot be turned on (err %d)", err);
		return err;
	}

	err = bt_scan_start(BT_SCAN_TYPE_SCAN_ACTIVE);
	if (err) {
		LOG_ERR("Scanning failed to start (err %d)", err);
		return err;
	}

	LOG_INF("Scan started");
	return 0;
}

static void scan_work_handler(struct k_work *item)
{
	ARG_UNUSED(item);

	(void)scan_start();
}

static void scan_init(void)
{
	struct bt_scan_init_param scan_init = {
		.connect_if_match = true,
	};

	bt_scan_init(&scan_init);
	bt_scan_cb_register(&scan_cb);

	k_work_init(&scan_work, scan_work_handler);
	LOG_INF("Scan module initialized");
}

static void auth_cancel(struct bt_conn *conn)
{
	char addr[BT_ADDR_LE_STR_LEN];

	bt_addr_le_to_str(bt_conn_get_dst(conn), addr, sizeof(addr));

	LOG_INF("Pairing cancelled: %s", addr);
}


static void pairing_complete(struct bt_conn *conn, bool bonded)
{
	char addr[BT_ADDR_LE_STR_LEN];

	bt_addr_le_to_str(bt_conn_get_dst(conn), addr, sizeof(addr));

	LOG_INF("Pairing completed: %s, bonded: %d", addr, bonded);
}


static void pairing_failed(struct bt_conn *conn, enum bt_security_err reason)
{
	char addr[BT_ADDR_LE_STR_LEN];

	bt_addr_le_to_str(bt_conn_get_dst(conn), addr, sizeof(addr));

	LOG_WRN("Pairing failed conn: %s, reason %d %s", addr, reason,
		bt_security_err_to_str(reason));
}

static struct bt_conn_auth_cb conn_auth_callbacks = {
	.cancel = auth_cancel,
};

static struct bt_conn_auth_info_cb conn_auth_info_callbacks = {
	.pairing_complete = pairing_complete,
	.pairing_failed = pairing_failed
};

int main(void)
{
	int err;

	leds_init();

	err = bt_conn_auth_cb_register(&conn_auth_callbacks);
	if (err) {
		LOG_ERR("Failed to register authorization callbacks.");
		return 0;
	}

	err = bt_conn_auth_info_cb_register(&conn_auth_info_callbacks);
	if (err) {
		printk("Failed to register authorization info callbacks.\n");
		return 0;
	}

	err = bt_enable(NULL);
	if (err) {
		LOG_ERR("Bluetooth init failed (err %d)", err);
		return 0;
	}
	LOG_INF("Bluetooth initialized");

	if (IS_ENABLED(CONFIG_SETTINGS)) {
		settings_load();
	}

	err = uart_init();
	if (err != 0) {
		LOG_ERR("uart_init failed (err %d)", err);
		return 0;
	}

	err = nus_client_init();
	if (err != 0) {
		LOG_ERR("nus_client_init failed (err %d)", err);
		return 0;
	}

	scan_init();

	/* ALTERADO PELO CURSO (nrf-manaus-2): o endereco do tag vem do terminal,
	 * digitado no boot. Depois disto a serial volta a ser so a ponte NUS<->UART,
	 * sem texto do central, para nao sujar o CSV.
	 */
	read_tag_address_from_uart(&tag_addr);
	{
		char addr_str[BT_ADDR_LE_STR_LEN];

		bt_addr_le_to_str(&tag_addr, addr_str, sizeof(addr_str));
		printk("Procurando o tag %s...\n", addr_str);
	}

	err = scan_start();
	if (err) {
		return 0;
	}

	struct uart_data_t nus_data = {
		.len = 0,
	};

	for (;;) {
		/* Wait indefinitely for data to be sent over Bluetooth */
		struct uart_data_t *buf = k_fifo_get(&fifo_uart_rx_data,
						     K_FOREVER);

		int plen = MIN(sizeof(nus_data.data) - nus_data.len, buf->len);
		int loc = 0;

		while (plen > 0) {
			memcpy(&nus_data.data[nus_data.len], &buf->data[loc], plen);
			nus_data.len += plen;
			loc += plen;
			if (nus_data.len >= sizeof(nus_data.data) ||
			   (nus_data.data[nus_data.len - 1] == '\n') ||
			   (nus_data.data[nus_data.len - 1] == '\r')) {
				err = bt_nus_client_send(&nus_client, nus_data.data, nus_data.len);
				if (err) {
					LOG_WRN("Failed to send data over BLE connection"
						"(err %d)", err);
				}

				err = k_sem_take(&nus_write_sem, NUS_WRITE_TIMEOUT);
				if (err) {
					LOG_WRN("NUS send timeout");
				}

				nus_data.len = 0;
			}

			plen = MIN(sizeof(nus_data.data), buf->len - loc);
		}

		k_free(buf);
	}
}
```
