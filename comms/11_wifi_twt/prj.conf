## CMakeLists.txt
```
#
# ORIGEM: copia de arquivo do SDK — nao e codigo do curso.
#   SDK     : nRF Connect SDK v3.4.0
#   Upstream: nrf/samples/wifi/twt/CMakeLists.txt
#   Local   : C:/ncs/v3.4.0/nrf/samples/wifi/twt/CMakeLists.txt
#   Copiado : 2026-09-06 — curso nrf-manaus-2, modulo comms/11_wifi_twt
#
# Para conferir se divergiu do SDK:
#   diff <este arquivo> C:/ncs/v3.4.0/nrf/samples/wifi/twt/CMakeLists.txt
#
# DIVERGENCIA DO CURSO: src/lab_rede.c (rede digitada no terminal e gravada
# em settings), adicionado ao target_sources.
#

#
# Copyright (c) 2023 Nordic Semiconductor ASA
#
# SPDX-License-Identifier: LicenseRef-Nordic-5-Clause
#

cmake_minimum_required(VERSION 3.20.0)

find_package(Zephyr REQUIRED HINTS $ENV{ZEPHYR_BASE})
project(nrf_wifi_twt)


target_include_directories(app PUBLIC ${ZEPHYR_BASE}/subsys/net/ip)
target_include_directories(app PRIVATE modules/traffic_gen/inc)

add_subdirectory(modules/traffic_gen)

target_sources(app PRIVATE src/main.c src/lab_rede.c)
```

## prj.conf
```kconfig
#
# ORIGEM: copia de arquivo do SDK — nao e codigo do curso.
#   SDK     : nRF Connect SDK v3.4.0
#   Upstream: nrf/samples/wifi/twt/prj.conf
#   Local   : C:/ncs/v3.4.0/nrf/samples/wifi/twt/prj.conf
#   Copiado : 2026-09-06 — curso nrf-manaus-2, modulo comms/11_wifi_twt
#
# Para conferir se divergiu do SDK:
#   diff <este arquivo> C:/ncs/v3.4.0/nrf/samples/wifi/twt/prj.conf
#
# DIVERGENCIA DO CURSO: sem credencial estatica. A rede e digitada no terminal
# no boot e gravada em settings (src/lab_rede.c); ver o bloco WIFI_CREDENTIALS.
#

#
# Copyright (c) 2023 Nordic Semiconductor ASA
#
# SPDX-License-Identifier: LicenseRef-Nordic-5-Clause
#
CONFIG_WIFI=y
CONFIG_WIFI_NRF70=y

# WPA supplicant
CONFIG_WIFI_NM_WPA_SUPPLICANT=y

# ALTERADO PELO CURSO (nrf-manaus-2): sem credencial no binario. SSID e senha
# sao digitados no terminal no primeiro boot e gravados em settings (ZMS na
# storage_partition) pela biblioteca wifi_credentials. Ver src/lab_rede.c.
CONFIG_WIFI_CREDENTIALS=y
CONFIG_WIFI_CREDENTIALS_MAX_ENTRIES=1
CONFIG_SETTINGS=y
CONFIG_FLASH=y
CONFIG_FLASH_PAGE_LAYOUT=y
CONFIG_FLASH_MAP=y
CONFIG_ZMS=y
CONFIG_SETTINGS_ZMS=y

# Networking
CONFIG_NETWORKING=y
CONFIG_NET_SOCKETS=y
CONFIG_NET_LOG=y
CONFIG_NET_IPV4=y
CONFIG_NET_UDP=y
CONFIG_NET_TCP=y
CONFIG_NET_DHCPV4=y

# Below section is the primary contributor to SRAM and is currently
# tuned for performance, but this will be revisited in the future.
CONFIG_NET_PKT_TX_COUNT=8
CONFIG_NET_PKT_RX_COUNT=16
CONFIG_NET_BUF_TX_COUNT=16
CONFIG_NET_BUF_RX_COUNT=16
CONFIG_NRF70_RX_NUM_BUFS=16
#CONFIG_SPEED_OPTIMIZATIONS=y
#CONFIG_NRF70_MAX_TX_AGGREGATION=9
#CONFIG_NRF70_MAX_TX_TOKENS=12
CONFIG_NET_TC_TX_COUNT=1

# Below configs will increase tcp connection timeout
CONFIG_NET_TCP_INIT_RETRANSMISSION_TIMEOUT=1000
CONFIG_NET_SOCKETS_CONNECT_TIMEOUT=10000
CONFIG_NET_TCP_RETRY_COUNT=10

CONFIG_NET_IF_UNICAST_IPV4_ADDR_COUNT=1
CONFIG_NET_MAX_CONTEXTS=5
CONFIG_NET_CONTEXT_SYNC_RECV=y

CONFIG_INIT_STACKS=y

CONFIG_NET_L2_ETHERNET=y

CONFIG_NET_CONFIG_SETTINGS=y
CONFIG_NET_CONFIG_INIT_TIMEOUT=0

CONFIG_ZVFS_POLL_MAX=10

# Memories
CONFIG_MAIN_STACK_SIZE=5200
CONFIG_NET_TX_STACK_SIZE=4096
CONFIG_NET_RX_STACK_SIZE=4096

# Debugging
CONFIG_STACK_SENTINEL=y
CONFIG_DEBUG_COREDUMP=y
CONFIG_DEBUG_COREDUMP_BACKEND_LOGGING=y
CONFIG_DEBUG_COREDUMP_MEMORY_DUMP_MIN=y
CONFIG_SHELL_CMDS_RESIZE=n


# Kernel options
CONFIG_ENTROPY_GENERATOR=y

# Logging
CONFIG_LOG=y
CONFIG_LOG_BUFFER_SIZE=2048
CONFIG_POSIX_TIMERS=y
CONFIG_POSIX_API=y

CONFIG_PM=y

CONFIG_NET_CONFIG_MY_IPV4_ADDR="192.168.1.99"
CONFIG_NET_CONFIG_MY_IPV4_NETMASK="255.255.255.0"
CONFIG_NET_CONFIG_MY_IPV4_GW="192.168.1.1"

# printing of scan results puts pressure on queues in new locking
# design in net_mgmt. So, use a higher timeout for a crowded
# environment.
CONFIG_NET_MGMT_EVENT_QUEUE_TIMEOUT=5000

CONFIG_TRAFFIC_GEN=y
# IPv4 address of the host running the traffic generator server
CONFIG_TRAFFIC_GEN_REMOTE_IPV4_ADDR="192.168.0.1"
```

## minha_rede.conf
```kconfig
#
# Fragmento do aluno -- a rede Wi-Fi da sala.
#
# Uso:
#   west build ... -- -D11_wifi_twt_EXTRA_CONF_FILE=minha_rede.conf
#
# Deixar vazio faz o build falhar de proposito: um kit sem credencial nao
# conecta em lugar nenhum, e o erro em tempo de build e mais barato que
# descobrir isso com o log rodando.
#
# NUNCA commite a senha real. Antes de commitar:
#   git checkout comms/11_wifi_twt/minha_rede.conf
#
CONFIG_WIFI_CREDENTIALS_STATIC_SSID=""
CONFIG_WIFI_CREDENTIALS_STATIC_PASSWORD=""
```

## src/main.c
```c
/*
 * ORIGEM: copia de arquivo do SDK — nao e codigo do curso.
 *   SDK     : nRF Connect SDK v3.4.0
 *   Upstream: nrf/samples/wifi/twt/src/main.c
 *   Local   : C:/ncs/v3.4.0/nrf/samples/wifi/twt/src/main.c
 *   Copiado : 2026-09-06 — curso nrf-manaus-2, modulo comms/11_wifi_twt
 *
 * Para conferir se divergiu do SDK:
 *   diff <este arquivo> C:/ncs/v3.4.0/nrf/samples/wifi/twt/src/main.c
 *
 * DIVERGENCIA DO CURSO: nenhuma - byte a byte igual ao SDK (conferido em
 * 2026-09-06, ignorando fim de linha).
 *
 * Copyright (c) 2023 Nordic Semiconductor ASA
 *
 * SPDX-License-Identifier: LicenseRef-Nordic-5-Clause
 */

/** @file
 * @brief WiFi TWT sample
 */

#include <zephyr/logging/log.h>
LOG_MODULE_REGISTER(twt, CONFIG_LOG_DEFAULT_LEVEL);

#if defined(CONFIG_POSIX_API)
#include <zephyr/posix/arpa/inet.h>
#include <zephyr/posix/netdb.h>
#include <zephyr/posix/unistd.h>
#include <zephyr/posix/sys/socket.h>
#endif

#include <zephyr/kernel.h>
#include <stdio.h>
#include <stdlib.h>
#include <zephyr/shell/shell.h>
#include <zephyr/sys/printk.h>
#include <zephyr/init.h>

#include <zephyr/net/net_if.h>
#include <zephyr/net/wifi_mgmt.h>
#include <zephyr/net/net_event.h>
#include <zephyr/drivers/gpio.h>


#include "net_private.h"
#include "traffic_gen.h"
#include "lab_rede.h"

#define WIFI_SHELL_MODULE "wifi"

#define WIFI_SHELL_MGMT_EVENTS (NET_EVENT_WIFI_CONNECT_RESULT |		\
				NET_EVENT_WIFI_DISCONNECT_RESULT|	\
				NET_EVENT_WIFI_TWT)

#define MAX_SSID_LEN        32
#define STATUS_POLLING_MS   300
#define TWT_RESP_TIMEOUT_S    20

struct traffic_gen_config tg_config;

static struct net_mgmt_event_callback wifi_shell_mgmt_cb;
static struct net_mgmt_event_callback net_shell_mgmt_cb;

static struct {
	const struct shell *sh;
	union {
		struct {
			uint8_t connected	: 1;
			uint8_t connect_result	: 1;
			uint8_t disconnect_requested	: 1;
			uint8_t _unused		: 5;
		};
		uint8_t all;
	};
} context;

static bool twt_supported, twt_resp_received, twt_resp_accept;
static uint32_t twt_flow_id = 1;

static bool wait_for_twt_resp_received(void)
{
	int i, timeout_polls = (TWT_RESP_TIMEOUT_S * 1000) / STATUS_POLLING_MS;

	for (i = 0; i < timeout_polls; i++) {
		k_sleep(K_MSEC(STATUS_POLLING_MS));
		if (twt_resp_received) {
			return twt_resp_accept;
		}
	}

	return false;
}

static int setup_twt(void)
{
	struct net_if *iface = net_if_get_first_wifi();
	struct wifi_twt_params params = { 0 };
	int ret;

	twt_flow_id = 1;
	params.operation = WIFI_TWT_SETUP;
	params.negotiation_type = WIFI_TWT_INDIVIDUAL;
	params.setup_cmd = WIFI_TWT_SETUP_CMD_REQUEST;
	params.dialog_token = 1;
	params.flow_id = twt_flow_id;
	params.setup.responder = 0;
	params.setup.trigger = IS_ENABLED(CONFIG_TWT_TRIGGER_ENABLE);
	params.setup.implicit = 1;
	params.setup.announce = IS_ENABLED(CONFIG_TWT_ANNOUNCED_MODE);
	params.setup.twt_wake_interval = CONFIG_TWT_WAKE_INTERVAL;
	params.setup.twt_interval = CONFIG_TWT_INTERVAL;

	ret = net_mgmt(NET_REQUEST_WIFI_TWT, iface, &params, sizeof(params));
	if (ret) {
		LOG_INF("TWT setup failed: %d", ret);
		return ret;
	}

	LOG_INF("TWT setup requested");

	return 0;
}

static int teardown_twt(void)
{
	struct net_if *iface = net_if_get_first_wifi();
	struct wifi_twt_params params = { 0 };
	int ret;

	params.operation = WIFI_TWT_TEARDOWN;
	params.negotiation_type = WIFI_TWT_INDIVIDUAL;
	params.setup_cmd = WIFI_TWT_TEARDOWN;
	params.dialog_token = 1;
	params.flow_id = twt_flow_id;

	ret = net_mgmt(NET_REQUEST_WIFI_TWT, iface, &params, sizeof(params));
	if (ret) {
		LOG_ERR("%s with %s failed, reason : %s",
			wifi_twt_operation_txt(params.operation),
			wifi_twt_negotiation_type_txt(params.negotiation_type),
			wifi_twt_get_err_code_str(params.fail_reason));
		return ret;
	}

	LOG_INF("TWT teardown success");

	return 0;
}

static int cmd_wifi_status(void)
{
	struct net_if *iface = net_if_get_default();
	struct wifi_iface_status status = { 0 };
	int ret;

	ret = net_mgmt(NET_REQUEST_WIFI_IFACE_STATUS, iface, &status,
				sizeof(struct wifi_iface_status));
	if (ret) {
		LOG_INF("Status request failed: %d\n", ret);
		return ret;
	}

	LOG_INF("==================");
	LOG_INF("State: %s", wifi_state_txt(status.state));

	if (status.state >= WIFI_STATE_ASSOCIATED) {
		uint8_t mac_string_buf[sizeof("xx:xx:xx:xx:xx:xx")];

		LOG_INF("Interface Mode: %s",
		       wifi_mode_txt(status.iface_mode));
		LOG_INF("Link Mode: %s",
		       wifi_link_mode_txt(status.link_mode));
		LOG_INF("SSID: %.32s", status.ssid);
		LOG_INF("BSSID: %s",
		       net_sprint_ll_addr_buf(
				status.bssid, WIFI_MAC_ADDR_LEN,
				mac_string_buf, sizeof(mac_string_buf)));
		LOG_INF("Band: %s", wifi_band_txt(status.band));
		LOG_INF("Channel: %d", status.channel);
		LOG_INF("Security: %s", wifi_security_txt(status.security));
		LOG_INF("MFP: %s", wifi_mfp_txt(status.mfp));
		LOG_INF("RSSI: %d", status.rssi);
		LOG_INF("TWT: %s", status.twt_capable ? "Supported" : "Not supported");

		if (status.twt_capable) {
			twt_supported = 1;
		}
	}

	return 0;
}

static void handle_wifi_connect_result(struct net_mgmt_event_callback *cb)
{
	const struct wifi_status *status =
		(const struct wifi_status *) cb->info;

	if (context.connected) {
		return;
	}

	if (status->status) {
		LOG_ERR("Connection failed (%d)", status->status);
	} else {
		LOG_INF("Connected");
		context.connected = true;
	}

	context.connect_result = true;
}

static void handle_wifi_disconnect_result(struct net_mgmt_event_callback *cb)
{
	const struct wifi_status *status =
		(const struct wifi_status *) cb->info;

	if (!context.connected) {
		return;
	}

	if (context.disconnect_requested) {
		LOG_INF("Disconnection request %s (%d)",
			 status->status ? "failed" : "done",
					status->status);
		context.disconnect_requested = false;
	} else {
		LOG_INF("Received Disconnected");
		context.connected = false;
	}

	cmd_wifi_status();
}

static void print_twt_params(uint8_t dialog_token, uint8_t flow_id,
			     enum wifi_twt_negotiation_type negotiation_type,
			     bool responder, bool implicit, bool announce,
			     bool trigger, uint32_t twt_wake_interval,
			     uint64_t twt_interval)
{
	LOG_INF("TWT Dialog token: %d",
	      dialog_token);
	LOG_INF("TWT flow ID: %d",
	      flow_id);
	LOG_INF("TWT negotiation type: %s",
	      wifi_twt_negotiation_type_txt(negotiation_type));
	LOG_INF("TWT responder: %s",
	       responder ? "true" : "false");
	LOG_INF("TWT implicit: %s",
	      implicit ? "true" : "false");
	LOG_INF("TWT announce: %s",
	      announce ? "true" : "false");
	LOG_INF("TWT trigger: %s",
	      trigger ? "true" : "false");
	LOG_INF("TWT wake interval: %d us",
	      twt_wake_interval);
	LOG_INF("TWT interval: %lld us",
	      twt_interval);
	LOG_INF("========================");
}

static void handle_wifi_twt_event(struct net_mgmt_event_callback *cb)
{
	const struct wifi_twt_params *resp =
		(const struct wifi_twt_params *)cb->info;

	if (resp->operation == WIFI_TWT_TEARDOWN) {
		if (resp->teardown_status == WIFI_TWT_TEARDOWN_SUCCESS) {
			LOG_INF("TWT teardown success received for flow ID %d\n",
				resp->flow_id);
		} else {
			LOG_INF("TWT teardown failed for flow ID %d\n",
				resp->flow_id);
		}
		return;
	}

	if (resp->resp_status == WIFI_TWT_RESP_RECEIVED) {
		LOG_INF("TWT response: %s",
		      wifi_twt_setup_cmd_txt(resp->setup_cmd));

		if (resp->setup_cmd == WIFI_TWT_SETUP_CMD_ACCEPT) {
			twt_resp_accept = true;
		}

		twt_resp_received = true;
		twt_flow_id = resp->flow_id;

		LOG_INF("== TWT negotiated parameters ==");
		print_twt_params(resp->dialog_token,
				 resp->flow_id,
				 resp->negotiation_type,
				 resp->setup.responder,
				 resp->setup.implicit,
				 resp->setup.announce,
				 resp->setup.trigger,
				 resp->setup.twt_wake_interval,
				 resp->setup.twt_interval);
	} else {
		LOG_INF("TWT response timed out\n");
	}
}

static void wifi_mgmt_event_handler(struct net_mgmt_event_callback *cb,
				     uint64_t mgmt_event, struct net_if *iface)
{
	switch (mgmt_event) {
	case NET_EVENT_WIFI_CONNECT_RESULT:
		handle_wifi_connect_result(cb);
		break;
	case NET_EVENT_WIFI_DISCONNECT_RESULT:
		handle_wifi_disconnect_result(cb);
		break;
	case NET_EVENT_WIFI_TWT:
		handle_wifi_twt_event(cb);
		break;
#ifdef CONFIG_SCHEDULED_TX
	case NET_EVENT_WIFI_TWT_SLEEP_STATE: {
		int *twt_state;

		twt_state = (int *)(cb->info);
		if (*twt_state == WIFI_TWT_STATE_SLEEP) {
			traffic_gen_pause(&tg_config);
		} else if (*twt_state == WIFI_TWT_STATE_AWAKE)  {
			traffic_gen_resume(&tg_config);
		} else {
			LOG_INF("UNKNOWN TWT STATE %d", *twt_state);
		}
	}
		break;
#endif
	default:
		break;
	}
}

static void print_dhcp_ip(struct net_mgmt_event_callback *cb)
{
	/* Get DHCP info from struct net_if_dhcpv4 and print */
	const struct net_if_dhcpv4 *dhcpv4 = cb->info;
	const struct in_addr *addr = &dhcpv4->requested_ip;
	char dhcp_info[128];

	net_addr_ntop(AF_INET, addr, dhcp_info, sizeof(dhcp_info));

	LOG_INF("DHCP IP address: %s", dhcp_info);
}

static void net_mgmt_event_handler(struct net_mgmt_event_callback *cb,
				    uint64_t mgmt_event, struct net_if *iface)
{
	switch (mgmt_event) {
	case NET_EVENT_IPV4_DHCP_BOUND:
		print_dhcp_ip(cb);
		break;
	default:
		break;
	}
}

static int wifi_connect(void)
{
	struct net_if *iface = net_if_get_first_wifi();

	context.connected = false;
	context.connect_result = false;

	if (net_mgmt(NET_REQUEST_WIFI_CONNECT_STORED, iface, NULL, 0)) {
		LOG_ERR("Connection request failed");

		return -ENOEXEC;
	}

	LOG_INF("Connection requested");

	return 0;
}

int main(void)
{
	memset(&context, 0, sizeof(context));

	/* CURSO: rede da sala digitada no terminal e gravada em settings. */
	lab_rede_ler(false, 0);

	net_mgmt_init_event_callback(&wifi_shell_mgmt_cb,
			wifi_mgmt_event_handler,
			WIFI_SHELL_MGMT_EVENTS);

	net_mgmt_add_event_callback(&wifi_shell_mgmt_cb);

	net_mgmt_init_event_callback(&net_shell_mgmt_cb,
			net_mgmt_event_handler,
			NET_EVENT_IPV4_DHCP_BOUND);

	net_mgmt_add_event_callback(&net_shell_mgmt_cb);

	LOG_INF("Starting %s with CPU frequency: %d MHz", CONFIG_BOARD, SystemCoreClock/MHZ(1));
	k_sleep(K_SECONDS(1));

	LOG_INF("Static IP address (overridable): %s/%s -> %s",
			CONFIG_NET_CONFIG_MY_IPV4_ADDR,
			CONFIG_NET_CONFIG_MY_IPV4_NETMASK,
			CONFIG_NET_CONFIG_MY_IPV4_GW);

	while (1) {
		wifi_connect();

		while (!context.connect_result) {
			cmd_wifi_status();
			k_sleep(K_MSEC(STATUS_POLLING_MS));
		}

		cmd_wifi_status();

		if (context.connected) {
			int ret;

			k_sleep(K_SECONDS(2));

			if (!twt_supported) {
				LOG_INF("AP is not TWT capable, exiting the sample\n");
				return -1;
			}

			LOG_INF("AP is TWT capable, establishing TWT");

			ret = setup_twt();
			if (ret) {
				LOG_ERR("Failed to establish TWT flow: %d\n", ret);
				return -1;
			}

			if (wait_for_twt_resp_received()) {
				LOG_INF("TWT Setup success");
			} else {
				LOG_INF("TWT Setup timed out\n");
				return -1;
			}

#ifdef CONFIG_TRAFFIC_GEN
			traffic_gen_init(&tg_config);

			ret = traffic_gen_start(&tg_config);
			if (ret < 0) {
				LOG_ERR("Failed to start traffic role ");
				goto teardown;
			}

			ret = traffic_gen_wait_for_report(&tg_config);
			if (ret < 0) {
				LOG_ERR("Failed to get traffic report ");
				goto teardown;
			}
			traffic_gen_get_report(&tg_config);
#endif /* CONFIG_TRAFFIC_GEN */

			/* Wait for few service periods before tearing down */
			k_sleep(K_USEC(5 * CONFIG_TWT_INTERVAL));

teardown:
			ret = teardown_twt();
			if (ret) {
				LOG_ERR("Failed to teardown TWT flow: %d\n", ret);
				return -1;
			}

			k_sleep(K_FOREVER);
		}
	}

	return 0;
}
```

## src/lab_rede.c
```c
/*
 * ARQUIVO DO CURSO (nrf-manaus-2) — nao existe no SDK.
 *
 * Pede a rede Wi-Fi no terminal serial (a console — uart30 na LM20-DK com a
 * EB II encaixada) e grava em settings, na storage_partition da placa. No boot
 * seguinte mostra o que tem gravado e da uma janela unica de JANELA_MS para
 * trocar; sem tecla, usa o gravado. Nao ha prompt periodico: cada campo e
 * pedido uma vez e so volta se a entrada for invalida.
 *
 * SSID e senha vao para a biblioteca wifi_credentials (backend settings), que
 * e de onde NET_REQUEST_WIFI_CONNECT_STORED le. IP e porta do servidor ficam
 * em "lab_rede/ip" e "lab_rede/porta", num handler proprio.
 *
 * Le por uart_poll_in() na console: nao precisa de UART assincrona nem de
 * shell, e convive com o printk/log que ja saem pela mesma UART.
 */

#include <errno.h>
#include <stdlib.h>
#include <string.h>

#include <zephyr/kernel.h>
#include <zephyr/device.h>
#include <zephyr/devicetree.h>
#include <zephyr/drivers/uart.h>
#include <zephyr/net/net_ip.h>
#include <zephyr/net/wifi.h>
#include <zephyr/net/wifi_credentials.h>
#include <zephyr/settings/settings.h>
#include <zephyr/sys/printk.h>

#include "lab_rede.h"

#define JANELA_MS 5000
#define POLL_MS 10
#define LINHA_MAX (WIFI_PSK_MAX_LEN + 1)

static const struct device *const console = DEVICE_DT_GET(DT_CHOSEN(zephyr_console));

static struct {
	char ssid[WIFI_SSID_MAX_LEN + 1];
	char senha[WIFI_PSK_MAX_LEN + 1]; /* vazia = rede aberta */
	char ip[NET_IPV4_ADDR_LEN];
	uint16_t porta;
	bool pede_servidor;
} atual;

/* ------------------------------------------------ settings: IP e porta */

static int rede_set(const char *name, size_t len, settings_read_cb read_cb, void *cb_arg)
{
	const char *next;
	ssize_t n;

	if (settings_name_steq(name, "ip", &next) && !next) {
		if (len >= sizeof(atual.ip)) {
			return -EINVAL;
		}
		n = read_cb(cb_arg, atual.ip, sizeof(atual.ip) - 1);
		if (n < 0) {
			return (int)n;
		}
		atual.ip[n] = '\0';
		return 0;
	}

	if (settings_name_steq(name, "porta", &next) && !next) {
		if (len != sizeof(atual.porta)) {
			return -EINVAL;
		}
		n = read_cb(cb_arg, &atual.porta, sizeof(atual.porta));
		return n < 0 ? (int)n : 0;
	}

	return -ENOENT;
}

SETTINGS_STATIC_HANDLER_DEFINE(lab_rede, "lab_rede", NULL, rede_set, NULL, NULL);

/* --------------------------------------------------- credencial gravada */

static void copia_ssid(void *arg, const char *ssid, size_t ssid_len)
{
	char *dest = arg;

	if (dest[0] == '\0' && ssid_len <= WIFI_SSID_MAX_LEN) {
		memcpy(dest, ssid, ssid_len);
		dest[ssid_len] = '\0';
	}
}

/* true se havia uma rede gravada; preenche atual.ssid e atual.senha. */
static bool carrega_credencial(void)
{
	struct wifi_credentials_personal cred;

	atual.ssid[0] = '\0';
	atual.senha[0] = '\0';

	wifi_credentials_for_each_ssid(copia_ssid, atual.ssid);
	if (atual.ssid[0] == '\0') {
		return false;
	}

	if (wifi_credentials_get_by_ssid_personal_struct(atual.ssid, strlen(atual.ssid),
							 &cred) != 0) {
		atual.ssid[0] = '\0';
		return false;
	}

	if (cred.header.type == WIFI_SECURITY_TYPE_PSK &&
	    cred.password_len <= WIFI_PSK_MAX_LEN) {
		memcpy(atual.senha, cred.password, cred.password_len);
		atual.senha[cred.password_len] = '\0';
	}
	return true;
}

static int grava(void)
{
	enum wifi_security_type tipo =
		atual.senha[0] ? WIFI_SECURITY_TYPE_PSK : WIFI_SECURITY_TYPE_NONE;
	int ret;

	/* Uma rede so (WIFI_CREDENTIALS_MAX_ENTRIES=1): a nova substitui a antiga. */
	wifi_credentials_delete_all();
	ret = wifi_credentials_set_personal(atual.ssid, strlen(atual.ssid), tipo, NULL, 0,
					    atual.senha, strlen(atual.senha), 0,
					    WIFI_CHANNEL_ANY, 0);
	if (ret) {
		return ret;
	}

	if (atual.pede_servidor) {
		ret = settings_save_one("lab_rede/ip", atual.ip, strlen(atual.ip) + 1);
		if (ret) {
			return ret;
		}
		ret = settings_save_one("lab_rede/porta", &atual.porta, sizeof(atual.porta));
	}
	return ret;
}

/* ------------------------------------------------------------- console */

/* Espera ate `ms` por uma tecla. -1 se nao veio nenhuma. */
static int espera_tecla(int ms)
{
	int64_t fim = k_uptime_get() + ms;
	unsigned char c;

	while (k_uptime_get() < fim) {
		if (uart_poll_in(console, &c) == 0) {
			return c;
		}
		k_sleep(K_MSEC(POLL_MS));
	}
	return -1;
}

/* Le uma linha da console, ecoando, ate Enter. Aceita backspace. */
static void ler_linha(char *linha, size_t tamanho)
{
	static bool ultimo_foi_cr;
	size_t len = 0;
	unsigned char c;

	for (;;) {
		if (uart_poll_in(console, &c) < 0) {
			k_sleep(K_MSEC(POLL_MS));
			continue;
		}

		if (c == '\n' && ultimo_foi_cr) {
			/* O LF de um CR+LF: ja fechou a linha no CR. */
			ultimo_foi_cr = false;
			continue;
		}
		ultimo_foi_cr = (c == '\r');

		if (c == '\r' || c == '\n') {
			linha[len] = '\0';
			printk("\n");
			return;
		}

		if (c == '\b' || c == 0x7f) {
			if (len > 0) {
				len--;
				printk("\b \b");
			}
		} else if (c >= ' ' && c <= '~' && len < tamanho - 1) {
			/* So ASCII imprimivel: a abertura da porta no PC pode soltar
			 * um byte de lixo, que nao deve entrar na linha.
			 */
			linha[len++] = c;
			printk("%c", c);
		}
	}
}

static void pede_ssid(void)
{
	char linha[LINHA_MAX];

	for (;;) {
		printk("SSID da rede: ");
		ler_linha(linha, sizeof(linha));
		if (linha[0] != '\0' && strlen(linha) <= WIFI_SSID_MAX_LEN) {
			strcpy(atual.ssid, linha);
			return;
		}
		printk("SSID tem de 1 a %d caracteres.\n", WIFI_SSID_MAX_LEN);
	}
}

static void pede_senha(void)
{
	char linha[LINHA_MAX];
	size_t n;

	for (;;) {
		printk("Senha (Enter vazio = rede aberta): ");
		ler_linha(linha, sizeof(linha));
		n = strlen(linha);
		if (n == 0 || (n >= WIFI_PSK_MIN_LEN && n <= WIFI_PSK_MAX_LEN)) {
			strcpy(atual.senha, linha);
			return;
		}
		printk("Senha WPA2 tem de %d a %d caracteres.\n", WIFI_PSK_MIN_LEN,
		       WIFI_PSK_MAX_LEN);
	}
}

static void pede_servidor(uint16_t porta_padrao)
{
	char linha[LINHA_MAX];
	struct in_addr addr;
	unsigned long porta;
	char *fim;

	for (;;) {
		printk("IP do servidor no PC (ex.: 192.168.0.100): ");
		ler_linha(linha, sizeof(linha));
		if (net_addr_pton(AF_INET, linha, &addr) == 0) {
			strcpy(atual.ip, linha);
			break;
		}
		printk("IPv4 invalido.\n");
	}

	for (;;) {
		printk("Porta do servidor (Enter = %u): ", porta_padrao);
		ler_linha(linha, sizeof(linha));
		if (linha[0] == '\0') {
			atual.porta = porta_padrao;
			return;
		}
		porta = strtoul(linha, &fim, 10);
		if (*fim == '\0' && porta >= 1 && porta <= 65535) {
			atual.porta = (uint16_t)porta;
			return;
		}
		printk("Porta tem de ser um numero de 1 a 65535.\n");
	}
}

static void mostra_gravado(void)
{
	printk("\nRede gravada: \"%s\" (%s)", atual.ssid,
	       atual.senha[0] ? "com senha" : "aberta");
	if (atual.pede_servidor) {
		printk(", servidor %s:%u", atual.ip, atual.porta);
	}
	printk("\nEnter (ou nada em %d s) usa essa; qualquer outra tecla troca: ",
	       JANELA_MS / 1000);
}

/* ------------------------------------------------------------- publico */

void lab_rede_ler(bool pede_servidor_flag, uint16_t porta_padrao)
{
	bool gravado;
	int tecla;
	int ret;

	atual.pede_servidor = pede_servidor_flag;
	atual.ip[0] = '\0';
	atual.porta = 0;

	/* A wifi_credentials ja inicializou o settings no boot; aqui so o
	 * subtree deste modulo. settings_subsys_init() e idempotente.
	 */
	settings_subsys_init();
	settings_load_subtree("lab_rede");

	gravado = carrega_credencial();
	if (pede_servidor_flag && (atual.ip[0] == '\0' || atual.porta == 0)) {
		gravado = false;
	}

	printk("\n=== Rede Wi-Fi ===\n");
	if (gravado) {
		mostra_gravado();
		tecla = espera_tecla(JANELA_MS);
		if (tecla < 0 || tecla == '\r' || tecla == '\n') {
			printk("\nUsando a rede gravada.\n");
			return;
		}
		printk("\n");
	}

	for (;;) {
		pede_ssid();
		pede_senha();
		if (pede_servidor_flag) {
			pede_servidor(porta_padrao);
		}

		ret = grava();
		if (ret == 0) {
			break;
		}
		printk("Falha ao gravar em settings (%d); tente de novo.\n", ret);
	}

	printk("Gravado. Rede \"%s\"", atual.ssid);
	if (pede_servidor_flag) {
		printk(", servidor %s:%u", atual.ip, atual.porta);
	}
	printk(".\n");
}

const char *lab_rede_ssid(void)
{
	return atual.ssid;
}

const char *lab_rede_ip(void)
{
	return atual.ip;
}

uint16_t lab_rede_porta(void)
{
	return atual.porta;
}
```
