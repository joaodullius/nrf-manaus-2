## CMakeLists.txt
```
cmake_minimum_required(VERSION 3.20.0)
find_package(Zephyr REQUIRED HINTS $ENV{ZEPHYR_BASE})
project(lab_wifi_location)

target_sources(app PRIVATE src/main.c src/lab_rede.c)
```

## Kconfig
```
#
# Codigo do curso (nrf-manaus-2).
#
menu "Lab: locationing por scan de Wi-Fi (nrf-manaus-2)"

config LAB_PORTA
	int "Porta do servidor no PC (padrao do prompt do boot)"
	default 9000
	help
	  O IP do servidor e digitado no terminal no primeiro boot e gravado em
	  settings (src/lab_rede.c); esta e a porta que o prompt propoe, e Enter
	  aceita. Porta TCP onde tools/wifi_locate.py escuta a lista de pontos de
	  acesso vinda do kit. Precisa bater com o --porta passado ao
	  wifi_locate.py.

endmenu

source "Kconfig.zephyr"
```

## sysbuild.conf
```
#
# Codigo do curso (nrf-manaus-2).
#
# Sem este arquivo o build fecha limpo e o firmware nao tem Wi-Fi: o driver do
# nRF7002 nunca e habilitado, e o log de boot diz "Nenhuma interface Wi-Fi
# encontrada". Os labs 6, 7 e 8 herdaram este arquivo dos samples do SDK; este
# lab e codigo do curso e precisa traze-lo de proposito (mesma licao do lab 9).
#
SB_CONFIG_WIFI_NRF70=y
SB_CONFIG_PARTITION_MANAGER=n

# Gera merged_<board>.hex no build dir (o hex que vai para a pasta hex/ do curso)
SB_CONFIG_MERGED_HEX_FILES=y
```

## prj.conf
```kconfig
#
# Codigo do curso (nrf-manaus-2).
#
# Base: blocos de CONFIG_WIFI*/CONFIG_NET*/DHCP de nrf/samples/wifi/sta
# (nRF Connect SDK v3.4.0), sem as credenciais de exemplo -- a rede e o
# servidor sao digitados no terminal no boot (src/lab_rede.c, como nos labs 7 e 9).
#
CONFIG_WIFI=y
CONFIG_WIFI_NRF70=y

# WPA supplicant
CONFIG_WIFI_NM_WPA_SUPPLICANT=y
CONFIG_WIFI_READY_LIB=y
CONFIG_NRF_WIFI_RPU_RECOVERY=y

# ALTERADO PELO CURSO (nrf-manaus-2): sem credencial no binario. SSID e senha
# sao digitados no terminal no primeiro boot e gravados em settings (ZMS na
# storage_partition) pela biblioteca wifi_credentials. Ver src/lab_rede.c.
CONFIG_WIFI_CREDENTIALS=y
CONFIG_WIFI_CREDENTIALS_MAX_ENTRIES=1
CONFIG_SETTINGS=y
CONFIG_FLASH=y
CONFIG_FLASH_PAGE_LAYOUT=y
CONFIG_FLASH_MAP=y
CONFIG_ZMS=y
CONFIG_SETTINGS_ZMS=y

# Networking
CONFIG_NETWORKING=y
CONFIG_NET_SOCKETS=y
CONFIG_NET_LOG=y
CONFIG_NET_IPV4=y
CONFIG_NET_UDP=y
CONFIG_NET_TCP=y
CONFIG_NET_DHCPV4=y

CONFIG_NET_PKT_RX_COUNT=16
CONFIG_NET_PKT_TX_COUNT=16
CONFIG_NRF70_RX_NUM_BUFS=16

# Below section is the primary contributor to SRAM and is currently
# tuned for performance, but this will be revisited in the future.
CONFIG_NET_BUF_RX_COUNT=16
CONFIG_NET_BUF_TX_COUNT=32
CONFIG_HEAP_MEM_POOL_SIZE=37000
CONFIG_HEAP_MEM_POOL_IGNORE_MIN=y
CONFIG_NRF_WIFI_CTRL_HEAP_SIZE=20000
CONFIG_NRF_WIFI_DATA_HEAP_SIZE=40000
CONFIG_NET_TC_TX_COUNT=1

CONFIG_NET_IF_UNICAST_IPV4_ADDR_COUNT=1
CONFIG_NET_MAX_CONTEXTS=5
CONFIG_NET_CONTEXT_SYNC_RECV=y

CONFIG_INIT_STACKS=y

CONFIG_NET_L2_ETHERNET=y
CONFIG_NET_L2_ETHERNET_MGMT=y

CONFIG_NET_CONFIG_SETTINGS=y
CONFIG_NET_CONFIG_INIT_TIMEOUT=0

CONFIG_ZVFS_POLL_MAX=10

# Memories
#
# CONFIG_MAIN_STACK_SIZE=5200, nao o padrao (4096): mesmo achado do lab 9 --
# o caminho do wpa_supplicant, logo depois da espera por
# CONFIG_WIFI_READY_LIB, e fundo o bastante para estourar uma pilha de 4096.
# E o mesmo valor que o sample wifi/sta ja usa, e pelo mesmo motivo.
CONFIG_MAIN_STACK_SIZE=5200
CONFIG_NET_TX_STACK_SIZE=4096
CONFIG_NET_RX_STACK_SIZE=4096

# Debugging
CONFIG_STACK_SENTINEL=y
CONFIG_DEBUG_COREDUMP=y
CONFIG_DEBUG_COREDUMP_BACKEND_LOGGING=y
CONFIG_DEBUG_COREDUMP_MEMORY_DUMP_MIN=y
CONFIG_SHELL_CMDS_RESIZE=n

# Kernel options
CONFIG_ENTROPY_GENERATOR=y

# Logging
CONFIG_LOG=y
CONFIG_LOG_BUFFER_SIZE=2048
CONFIG_POSIX_TIMERS=y

CONFIG_NET_CONFIG_MY_IPV4_ADDR="192.168.1.99"
CONFIG_NET_CONFIG_MY_IPV4_NETMASK="255.255.255.0"
CONFIG_NET_CONFIG_MY_IPV4_GW="192.168.1.1"

# printing of scan results puts pressure on queues in new locking
# design in net_mgmt. So, use a higher timeout for a crowded
# environment.
CONFIG_NET_MGMT_EVENT_QUEUE_TIMEOUT=5000

# Codigo do curso (nrf-manaus-2)
CONFIG_GPIO=y
# CONFIG_MAIN_STACK_SIZE fica na secao "Memories" acima, com 5200 -- mesma
# licao do lab 9, nao um valor arbitrario.
#
# Este lab nao le sensor (CONFIG_SENSOR/CONFIG_TEMP_NRF5, do lab 9, nao
# entram aqui) nem manda ponto flutuante pela rede -- so inteiros no formato
# "AP,<bssid>,<rssi>,<frequencia>,<ssid>" (ver src/main.c).
```

## minha_rede.conf
```kconfig
#
# Fragmento do aluno -- a rede Wi-Fi da sala.
#
# Uso:
#   west build ... -- -D13_wifi_location_EXTRA_CONF_FILE=minha_rede.conf
#
# Deixar vazio faz o build falhar de proposito: um kit sem credencial nao
# conecta em lugar nenhum, e o erro em tempo de build e mais barato que
# descobrir isso com o log rodando.
#
# NUNCA commite a senha real. Antes de commitar:
#   git checkout comms/13_wifi_location/minha_rede.conf
#
CONFIG_WIFI_CREDENTIALS_STATIC_SSID=""
CONFIG_WIFI_CREDENTIALS_STATIC_PASSWORD=""
```

## src/main.c
```c
/* Codigo do curso (nrf-manaus-2) -- nao vem do SDK.
 *
 * Lab 13: conecta na rede da sala (esqueleto do lab 7/9), varre os pontos de
 * acesso Wi-Fi ao redor (NET_REQUEST_WIFI_SCAN) e manda a lista para o PC por
 * um socket TCP -- uma linha "AP,<bssid>,<rssi>,<frequencia_mhz>,<ssid>" por
 * ponto de acesso, seguida de "FIM". Quem resolve a posicao e o PC
 * (tools/wifi_locate.py), consultando os Location Services (Wi-Fi) do nRF
 * Cloud: o kit nunca sabe onde esta, so enxerga vizinhos.
 *
 * Faz um scan automatico assim que a conexao fica pronta e repete a cada
 * aperto do sw0 (sw3 nao existe com o shield nesta versao do SDK -- mesma
 * nota do lab 9).
 */
#include <errno.h>
#include <stdint.h>
#include <stdio.h>
#include <string.h>

#include <zephyr/kernel.h>
#include <zephyr/device.h>
#include <zephyr/logging/log.h>
#include <zephyr/drivers/gpio.h>
#include <zephyr/net/socket.h>
#include <zephyr/net/net_if.h>
#include <zephyr/net/net_mgmt.h>
#include <zephyr/net/net_event.h>
#include <zephyr/net/wifi_mgmt.h>

#ifdef CONFIG_WIFI_READY_LIB
#include <net/wifi_ready.h>
#endif /* CONFIG_WIFI_READY_LIB */

LOG_MODULE_REGISTER(lab_wifi_location, CONFIG_LOG_DEFAULT_LEVEL);
#include "lab_rede.h"

/* sw3 nao existe com o shield nrf7002eb2 nesta versao do SDK (o overlay
 * apaga o botao e o alias): o botao do lab e o sw0, mesma nota do lab 9.
 */
#define SW0_NODE DT_ALIAS(sw0)
static const struct gpio_dt_spec botao = GPIO_DT_SPEC_GET(SW0_NODE, gpios);
static struct gpio_callback botao_cb_data;

static struct net_mgmt_event_callback wifi_cb;
static struct net_mgmt_event_callback net_cb;
static struct net_mgmt_event_callback scan_cb;

static K_SEM_DEFINE(ip_pronto, 0, 1);
static K_SEM_DEFINE(scan_pronto, 0, 1);
static K_SEM_DEFINE(scan_disparado, 0, 1);

/* Um AP capturado no scan, ja no formato textual que sai na linha para o PC
 * -- convertido dentro do callback (handler_scan_result(), abaixo), nao
 * guardado como struct wifi_scan_result crua: essa struct e valida so
 * durante o callback (o driver reaproveita o buffer logo depois).
 */
struct ap_encontrado {
	char bssid[sizeof("xx:xx:xx:xx:xx:xx")];
	int8_t rssi;
	uint16_t freq_mhz;
	char ssid[WIFI_SSID_MAX_LEN + 1];
};

/* Uma varredura real desta bancada viu 25 redes (ver o relatorio da task);
 * 32 da folga sem gastar memoria a toa. Excedentes sao descartados com
 * aviso, nao travam o scan.
 */
#define MAX_APS 32

static struct ap_encontrado aps[MAX_APS];
static size_t num_aps;
static K_MUTEX_DEFINE(aps_mutex);

/* Converte canal+banda (o que struct wifi_scan_result carrega) para
 * frequencia em MHz (o que o formato de linha deste lab manda, e o que a
 * ferramenta de PC guarda em "frequency" -- so para a lista impressa; o
 * nRF Cloud so usa macAddress/signalStrength). Formulas do proprio Zephyr,
 * so invertidas (wifi_freq_to_channel(), subsys/net/l2/wifi/wifi_shell.c).
 */
static uint16_t canal_para_freq_mhz(enum wifi_frequency_bands band, uint8_t canal)
{
	switch (band) {
	case WIFI_FREQ_BAND_2_4_GHZ:
		return (canal == 14) ? 2484 : (uint16_t)(2407 + canal * 5);
	case WIFI_FREQ_BAND_5_GHZ:
		return (uint16_t)(5000 + canal * 5);
	default:
		/* O nRF7002 e dual-band (2,4/5 GHz) e nunca emite
		 * WIFI_FREQ_BAND_6_GHZ num scan -- sem caso real para validar
		 * uma formula, essa banda fica so no default (0).
		 */
		return 0;
	}
}

static void formatar_bssid(const uint8_t *mac, uint8_t mac_len, char *saida, size_t tam)
{
	if (mac_len < 6) {
		saida[0] = '\0';
		return;
	}
	snprintf(saida, tam, "%02x:%02x:%02x:%02x:%02x:%02x",
		 mac[0], mac[1], mac[2], mac[3], mac[4], mac[5]);
}

static void handler_scan_result(struct net_mgmt_event_callback *cb)
{
	const struct wifi_scan_result *entry = (const struct wifi_scan_result *)cb->info;
	struct ap_encontrado novo = {0};
	size_t ssid_len;

	formatar_bssid(entry->mac, entry->mac_length, novo.bssid, sizeof(novo.bssid));
	novo.rssi = entry->rssi;
	novo.freq_mhz = canal_para_freq_mhz(entry->band, entry->channel);

	ssid_len = MIN(entry->ssid_length, sizeof(novo.ssid) - 1);
	memcpy(novo.ssid, entry->ssid, ssid_len);
	novo.ssid[ssid_len] = '\0';

	k_mutex_lock(&aps_mutex, K_FOREVER);
	if (num_aps < MAX_APS) {
		aps[num_aps++] = novo;
	} else {
		LOG_WRN("Descartando AP %s -- buffer de %d entradas cheio", novo.bssid, MAX_APS);
	}
	k_mutex_unlock(&aps_mutex);
}

static void handler_scan(struct net_mgmt_event_callback *cb, uint64_t evento,
			  struct net_if *iface)
{
	ARG_UNUSED(iface);

	if (evento == NET_EVENT_WIFI_SCAN_RESULT) {
		handler_scan_result(cb);
		return;
	}

	if (evento == NET_EVENT_WIFI_SCAN_DONE) {
		const struct wifi_status *status = (const struct wifi_status *)cb->info;

		if (status->status) {
			LOG_WRN("Scan terminou com erro (%d)", status->status);
		}
		k_sem_give(&scan_pronto);
	}
}

/* Pede o scan e espera terminar (via NET_EVENT_WIFI_SCAN_DONE, tratado em
 * handler_scan() acima). Zera o acumulado antes de pedir -- um scan novo
 * substitui o anterior, nunca soma em cima.
 */
static int solicitar_scan(void)
{
	struct net_if *iface = net_if_get_first_wifi();
	struct wifi_scan_params params = {0};

	if (!iface) {
		LOG_ERR("Nenhuma interface Wi-Fi encontrada");
		return -ENODEV;
	}

	k_mutex_lock(&aps_mutex, K_FOREVER);
	num_aps = 0;
	k_mutex_unlock(&aps_mutex);

	if (net_mgmt(NET_REQUEST_WIFI_SCAN, iface, &params, sizeof(params))) {
		LOG_ERR("Pedido de scan Wi-Fi falhou");
		return -EIO;
	}

	LOG_INF("Scan solicitado...");

	if (k_sem_take(&scan_pronto, K_SECONDS(30)) < 0) {
		LOG_ERR("Tempo esgotado esperando o scan terminar");
		return -ETIMEDOUT;
	}

	return 0;
}

/* Reimplementacao enxuta do padrao de socket TCP ja usado no lab 9
 * (comms/09_wifi_tcp/src/transporte.c): abre, manda, fecha -- sem conexao
 * persistente nem thread de recepcao, porque este lab so manda dados, nunca
 * recebe comando de volta. Cada scan e uma conexao nova.
 */
static int mandar_scan_para_pc(void)
{
	struct net_sockaddr_in endereco = {0};
	char linha[96];
	size_t i;
	int sock;
	int ret;

	sock = zsock_socket(NET_AF_INET, NET_SOCK_STREAM, 0);
	if (sock < 0) {
		LOG_ERR("Falha ao criar o socket (%d)", -errno);
		return -errno;
	}

	endereco.sin_family = NET_AF_INET;
	endereco.sin_port = net_htons(lab_rede_porta());

	ret = net_addr_pton(NET_AF_INET, lab_rede_ip(), &endereco.sin_addr);
	if (ret < 0) {
		LOG_ERR("IP do servidor invalido: %s", lab_rede_ip());
		zsock_close(sock);
		return ret;
	}

	ret = zsock_connect(sock, (struct net_sockaddr *)&endereco, sizeof(endereco));
	if (ret < 0) {
		ret = -errno;
		LOG_ERR("Falha ao conectar em %s:%d (%d)",
			lab_rede_ip(), lab_rede_porta(), ret);
		zsock_close(sock);
		return ret;
	}

	k_mutex_lock(&aps_mutex, K_FOREVER);
	for (i = 0; i < num_aps; i++) {
		int n = snprintf(linha, sizeof(linha), "AP,%s,%d,%u,%s\n",
				  aps[i].bssid, aps[i].rssi, aps[i].freq_mhz, aps[i].ssid);
		if (n > 0) {
			zsock_send(sock, linha, (size_t)n, 0);
		}
	}
	ret = (int)num_aps;
	k_mutex_unlock(&aps_mutex);

	zsock_send(sock, "FIM\n", 4, 0);
	zsock_close(sock);

	LOG_INF("Scan (%d AP(s)) enviado para %s:%d", ret,
		lab_rede_ip(), lab_rede_porta());
	return 0;
}

static void realizar_scan_e_enviar(void)
{
	if (solicitar_scan() < 0) {
		return;
	}
	mandar_scan_para_pc();
}

static void thread_scan(void)
{
	while (1) {
		k_sem_take(&scan_disparado, K_FOREVER);
		realizar_scan_e_enviar();
	}
}

/* Rede (net_mgmt do scan, socket TCP): mesmo piso de 3072 medido no lab 9
 * para threads que fazem rede -- ver o relatorio da task.
 */
K_THREAD_DEFINE(scan_id, 3072, thread_scan, NULL, NULL, NULL, 7, 0, -1);

static void botao_pressionado_cb(const struct device *dev, struct gpio_callback *cb,
				  uint32_t pins)
{
	ARG_UNUSED(dev);
	ARG_UNUSED(cb);
	ARG_UNUSED(pins);

	k_sem_give(&scan_disparado);
}

static void configurar_botao(void)
{
	int ret;

	if (!gpio_is_ready_dt(&botao)) {
		LOG_ERR("Botao sw0 nao esta pronto");
		return;
	}

	ret = gpio_pin_configure_dt(&botao, GPIO_INPUT);
	if (ret < 0) {
		LOG_ERR("Falha ao configurar o botao sw0 (%d)", ret);
		return;
	}

	ret = gpio_pin_interrupt_configure_dt(&botao, GPIO_INT_EDGE_TO_ACTIVE);
	if (ret < 0) {
		LOG_ERR("Falha ao configurar a interrupcao do botao sw0 (%d)", ret);
		return;
	}

	gpio_init_callback(&botao_cb_data, botao_pressionado_cb, BIT(botao.pin));
	gpio_add_callback(botao.port, &botao_cb_data);
}

static void handler_wifi(struct net_mgmt_event_callback *cb, uint64_t evento,
			  struct net_if *iface)
{
	ARG_UNUSED(iface);

	if (evento != NET_EVENT_WIFI_CONNECT_RESULT) {
		return;
	}

	const struct wifi_status *status = (const struct wifi_status *)cb->info;

	if (status->status) {
		LOG_ERR("Falha ao conectar ao Wi-Fi (%d)", status->status);
	} else {
		LOG_INF("Conectado ao Wi-Fi");
	}
}

static void handler_net(struct net_mgmt_event_callback *cb, uint64_t evento,
			 struct net_if *iface)
{
	ARG_UNUSED(iface);

	if (evento != NET_EVENT_IPV4_DHCP_BOUND) {
		return;
	}

	const struct net_if_dhcpv4 *dhcpv4 = cb->info;
	char ip[NET_IPV4_ADDR_LEN];

	net_addr_ntop(NET_AF_INET, &dhcpv4->requested_ip, ip, sizeof(ip));
	LOG_INF("IP obtido por DHCP: %s", ip);

	k_sem_give(&ip_pronto);
}

#ifdef CONFIG_WIFI_READY_LIB
/* O supplicant (wpa_supplicant) demora um instante depois do driver do
 * nRF7002 inicializar. Pedir conexao antes disso falha com -ENOTSUP (-134) --
 * mesmo padrao do lab 7 (comms/07_wifi_sta/src/main.c) e do lab 9
 * (comms/09_wifi_tcp/src/main.c), reproduzido aqui.
 */
static K_SEM_DEFINE(wifi_pronto_sem, 0, 1);
static bool wifi_esta_pronto;

static void wifi_ready_cb(bool pronto)
{
	wifi_esta_pronto = pronto;
	k_sem_give(&wifi_pronto_sem);
}

static int esperar_wifi_pronto(void)
{
	wifi_ready_callback_t cb = {
		.wifi_ready_cb = wifi_ready_cb,
	};
	struct net_if *iface = net_if_get_first_wifi();
	int ret;

	if (!iface) {
		LOG_ERR("Nenhuma interface Wi-Fi encontrada");
		return -ENODEV;
	}

	ret = register_wifi_ready_callback(cb, iface);
	if (ret < 0) {
		LOG_ERR("Falha ao registrar o callback de Wi-Fi pronto (%d)", ret);
		return ret;
	}

	LOG_INF("Aguardando o supplicant do Wi-Fi ficar pronto...");
	ret = k_sem_take(&wifi_pronto_sem, K_SECONDS(10));
	if (ret < 0) {
		LOG_ERR("Tempo esgotado esperando o Wi-Fi ficar pronto (%d)", ret);
		return ret;
	}
	if (!wifi_esta_pronto) {
		LOG_ERR("Wi-Fi nao ficou pronto");
		return -EIO;
	}

	return 0;
}
#endif /* CONFIG_WIFI_READY_LIB */

static int conectar_wifi(void)
{
	struct net_if *iface = net_if_get_first_wifi();

	if (!iface) {
		LOG_ERR("Nenhuma interface Wi-Fi encontrada");
		return -ENODEV;
	}

	if (net_mgmt(NET_REQUEST_WIFI_CONNECT_STORED, iface, NULL, 0)) {
		LOG_ERR("Pedido de conexao Wi-Fi falhou");
		return -EIO;
	}

	LOG_INF("Conexao Wi-Fi solicitada");
	return 0;
}

int main(void)
{
	/* CURSO: rede da sala e IP/porta do servidor, digitados no terminal e
	 * gravados em settings. So retorna com tudo valido.
	 */
	lab_rede_ler(true, lab_rede_porta());

	net_mgmt_init_event_callback(&wifi_cb, handler_wifi, NET_EVENT_WIFI_CONNECT_RESULT);
	net_mgmt_add_event_callback(&wifi_cb);

	net_mgmt_init_event_callback(&net_cb, handler_net, NET_EVENT_IPV4_DHCP_BOUND);
	net_mgmt_add_event_callback(&net_cb);

	net_mgmt_init_event_callback(&scan_cb, handler_scan,
				      NET_EVENT_WIFI_SCAN_RESULT | NET_EVENT_WIFI_SCAN_DONE);
	net_mgmt_add_event_callback(&scan_cb);

	configurar_botao();

#ifdef CONFIG_WIFI_READY_LIB
	if (esperar_wifi_pronto() < 0) {
		LOG_WRN("Seguindo sem confirmar que o supplicant esta pronto");
	}
#endif /* CONFIG_WIFI_READY_LIB */

	if (conectar_wifi() < 0) {
		return -EIO;
	}

	LOG_INF("Aguardando IP por DHCP...");
	k_sem_take(&ip_pronto, K_FOREVER);

	k_thread_start(scan_id);

	/* Primeiro scan automatico, assim que a conexao fica pronta; os
	 * seguintes vem do sw0 (botao_pressionado_cb() -> thread_scan()).
	 */
	k_sem_give(&scan_disparado);

	return 0;
}
```
