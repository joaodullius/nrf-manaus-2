## CMakeLists.txt
```
#
# ORIGEM: copia de arquivo do SDK — nao e codigo do curso.
#   SDK     : nRF Connect SDK v3.4.0
#   Upstream: nrf/samples/wifi/provisioning/softap/CMakeLists.txt
#   Local   : C:/ncs/v3.4.0/nrf/samples/wifi/provisioning/softap/CMakeLists.txt
#   Copiado : 2026-09-06 — curso nrf-manaus-2, modulo comms/08a_wifi_provisioning
#
# Para conferir se divergiu do SDK:
#   diff <este arquivo> C:/ncs/v3.4.0/nrf/samples/wifi/provisioning/softap/CMakeLists.txt
#
# DIVERGENCIA DO CURSO: nenhuma.
#

#
# Copyright (c) 2024 Nordic Semiconductor ASA
#
# SPDX-License-Identifier: LicenseRef-Nordic-5-Clause
#

cmake_minimum_required(VERSION 3.20.0)

find_package(Zephyr REQUIRED HINTS $ENV{ZEPHYR_BASE})
project(softap_wifi_provision_sample)

target_sources(app PRIVATE src/main.c)
```

## prj.conf
```kconfig
#
# ORIGEM: copia de arquivo do SDK — nao e codigo do curso.
#   SDK     : nRF Connect SDK v3.4.0
#   Upstream: nrf/samples/wifi/provisioning/softap/prj.conf
#   Local   : C:/ncs/v3.4.0/nrf/samples/wifi/provisioning/softap/prj.conf
#   Copiado : 2026-09-06 — curso nrf-manaus-2, modulo comms/08a_wifi_provisioning
#
# Para conferir se divergiu do SDK:
#   diff <este arquivo> C:/ncs/v3.4.0/nrf/samples/wifi/provisioning/softap/prj.conf
#
# DIVERGENCIA DO CURSO: nenhuma.
#

#
# Copyright (c) 2024 Nordic Semiconductor ASA
#
# SPDX-License-Identifier: LicenseRef-Nordic-5-Clause
#

# Optimize TF-M
CONFIG_TFM_PROFILE_TYPE_SMALL=y
CONFIG_PM_PARTITION_SIZE_TFM_SRAM=0xa000
CONFIG_PM_PARTITION_SIZE_TFM=0x20000

# Optimize Wi-Fi stack to save some memory.
CONFIG_NRF_WIFI_CTRL_HEAP_SIZE=20000
CONFIG_NRF_WIFI_DATA_HEAP_SIZE=53000
CONFIG_NRF70_RX_NUM_BUFS=16
CONFIG_NRF70_MAX_TX_AGGREGATION=4

# Wi-Fi
CONFIG_WIFI=y
CONFIG_WIFI_NRF70=y
CONFIG_NRF70_AP_MODE=y
CONFIG_WIFI_NM_WPA_SUPPLICANT=y
CONFIG_WIFI_NM_WPA_SUPPLICANT_AP=y
CONFIG_NET_L2_ETHERNET=y
CONFIG_WIFI_CREDENTIALS=y
CONFIG_SETTINGS=y

# General
CONFIG_LOG=y
CONFIG_LOG_MODE_IMMEDIATE=y
CONFIG_ASSERT=y
CONFIG_ASSERT_VERBOSE=n
CONFIG_REBOOT=y

# Link-time optimizations
CONFIG_LTO=y
CONFIG_ISR_TABLES_LOCAL_DECLARATION=y

# Temporarily enable FS support so that linking succeeds.
CONFIG_FILE_SYSTEM=y
CONFIG_MAIN_STACK_SIZE=6200
CONFIG_NANOPB=y
CONFIG_SMF=y

# HTTP parser
CONFIG_HTTP_PARSER=y
CONFIG_HTTP_PARSER_URL=y

# DK Butons and LEDs
CONFIG_DK_LIBRARY=y

# Networking config
CONFIG_NETWORKING=y
CONFIG_NET_CONNECTION_MANAGER=y
CONFIG_NET_IPV4=y
# Disable IPv6 to save memory
CONFIG_NET_IPV6=n
CONFIG_NET_TCP=y
CONFIG_NET_UDP=y
CONFIG_NET_SOCKETS=y
CONFIG_NET_MAX_CONN=8
CONFIG_NET_SOCKETS_TLS_MAX_CONTEXTS=2
CONFIG_NET_SOCKETS_SOCKOPT_TLS=y

# Zephyr NET Connection Manager connectivity layer
CONFIG_L2_WIFI_CONNECTIVITY=y
CONFIG_L2_WIFI_CONNECTIVITY_AUTO_CONNECT=n
CONFIG_L2_WIFI_CONNECTIVITY_AUTO_DOWN=n

# SoftAP Wi-Fi Provision library
CONFIG_SOFTAP_WIFI_PROVISION=y
CONFIG_SOFTAP_WIFI_PROVISION_THREAD_STACK_SIZE=8192
# Disable socket close on completed provisioning to keep mDNS SD running.
# SD depends on the socket being open for a specified port.
CONFIG_SOFTAP_WIFI_PROVISION_SOCKET_CLOSE_ON_COMPLETION=n
CONFIG_SOFTAP_WIFI_PROVISION_LOG_LEVEL_DBG=y
CONFIG_WIFI_NM_WPA_SUPPLICANT_THREAD_STACK_SIZE=8192

# (M)DNS
CONFIG_MDNS_RESPONDER=y
CONFIG_DNS_SD=y
CONFIG_MDNS_RESPONDER_DNS_SD=y
CONFIG_NET_HOSTNAME_ENABLE=y
CONFIG_NET_HOSTNAME="wifiprov"
# Disable POSIX uname support to suppress build warning that hostname is too long.
CONFIG_POSIX_SINGLE_PROCESS=n

# DHCPv4 client and server
CONFIG_NET_DHCPV4=y
CONFIG_NET_DHCPV4_SERVER=y

# Store TLS credentials to protected storage.
CONFIG_TLS_CREDENTIALS=y
CONFIG_TLS_CREDENTIALS_BACKEND_PROTECTED_STORAGE=y

CONFIG_FLASH=y
CONFIG_FLASH_PAGE_LAYOUT=y
CONFIG_FLASH_MAP=y
CONFIG_ZMS=y
CONFIG_SETTINGS=y
CONFIG_SETTINGS_ZMS=y

# Disable auto init of NET config as the softAP Wi-Fi provision library will manually set its
# own IP configuration.
CONFIG_NET_CONFIG_AUTO_INIT=n

# Default mbedTLS heap is 512 B; PEM decode of server cert/key needs more or load fails with
# MBEDTLS_ERR_PEM_ALLOC_FAILED (-0x1180) during tls_credential_add().
CONFIG_MBEDTLS_HEAP_SIZE=49152

# nrf_security can leave PEM parsing off; embedded PEM certs need this or x509 parse fails with
# MBEDTLS_ERR_X509_INVALID_FORMAT (-0x2180).
CONFIG_MBEDTLS_PEM_PARSE_C=y

# Embedded PEMs are ECDSA P-256 (prime256v1). PSA must list
# secp256r1 and ECDSA/ECDH or mbedtls_x509_crt_parse() returns MBEDTLS_ERR_X509_INVALID_FORMAT
# (-0x2180). TLS server ECDHE uses psa_generate_key() then psa_export_public_key() for the
# ephemeral key; without PSA_WANT_KEY_TYPE_ECC_KEY_PAIR_GENERATE / EXPORT, those calls map to
# MBEDTLS_ERR_SSL_FEATURE_UNAVAILABLE (-0x7080). See samples/crypto/psa_tls/prj.conf.
CONFIG_PSA_WANT_ALG_ECDSA=y
CONFIG_PSA_WANT_ALG_ECDH=y
CONFIG_PSA_WANT_ECC_SECP_R1_256=y
CONFIG_PSA_WANT_KEY_TYPE_ECC_PUBLIC_KEY=y
CONFIG_PSA_WANT_KEY_TYPE_ECC_KEY_PAIR_IMPORT=y
CONFIG_PSA_WANT_KEY_TYPE_ECC_KEY_PAIR_GENERATE=y
CONFIG_PSA_WANT_KEY_TYPE_ECC_KEY_PAIR_EXPORT=y
```

## meu_softap.conf
```kconfig
#
# Fragmento do aluno — o SSID do SoftAP de provisionamento deste kit.
#
# Uso:
#   west build ... -- -D08a_wifi_provisioning_EXTRA_CONF_FILE=meu_softap.conf
#
# Vem com o valor padrao da biblioteca, que e o que o app da Nordic ja sugere.
# Numa sala com varios kits, todos anunciam ESTE MESMO nome e nao ha como saber em
# qual deles voce entrou — o SoftAP e aberto, e o SSID e a unica coisa que distingue
# um kit do outro no ar. Se quiser o seu proprio, troque o valor abaixo por algo
# unico (numero de bancada, iniciais).
#
# ATENCAO ao escolher o nome, se voce for usar o APP nRF Wi-Fi Provisioner:
# o campo "Edit SSID" do app tem um defeito — a tela se redesenha sozinha e o
# teclado volta para as letras toda vez que voce troca para a pagina de simbolos,
# o que torna impossivel digitar "-" ou qualquer caractere especial. Entao:
#   - use SO letras e numeros (ex.: "nrfprov07"), e o app consegue digitar; ou
#   - use o scripts/provision.py, que NAO olha o SSID do SoftAP — voce entra na
#     rede na mao e ele fala com wifiprov.local. Por script, qualquer nome serve.
# Observado na bancada em 2026-09-07.
#
# Este valor NAO e segredo (e so o nome do AP que a DK anuncia): pode ser
# commitado a vontade. A senha da rede da sala nao fica em arquivo nenhum.
#
# Nao mexa no CONFIG_NET_HOSTNAME por causa disto. O certificado do servidor HTTPS
# e amarrado ao hostname (wifiprov.local), nao ao SSID, e o provision.py resolve
# esse nome. Mudar so o SSID nao obriga a regerar certificado nenhum.
#
CONFIG_SOFTAP_WIFI_PROVISION_SSID="nrf-wifiprov"
```

## src/main.c
```c
/*
 * ORIGEM: copia de arquivo do SDK — nao e codigo do curso.
 *   SDK     : nRF Connect SDK v3.4.0
 *   Upstream: nrf/samples/wifi/provisioning/softap/src/main.c
 *   Local   : C:/ncs/v3.4.0/nrf/samples/wifi/provisioning/softap/src/main.c
 *   Copiado : 2026-09-06 — curso nrf-manaus-2, modulo comms/08a_wifi_provisioning
 *
 * Para conferir se divergiu do SDK:
 *   diff <este arquivo> C:/ncs/v3.4.0/nrf/samples/wifi/provisioning/softap/src/main.c
 *
 * DIVERGENCIA DO CURSO: imprime o IP recebido da rede provisionada.
 *   O sample original so loga "Network connected" e nunca mostra o endereco que o
 *   kit pegou por DHCP -- para achar o kit na rede era preciso cacar o MAC na tabela
 *   ARP do PC. Foi acrescentada uma assinatura de NET_EVENT_IPV4_DHCP_BOUND que
 *   imprime "DHCP IP address: ...", o mesmo texto do lab 7. Procure por
 *   "DIVERGENCIA DO CURSO" no corpo do arquivo para ver os dois trechos.
 */

/*
 * Copyright (c) 2024 Nordic Semiconductor ASA
 *
 * SPDX-License-Identifier: LicenseRef-Nordic-5-Clause
 */

#include <stdio.h>
#include <errno.h>
#include <zephyr/kernel.h>
#include <zephyr/logging/log.h>
#include <zephyr/logging/log_ctrl.h>
#include <zephyr/sys/reboot.h>
#include <zephyr/net/wifi_mgmt.h>
#include <zephyr/net/net_mgmt.h>
#include <zephyr/net/net_event.h>
#include <zephyr/net/conn_mgr_monitor.h>
#include <zephyr/net/conn_mgr_connectivity.h>
#include <zephyr/net/dhcpv4.h>
#include <dk_buttons_and_leds.h>
#include <net/softap_wifi_provision.h>

LOG_MODULE_REGISTER(softap_wifi_provision_sample, CONFIG_SOFTAP_WIFI_PROVISION_SAMPLE_LOG_LEVEL);

/* Macro used to subscribe to specific Zephyr NET management events. */
#define L4_EVENT_MASK (NET_EVENT_L4_CONNECTED | NET_EVENT_L4_DISCONNECTED)
#define CONN_LAYER_EVENT_MASK (NET_EVENT_CONN_IF_FATAL_ERROR)

/* Macro called upon a fatal error, reboots the device. */
#define FATAL_ERROR()								\
	LOG_ERR("Fatal error!%s", IS_ENABLED(CONFIG_RESET_ON_FATAL_ERROR) ?	\
				  " Rebooting the device" : "");		\
	LOG_PANIC();								\
	IF_ENABLED(CONFIG_REBOOT, (sys_reboot(0)))

/* Callbacks for Zephyr NET management events. */
static struct net_mgmt_event_callback l4_cb;
static struct net_mgmt_event_callback conn_cb;

/* DIVERGENCIA DO CURSO: o sample original nao imprime o IP que o kit recebe da rede
 * provisionada -- ele so loga "Network connected". Sem o endereco, nao ha como falar
 * com o kit depois de provisionado a nao ser cacando o MAC na tabela ARP do PC. O
 * bloco abaixo assina NET_EVENT_IPV4_DHCP_BOUND e imprime o endereco, no mesmo
 * formato do lab 7 ("DHCP IP address: ...") para os dois logs se lerem igual.
 */
static struct net_mgmt_event_callback dhcp_cb;

static void print_dhcp_ip(struct net_mgmt_event_callback *cb)
{
	const struct net_if_dhcpv4 *dhcpv4 = cb->info;
	const struct in_addr *addr = &dhcpv4->requested_ip;
	char dhcp_info[128];

	net_addr_ntop(AF_INET, addr, dhcp_info, sizeof(dhcp_info));

	LOG_INF("DHCP IP address: %s", dhcp_info);
}

static void dhcp_event_handler(struct net_mgmt_event_callback *cb,
			       uint64_t event,
			       struct net_if *iface)
{
	ARG_UNUSED(iface);

	switch (event) {
	case NET_EVENT_IPV4_DHCP_BOUND:
		print_dhcp_ip(cb);
		break;
	default:
		/* Don't care */
		return;
	}
}

static void l4_event_handler(struct net_mgmt_event_callback *cb,
			     uint64_t event,
			     struct net_if *iface)
{
	switch (event) {
	case NET_EVENT_L4_CONNECTED:
		LOG_INF("Network connected");

		int ret = dk_set_led_on(DK_LED2);

		if (ret) {
			LOG_ERR("dk_set_led_on, error: %d", ret);
			FATAL_ERROR();
			return;
		}

		/* Start the DHCPv4 client after the device is provisioned to a network.
		 * This is needed to get a dynamic IPv4 address from the APs DHCPv4 server.
		 */
		net_dhcpv4_start(iface);
		break;
	case NET_EVENT_L4_DISCONNECTED:
		LOG_INF("Network disconnected");
		break;
	default:
		/* Don't care */
		return;
	}
}

static void connectivity_event_handler(struct net_mgmt_event_callback *cb,
				       uint64_t event,
				       struct net_if *iface)
{
	if (event == NET_EVENT_CONN_IF_FATAL_ERROR) {
		LOG_ERR("NET_EVENT_CONN_IF_FATAL_ERROR");
		FATAL_ERROR();
		return;
	}
}

/* Callback for softAP Wi-Fi provision library events. */
static void softap_wifi_provision_handler(const struct softap_wifi_provision_evt *evt)
{
	int ret;

	switch (evt->type) {
	case SOFTAP_WIFI_PROVISION_EVT_STARTED:
		LOG_INF("Provisioning started");

		ret = dk_set_led_on(DK_LED1);
		if (ret) {
			LOG_ERR("dk_set_led_on, error: %d", ret);
			FATAL_ERROR();
			return;
		}

		break;
	case SOFTAP_WIFI_PROVISION_EVT_CLIENT_CONNECTED:
		LOG_INF("Client connected");
		break;
	case SOFTAP_WIFI_PROVISION_EVT_CLIENT_DISCONNECTED:
		LOG_INF("Client disconnected");
		break;
	case SOFTAP_WIFI_PROVISION_EVT_CREDENTIALS_RECEIVED:
		LOG_INF("Wi-Fi credentials received");
		break;
	case SOFTAP_WIFI_PROVISION_EVT_COMPLETED:
		LOG_INF("Provisioning completed");
		break;
	case SOFTAP_WIFI_PROVISION_EVT_UNPROVISIONED_REBOOT_NEEDED:
		LOG_INF("Reboot request notified, rebooting...");

		LOG_PANIC();
		IF_ENABLED(CONFIG_REBOOT, (sys_reboot(0)));
		break;
	case SOFTAP_WIFI_PROVISION_EVT_FATAL_ERROR:
		LOG_ERR("Provisioning failed, fatal error!");
		FATAL_ERROR();
		break;
	default:
		/* Don't care */
		return;
	}
}

static void button_handler(uint32_t button_states, uint32_t has_changed)
{
	if ((has_changed & DK_BTN1_MSK) && (button_states & DK_BTN1_MSK)) {
		LOG_INF("Button 1 pressed");

		int ret = softap_wifi_provision_reset();

		if (ret) {
			LOG_ERR("softap_wifi_provision_reset, error: %d", ret);
			FATAL_ERROR();
			return;
		}
	}
}

static int wifi_power_saving_disable(void)
{
	int ret;
	struct net_if *iface = net_if_get_first_wifi();
		struct wifi_ps_params params = {
		.enabled = WIFI_PS_DISABLED
	};

	ret = net_mgmt(NET_REQUEST_WIFI_PS, iface, &params, sizeof(params));
	if (ret) {
		LOG_ERR("Failed to disable PSM, error: %d", ret);
		FATAL_ERROR();
		return ret;
	}

	return 0;
}

static int wifi_power_saving_enable(void)
{
	int ret;
	struct net_if *iface = net_if_get_first_wifi();
	struct wifi_ps_params params = {
		.enabled = WIFI_PS_ENABLED
	};

	ret = net_mgmt(NET_REQUEST_WIFI_PS, iface, &params, sizeof(params));
	if (ret) {
		LOG_ERR("Failed to enable PSM, error: %d", ret);
		FATAL_ERROR();
		return ret;
	}

	return 0;
}

/* Function used to disable and re-enable PSM after a configured amount of time post provisioning.
 * This is to ensure that the device is discoverable via mDNS so that clients can
 * confirm that provisioning succeeded. This is needed due to mDNS SD being unstable
 * in Power Save Mode.
 */
static void psm_set(void)
{
	int ret;

	ret = wifi_power_saving_disable();
	if (ret) {
		LOG_ERR("wifi_power_saving_disable, error: %d", ret);
		FATAL_ERROR();
		return;
	}

	LOG_INF("PSM disabled");

	k_sleep(K_SECONDS(CONFIG_SOFTAP_WIFI_PROVISION_SAMPLE_PSM_DISABLED_SECONDS));

	ret = wifi_power_saving_enable();
	if (ret) {
		LOG_ERR("wifi_power_saving_enable, error: %d", ret);
		FATAL_ERROR();
		return;
	}

	LOG_INF("PSM enabled");
}

int main(void)
{
	int ret;
	bool provisioning_completed = false;

	LOG_INF("SoftAP Wi-Fi provision sample started");

	ret = dk_buttons_init(button_handler);
	if (ret) {
		LOG_ERR("dk_buttons_init, error: %d", ret);
		FATAL_ERROR();
		return ret;
	}

	ret = dk_leds_init();
	if (ret) {
		LOG_ERR("dk_leds_init, error: %d", ret);
		FATAL_ERROR();
		return ret;
	}

	ret = softap_wifi_provision_init(softap_wifi_provision_handler);
	if (ret) {
		LOG_ERR("softap_wifi_provision_init, error: %d", ret);
		FATAL_ERROR();
		return ret;
	}

	ret = conn_mgr_all_if_up(true);
	if (ret) {
		LOG_ERR("conn_mgr_all_if_up, error: %d", ret);
		FATAL_ERROR();
		return ret;
	}

	LOG_INF("Network interface brought up");

	ret = softap_wifi_provision_start();
	switch (ret) {
	case 0:
		provisioning_completed = true;
		break;
	case -EALREADY:
		LOG_INF("Wi-Fi credentials found, skipping provisioning");
		break;
	default:
		LOG_ERR("softap_wifi_provision_start, error: %d", ret);
		FATAL_ERROR();
		return ret;
	}

	/* Register NET mgmt handlers for Connection Manager events after provisioning
	 * is completed. This is to avoid receiving events during provisioning when the device is
	 * in softAP (server) mode and gets assigned an IP,
	 * which triggers the NET_EVENT_L4_CONNECTED.
	 */

	/* Setup handler for Zephyr NET Connection Manager events. */
	net_mgmt_init_event_callback(&l4_cb, l4_event_handler, L4_EVENT_MASK);
	net_mgmt_add_event_callback(&l4_cb);

	/* Setup handler for Zephyr NET Connection Manager Connectivity layer. */
	net_mgmt_init_event_callback(&conn_cb, connectivity_event_handler, CONN_LAYER_EVENT_MASK);
	net_mgmt_add_event_callback(&conn_cb);

	/* DIVERGENCIA DO CURSO: imprime o IP da rede provisionada. Registrado aqui junto
	 * com os outros, isto e, depois do provisionamento, pelo mesmo motivo do
	 * comentario acima.
	 */
	net_mgmt_init_event_callback(&dhcp_cb, dhcp_event_handler, NET_EVENT_IPV4_DHCP_BOUND);
	net_mgmt_add_event_callback(&dhcp_cb);

	ret = conn_mgr_all_if_connect(true);
	if (ret) {
		LOG_ERR("conn_mgr_all_if_connect, error: %d", ret);
		FATAL_ERROR();
		return ret;
	}

	if (provisioning_completed) {
		psm_set();
	}

	return 0;
}
```
