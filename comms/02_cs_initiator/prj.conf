## CMakeLists.txt
```
#
# Copyright (c) 2024 Nordic Semiconductor
#
# SPDX-License-Identifier: LicenseRef-Nordic-5-Clause
#

cmake_minimum_required(VERSION 3.20.0)

find_package(Zephyr REQUIRED HINTS $ENV{ZEPHYR_BASE})
project(channel_sound_ras_initiator)

# ALTERADO PELO CURSO (nrf-manaus-2): falha cedo e com mensagem util, em vez de
# compilar um initiator que conecta no TAG do colega.
if(NOT CONFIG_LAB_TAG_ADDR_VALUE)
  message(FATAL_ERROR
    "CONFIG_LAB_TAG_ADDR_VALUE nao definido.\n"
    "Este initiator so conecta no TAG cujo endereco BLE for informado.\n"
    "E o MESMO endereco do edge_ai/03_central_uart — copie o meu_tag.conf de la,\n"
    "ou leia a linha \"Identity:\" do log RTT do TAG e preencha:\n"
    "  CONFIG_LAB_TAG_ADDR_VALUE=\"EF:12:34:56:78:9A\"\n"
    "  CONFIG_LAB_TAG_ADDR_TYPE=\"random\"\n"
    "e compile com -DEXTRA_CONF_FILE=meu_tag.conf")
endif()

FILE(GLOB app_sources src/*.c)
# NORDIC SDK APP START
target_sources(app PRIVATE
  ${app_sources}
)
# NORDIC SDK APP END
```

## Kconfig
```
#
# Copyright (c) 2026 Nordic Semiconductor ASA
#
# SPDX-License-Identifier: LicenseRef-Nordic-5-Clause
#

# ALTERADO PELO CURSO (nrf-manaus-2): menu abaixo acrescentado.
menu "Lab: Channel Sounding (nrf-manaus-2)"

config LAB_PROCEDURE_INTERVAL
	int "Intervalo entre procedures de CS (em intervalos de conexao; 0 = valor do sample)"
	default 0
	range 0 255
	help
	  Quantos intervalos de conexao ACL (20 ms neste sample) separam dois
	  procedures de Channel Sounding. 0 mantem a escolha do sample da Nordic:
	  5 com ranging data em tempo real, 10 caso contrario (100 ou 200 ms).

	  Seis estacoes medindo ao mesmo tempo na mesma sala nao e uma condicao
	  que a Nordic documenta. Se as medidas degradarem, escalone: estacao n
	  (0 a 5) usa 50 + n*12 (1000 a 2200 ms), passado por fragmento ou
	  -DCONFIG_LAB_PROCEDURE_INTERVAL=<n>.

endmenu

menu "Channel Sounding RAS Initiator sample"

choice SAMPLE_RAS_INITIATOR_STEP_MODE
	prompt "Channel Sounding Step Modes selection"
	default SAMPLE_RAS_INITIATOR_STEP_MODE_2_SUB_MODE_1

config SAMPLE_RAS_INITIATOR_STEP_MODE_2_SUB_MODE_1
	bool "Main: 2, Sub: 1."
	help
	  This option enables CS with main mode 2 and submode 1.
	  Mode 2 steps are used for PBR and mode 1 steps are used for RTT.

config SAMPLE_RAS_INITIATOR_STEP_MODE_1
	bool "Main: 1, Sub: unused."
	help
	  This option enables CS with main mode 1 and submode unused.
	  Mode 1 steps are used for RTT.

config SAMPLE_RAS_INITIATOR_STEP_MODE_2
	bool "Main: 2, Sub: unused."
	help
	  This option enables CS with main mode 2 and submode unused.
	  Mode 2 steps are used for PBR.

config SAMPLE_RAS_INITIATOR_STEP_MODE_3
	bool "Main: 3, Sub: unused."
	select BT_RAS_MODE_3_SUPPORTED
	select BT_CTLR_SDC_CS_STEP_MODE3
	help
	  This option enables CS with main mode 3 and submode unused.
	  Mode 3 steps are used for PBR and RTT.

endchoice

endmenu

source "Kconfig.zephyr"
```

## prj.conf
```kconfig
#
# ORIGEM: copia de arquivo do SDK — nao e codigo do curso.
#   SDK     : nRF Connect SDK v3.4.0
#   Upstream: nrf/samples/bluetooth/channel_sounding/ras_initiator/prj.conf
#   Local   : C:/ncs/v3.4.0/nrf/samples/bluetooth/channel_sounding/ras_initiator/prj.conf
#   Copiado : 2026-09-05 — curso nrf-manaus-2, modulo comms/02_cs_initiator
#
# Para conferir se divergiu do SDK:
#   diff <este arquivo> C:/ncs/v3.4.0/nrf/samples/bluetooth/channel_sounding/ras_initiator/prj.conf
#
# DIVERGENCIA DO CURSO (unica): CONFIG_BT_SCAN_ADDRESS_CNT=1 no bloco de scan.
#   O endereco do filtro nao e config: o aluno digita no terminal serial no boot.
#

#
# Copyright (c) 2024 Nordic Semiconductor ASA
#
# SPDX-License-Identifier: LicenseRef-Nordic-5-Clause
#

CONFIG_NCS_SAMPLES_DEFAULTS=y
CONFIG_DK_LIBRARY=y

CONFIG_BT=y
CONFIG_BT_SMP=y
CONFIG_BT_CENTRAL=y
CONFIG_BT_MAX_CONN=1
CONFIG_BT_BONDABLE=n

CONFIG_BT_GATT_CLIENT=y
CONFIG_BT_GATT_DYNAMIC_DB=y

CONFIG_BT_CHANNEL_SOUNDING=y
CONFIG_BT_RAS=y
CONFIG_BT_RAS_RREQ=y

CONFIG_BT_SCAN=y
CONFIG_BT_SCAN_FILTER_ENABLE=y
CONFIG_BT_SCAN_UUID_CNT=1
# ALTERADO PELO CURSO (nrf-manaus-2): um slot de filtro por endereco, para o
# add_tag_address_filter() de src/main.c.
CONFIG_BT_SCAN_ADDRESS_CNT=1

# The Ranging Profile recommends a MTU of at least 247 octets.
CONFIG_BT_L2CAP_TX_MTU=498
CONFIG_BT_BUF_ACL_TX_SIZE=502
CONFIG_BT_BUF_ACL_RX_SIZE=502
CONFIG_BT_ATT_PREPARE_COUNT=3
CONFIG_BT_CTLR_DATA_LENGTH_MAX=251

# This reduces RAM usage. Additional RAM is needed to support optional
# features such as mode 3 or multiantenna. Change or remove these if
# using those features
CONFIG_BT_RAS_MODE_3_SUPPORTED=n
CONFIG_BT_RAS_MAX_ANTENNA_PATHS=1
CONFIG_BT_CS_DE_MAX_NUM_ANTENNA_PATHS=1
CONFIG_BT_CTLR_SDC_CS_MAX_ANTENNA_PATHS=1
CONFIG_BT_CTLR_SDC_CS_NUM_ANTENNAS=1
CONFIG_BT_CTLR_SDC_CS_STEP_MODE3=n
CONFIG_BT_CTLR_SDC_CS_ROLE_INITIATOR_ONLY=y

# Disabling the CS Test command reduces flash usage
CONFIG_BT_CTLR_CHANNEL_SOUNDING_TEST=n

# This allows CS and ACL to use different PHYs
CONFIG_BT_TRANSMIT_POWER_CONTROL=y

# This improves the performance of floating-point operations
CONFIG_FPU=y
CONFIG_FPU_SHARING=y

CONFIG_CBPRINTF_FP_SUPPORT=y

CONFIG_BT_CS_DE=y
CONFIG_BT_CS_DE_512_NFFT=y
```

## pbr_only.conf
```kconfig
#
# Variacao opcional do lab 2 (nrf-manaus-2): so PBR (step mode 2).
# Uso: -DEXTRA_CONF_FILE=pbr_only.conf
# Rebuild so da DK; o reflector nao muda.
#
CONFIG_SAMPLE_RAS_INITIATOR_STEP_MODE_2=y
```

## rtt_only.conf
```kconfig
#
# Variacao opcional do lab 2 (nrf-manaus-2): so RTT (step mode 1).
# Uso: -DEXTRA_CONF_FILE=rtt_only.conf
# Rebuild so da DK; o reflector nao muda.
#
CONFIG_SAMPLE_RAS_INITIATOR_STEP_MODE_1=y
```

## boards/nrf54lm20dk_nrf54lm20a_cpuapp.overlay
```dts
/*
 * ORIGEM: copia de arquivo do SDK — nao e codigo do curso.
 *   SDK     : nRF Connect SDK v3.4.0
 *   Upstream: nrf/samples/bluetooth/channel_sounding/ras_initiator/boards/nrf54lm20dk_nrf54lm20a_cpuapp.overlay
 *   Local   : C:/ncs/v3.4.0/nrf/samples/bluetooth/channel_sounding/ras_initiator/boards/nrf54lm20dk_nrf54lm20a_cpuapp.overlay
 *   Copiado : 2026-09-05 — curso nrf-manaus-2, modulo comms/02_cs_initiator
 *
 * Para conferir se divergiu do SDK:
 *   diff <este arquivo> C:/ncs/v3.4.0/nrf/samples/bluetooth/channel_sounding/ras_initiator/boards/nrf54lm20dk_nrf54lm20a_cpuapp.overlay
 *
 * DIVERGENCIA DO CURSO: nenhuma.
 */

/*
 * Copyright (c) 2025 Nordic Semiconductor ASA
 *
 * SPDX-License-Identifier: LicenseRef-Nordic-5-Clause
 */

/ {
	cs_antenna_switch: cs-antenna-config {
		status = "okay";
		compatible = "nordic,bt-cs-antenna-switch";
		ant-gpios = <&gpio1 17 GPIO_ACTIVE_HIGH>,
			    <&gpio1 18 GPIO_ACTIVE_HIGH>,
			    <&gpio1 19 GPIO_ACTIVE_HIGH>,
			    <&gpio1 20 GPIO_ACTIVE_HIGH>;
		multiplexing-mode = <0>;
	};
};
```

## boards/nrf54lm20dk_nrf54lm20b_cpuapp.overlay
```dts
/*
 * ORIGEM: copia de arquivo do SDK — nao e codigo do curso.
 *   SDK     : nRF Connect SDK v3.4.0
 *   Upstream: nrf/samples/bluetooth/channel_sounding/ras_initiator/boards/nrf54lm20dk_nrf54lm20b_cpuapp.overlay
 *   Local   : C:/ncs/v3.4.0/nrf/samples/bluetooth/channel_sounding/ras_initiator/boards/nrf54lm20dk_nrf54lm20b_cpuapp.overlay
 *   Copiado : 2026-09-05 — curso nrf-manaus-2, modulo comms/02_cs_initiator
 *
 * Para conferir se divergiu do SDK:
 *   diff <este arquivo> C:/ncs/v3.4.0/nrf/samples/bluetooth/channel_sounding/ras_initiator/boards/nrf54lm20dk_nrf54lm20b_cpuapp.overlay
 *
 * DIVERGENCIA DO CURSO: nenhuma.
 */

/*
 * Copyright (c) 2026 Nordic Semiconductor ASA
 *
 * SPDX-License-Identifier: LicenseRef-Nordic-5-Clause
 */

/ {
	cs_antenna_switch: cs-antenna-config {
		status = "okay";
		compatible = "nordic,bt-cs-antenna-switch";
		ant-gpios = <&gpio1 17 GPIO_ACTIVE_HIGH>,
			    <&gpio1 18 GPIO_ACTIVE_HIGH>,
			    <&gpio1 19 GPIO_ACTIVE_HIGH>,
			    <&gpio1 20 GPIO_ACTIVE_HIGH>;
		multiplexing-mode = <0>;
	};
};
```

## src/lab_tag_addr.h
```c
/*
 * ARQUIVO DO CURSO (nrf-manaus-2) — nao existe no SDK.
 *
 * Endereco BLE do TAG do aluno, digitado no terminal serial no boot.
 * Mesmo mecanismo do edge_ai/03_central_uart; copiado igual nos tres
 * initiators de Channel Sounding (comms/02, comms/03/initiator, comms/05).
 */

#ifndef LAB_TAG_ADDR_H_
#define LAB_TAG_ADDR_H_

#include <zephyr/bluetooth/addr.h>

/* Pede o endereco no console serial e so retorna com um valido. */
void lab_tag_addr_read(bt_addr_le_t *addr);

#endif /* LAB_TAG_ADDR_H_ */
```
